## make/libs/libcjson/Config.in
```kconfig
config FREETZ_LIB_libcjson
	bool "libcjson"
	default n
	help
		Ultralightweight JSON parser in ANSI C.
```

## make/libs/libusb/Config.in
```kconfig
menu "libusb(-compat)"

	config FREETZ_LIB_libusb_0
		bool "libusb-0.1 (libusb-0.1.so)"
		select FREETZ_LIB_libusb_1 if FREETZ_LIB_libusb_0_WITH_VERSION_CURRENT
		default n
		help
			A library for accessing Linux USB devices (legacy API).

	choice
		prompt "implemented using"
			default FREETZ_LIB_libusb_0_WITH_VERSION_CURRENT

		config FREETZ_LIB_libusb_0_WITH_VERSION_ABANDON
			bool "legacy library"

		config FREETZ_LIB_libusb_0_WITH_VERSION_CURRENT
			bool "libusb-compat"
	endchoice

endmenu # libusb(-compat)
```

## make/libs/libusb1/Config.in
```kconfig
menu "libusb1"

	config FREETZ_LIB_libusb_1
		bool "libusb-1.0 (libusb-1.0.so)"
		select FREETZ_LIB_libpthread if FREETZ_TARGET_UCLIBC_HAS_multiple_libs
		default n
		help
			A library for accessing Linux USB devices (current API).

	choice
		prompt "Version"
			default FREETZ_LIB_libusb_1_WITH_VERSION_CURRENT

		config FREETZ_LIB_libusb_1_WITH_VERSION_ABANDON
			bool "1.0.23"
			depends on (FREETZ_TARGET_GCC_4_MAX || FREETZ_KERNEL_VERSION_2_MAX)

		config FREETZ_LIB_libusb_1_WITH_VERSION_CURRENT
			bool "1.0.30"
			depends on !(FREETZ_TARGET_GCC_4_MAX || FREETZ_KERNEL_VERSION_2_MAX)
	endchoice

endmenu # libusb1
```

## make/pkgs/mini-snmpd/Config.in
```kconfig
config FREETZ_PACKAGE_MINI_SNMPD
	bool "mini-snmpd 1.7 (binary only)"
	depends on !(FREETZ_TARGET_UCLIBC_0_9_28 || FREETZ_TARGET_UCLIBC_0_9_29)
	default n
	help
		This program is an SNMP server for "embedded systems".
		The advantage in comparison to other products is the
		low usage of system resources.
```
