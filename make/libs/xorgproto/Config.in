## make/libs/xorgproto/Config.in
```kconfig
config FREETZ_LIB_libxorgproto
	bool "xorgproto (X11 protocol headers)"
	default n
	help
		Xorg protocol headers package providing the X11 protocol definitions
		needed to compile X11 client libraries (libX11, libXt, etc.).
		This is a header-only package, no shared library.
		
		Website: https://www.x.org/
```

## make/libs/xtrans/Config.in
```kconfig
config FREETZ_LIB_libxtrans
	bool "xtrans (X11 transport layer headers)"
	default n
	help
		X transport layer headers needed to build libX11.
		This is a header-only package, no shared library.
		
		Website: https://www.x.org/
```

## make/libs/yaml-cpp/Config.in
```kconfig
config FREETZ_LIB_libyaml_cpp
	bool "yaml-cpp (libyaml-cpp.so)"
	depends on FREETZ_TARGET_GCC_4_8_MIN
	select FREETZ_LIB_libstdcxx
	default n
	help
		YAML parser and emitter library for C++.
```

## make/pkgs/age/Config.in
```kconfig
config FREETZ_PACKAGE_AGE
	bool "age 1.3.1 (binaries only)"
	default n
	help
		age is a modern file encryption tool.

		This package cross-compiles the upstream Go sources and installs the
		age and age-keygen executables on the target.

		Can be externalized to save flash memory.
```

## make/pkgs/alsa-utils-cgi/Config.in
```kconfig
config FREETZ_PACKAGE_ALSA_UTILS_CGI
	bool "alsa-utils CGI (audio status/test web UI)"
	depends on FREETZ_PACKAGE_ALSA_UTILS
	default y
	help
		Provides the freetz web UI pages for ALSA playback tests,
		capability inspection and mixer or volume control.

		http://fritz.box:81/cgi-bin/conf/alsa-utils
```

## make/pkgs/alsa-utils/Config.in
```kconfig
config FREETZ_PACKAGE_ALSA_UTILS
	bool "alsa-utils 1.2.13"
	select FREETZ_LIB_libasound
	select FREETZ_MODULE_snd_usb_audio if FREETZ_MODULES_AUDIO_AVAILABLE
	default n
	help
		ALSA command line utilities including aplay, arecord, amixer,
		alsactl and speaker-test.

		Note: this lean Freetz build keeps optional ALSA tools/features
		disabled by default (can be enabled below).

if FREETZ_PACKAGE_ALSA_UTILS

config FREETZ_PACKAGE_ALSA_UTILS_WITH_ALSAMIXER
	bool "Build alsamixer (ncurses UI)"
	select FREETZ_LIB_libncurses
	select FREETZ_LIB_libform
	default n
	help
		Enable the ncurses-based alsamixer binary.

config FREETZ_PACKAGE_ALSA_UTILS_WITH_ALSACONF
	bool "Build alsaconf"
	default n
	help
		Enable the legacy alsaconf helper script.

config FREETZ_PACKAGE_ALSA_UTILS_WITH_ALSALOOP
	bool "Build alsaloop"
	default n
	help
		Enable the ALSA loopback transfer utility.

config FREETZ_PACKAGE_ALSA_UTILS_WITH_BAT
	bool "Build alsabat and bat helpers"
	default n
	help
		Enable alsabat and related BAT helper scripts.

config FREETZ_PACKAGE_ALSA_UTILS_WITH_NHLT
	bool "Build NHLT tools"
	default n
	help
		Enable NHLT parsing support and nhlt-dmic-info utility.

config FREETZ_PACKAGE_ALSA_UTILS_CGI
	bool "alsa-utils CGI (audio status/test web UI)"
	default y
	help
		Provides the freetz web UI pages for ALSA device testing, sample
		playback, mixer inspection and volume control.
		This is the same symbol shown in "Packages -> Web interfaces".

endif
```

## make/pkgs/alsaequal-cgi/Config.in
```kconfig
config FREETZ_PACKAGE_ALSAEQUAL_CGI
	bool "alsaequal CGI (equalizer config/control web UI) - DEVELOPER"
	depends on FREETZ_PACKAGE_ALSAEQUAL && FREETZ_PACKAGE_ALSA_UTILS
	depends on FREETZ_SHOW_DEVELOPER
	default y
	help
		Provides the freetz web UI pages to configure alsaequal and adjust
		the exported equalizer controls at runtime.

		Developer-only together with the underlying alsaequal package.

		http://fritz.box:81/cgi-bin/conf/alsaequal
```

## make/pkgs/alsaequal/Config.in
```kconfig
config FREETZ_PACKAGE_ALSAEQUAL
	bool "alsaequal 0.7.1 - DEVELOPER"
	depends on FREETZ_SHOW_DEVELOPER
	select FREETZ_LIB_libasound
	select FREETZ_LIB_caps
	default n
	help
		alsaequal exposes a LADSPA-based equalizer as ALSA PCM and control
		devices, so it can be configured with regular ALSA mixer tools.

		Note: on FRITZ!Box targets this package can require too much CPU for
		reliable normal use, so it remains developer-only.

		Freetz-EVO selects the CAPS LADSPA library by default so the bundled
		Eq10 module is immediately available. Another compatible LADSPA
		plugin can still be configured at runtime if desired.
```

## make/pkgs/amutorrent/Config.in
```kconfig
config FREETZ_PACKAGE_AMUTORRENT
        depends on FREETZ_USER_LEVEL_DEVELOPER
        depends on FREETZ_TARGET_GCC_13_MIN
        depends on FREETZ_OPENSSL_VERSION_30 || FREETZ_OPENSSL_VERSION_35
        bool "aMUTorrent 3.5.0 - DEVELOPER"
        default n
        help
                Experimental package, needs Node.js: installs aMUTorrent as a service
                with full Node.js, with the frontend built on the host system and the
                Express/WebSocket backend running on the target.

                The bootstrap preconfigures a local rTorrent via SCGI directly to
                127.0.0.1:${RTORRENT_SCGI_PORT:-16891} when available.

                The page http://fritz.box:81/amutorrent/ redirects to the service port
                (4000 by default) and displays a diagnostic page if the daemon is not running.

                Note: the Node.js porting on the target is not yet considered functional;
                for this reason the package remains in developer mode, disabled by default,
                and should not be considered ready for normal use.
```

## make/pkgs/aria2-cgi/Config.in
```kconfig
config FREETZ_PACKAGE_ARIA2_CGI
	bool "aria2 CGI (freetz configuration web page)"
	depends on FREETZ_PACKAGE_ARIA2
	select FREETZ_BUSYBOX_START_STOP_DAEMON
	help
		Provides a freetz web configuration page for aria2 daemon.

		Includes init script, default config and CGI script for managing
		aria2 settings via the freetz web UI (http://fritz.box:81/).
```

## make/pkgs/aria2/Config.in
```kconfig
menuconfig FREETZ_PACKAGE_ARIA2
	bool "aria2 1.37.0/AriaNg 1.3.13 (HTTP(s)/(s)FTP/Torrent/Metalink downloader)"
	default n
	select FREETZ_LIB_libcares    if !FREETZ_PACKAGE_ARIA2_STATIC && !FREETZ_PACKAGE_ARIA2_WITHOUT_ASYNC_DNS
	select FREETZ_LIB_libz        if !FREETZ_PACKAGE_ARIA2_STATIC
	select FREETZ_LIB_libpthread  if !FREETZ_PACKAGE_ARIA2_STATIC && FREETZ_TARGET_UCLIBC_HAS_multiple_libs
	select FREETZ_LIB_libm        if !FREETZ_PACKAGE_ARIA2_STATIC && FREETZ_TARGET_UCLIBC_HAS_multiple_libs
	help
		aria2 is a utility for downloading files. The supported protocols are
		HTTP(S), FTP, SFTP, BitTorrent and Metalink. aria2 can download a file
		from multiple sources/protocols and tries to utilize your maximum download
		bandwidth. It supports only a single file per request, but you can specify
		multiple URLs (even different hosts) for it. It can retrieve multiple files
		if you specify multiple files as the part of the command line. It can be
		controlled via built-in JSON-RPC and XML-RPC interface.

if FREETZ_PACKAGE_ARIA2

	config FREETZ_PACKAGE_ARIA2_WITH_OPENSSL
		bool "Use OpenSSL"
		default y
		select FREETZ_LIB_libcrypto  if !FREETZ_PACKAGE_ARIA2_STATIC
		select FREETZ_LIB_libssl     if !FREETZ_PACKAGE_ARIA2_STATIC
		help
			Build aria2 with OpenSSL support for SSL/TLS.

	config FREETZ_PACKAGE_ARIA2_WITH_GNUTLS
		bool "Use GnuTLS"
		default n
		depends on !FREETZ_PACKAGE_ARIA2_WITH_OPENSSL
		select FREETZ_LIB_libgnutls  if !FREETZ_PACKAGE_ARIA2_STATIC
		help
			Build aria2 with GnuTLS support for SSL/TLS.
			Cannot be used together with OpenSSL.

	config FREETZ_PACKAGE_ARIA2_WITH_BITTORRENT
		bool "Enable BitTorrent support"
		default y
		select FREETZ_LIB_libnettle  if !FREETZ_PACKAGE_ARIA2_STATIC && FREETZ_PACKAGE_ARIA2_WITH_BITTORRENT
		select FREETZ_LIB_libgmp     if !FREETZ_PACKAGE_ARIA2_STATIC && FREETZ_PACKAGE_ARIA2_WITH_BITTORRENT
		help
			Enable BitTorrent protocol support.

	config FREETZ_PACKAGE_ARIA2_WITH_METALINK
		bool "Enable Metalink support"
		default y
		help
			Enable Metalink support for downloading from multiple sources.

	config FREETZ_PACKAGE_ARIA2_WITH_XMLRPC
		bool "Enable XML-RPC support"
		default y
		select FREETZ_LIB_libxml2    if !FREETZ_PACKAGE_ARIA2_STATIC
		help
			Enable XML-RPC interface support.

	config FREETZ_PACKAGE_ARIA2_WITH_WEBSOCKET
		bool "Enable WebSocket support"
		default y
		help
			Enable WebSocket support for JSON-RPC interface.

	config FREETZ_PACKAGE_ARIA2_WITH_LIBSSH2
		bool "Enable SFTP/SCP support"
		default y
		select FREETZ_LIB_libssh2    if !FREETZ_PACKAGE_ARIA2_STATIC
		help
			Enable SFTP and SCP protocol support via libssh2.

	config FREETZ_PACKAGE_ARIA2_WITH_SQLITE3
		bool "Enable cookie support (Firefox3/Chromium)"
		default n
		select FREETZ_LIB_libsqlite3 if !FREETZ_PACKAGE_ARIA2_STATIC
		help
			Enable loading cookies from Firefox3/Chromium.

	config FREETZ_PACKAGE_ARIA2_WITHOUT_ASYNC_DNS
		bool "Disable async DNS (libcares)"
		default y
		help
			Disable libcares async DNS support.
			Useful if libcares is not available. Uses standard DNS resolver instead.

	config FREETZ_PACKAGE_ARIA2_STATIC
		bool "Link statically"
		default n
		help
			Build aria2 with statically linked libraries.

	config FREETZ_PACKAGE_ARIA2_CA_BUNDLE
		string "Path to CA bundle for HTTPS certificate verification"
		default "/etc/ssl/certs/ca-bundle.crt"
		depends on FREETZ_PACKAGE_ARIA2_WITH_OPENSSL || FREETZ_PACKAGE_ARIA2_WITH_GNUTLS
		help
			Path to the CA bundle file for verifying HTTPS certificates.
			Default is /etc/ssl/certs/ca-bundle.crt (standard on most Linux distributions).
			Can be overridden at runtime with --ca-certificate aria2 option.

	config FREETZ_PACKAGE_ARIA2_WITH_LIBARIA2
		bool "Build libaria2 C++ library"
		default n
		select FREETZ_LIB_libstdcpp  if !FREETZ_PACKAGE_ARIA2_STATIC
		help
			Build libaria2 C++ library for embedding aria2 in other applications.
			This provides the C++ API interface to aria2 functionality.
			Include file: <aria2/aria2.h>
			Link with: -laria2

	config FREETZ_PACKAGE_ARIA2_CGI
		bool "aria2 CGI (freetz configuration web page)"
		select FREETZ_BUSYBOX_START_STOP_DAEMON
		default y
		help
			Provides a freetz web configuration page for aria2 daemon.

			Includes init script, default config and CGI script for managing
			aria2 settings via the freetz web UI (http://fritz.box:81/).

	config FREETZ_PACKAGE_ARIANG
		bool "AriaNg 1.3.13 (Web frontend for aria2)"
		default y
		help
			AriaNg is a modern web interface for aria2. It's a pure frontend application,
			communicating with aria2 daemon via JSON-RPC interface.

			Features:
			- Modern and responsive web UI
			- Real-time task monitoring
			- Support for multiple aria2 instances
			- Download management (add, pause, resume, delete)
			- Settings configuration

			Accessed via: http://fritz.box:81/ariang/

endif # FREETZ_PACKAGE_ARIA2
```

## make/pkgs/atuin/Config.in
```kconfig
config FREETZ_PACKAGE_ATUIN
	bool "atuin 18.16.1"
	depends on FREETZ_TARGET_UCLIBC_1_0_58
	default n
	help
		atuin utility package built from source using Rust/Cargo.
		
		Requires uClibc 1.0.58 or newer (the Rust/Cargo
		cross-build is not supported on the older toolchains).
```

## make/pkgs/aurapeq/Config.in
```kconfig
config FREETZ_PACKAGE_AURAPEQ
	bool "aurapeq 1.1 (binary only)"
	select FREETZ_LIB_hidapi
	select FREETZ_LIB_libwebsockets
	default n
	help
		AuraPEQ WebSocket-HID bridge per Audiocular Aura e DAC
		USB compatibili.
		
		aura-bridged e' un demone che funge da ponte tra WebSocket
		e HID (backend libusb). Usa libwebsockets per il server
		WebSocket e hidapi per l'accesso HID.
		
		hid-list e' una utility diagnostica che elenca tutti i
		dispositivi HID USB e mostra i report supportati.
		
		Permette all'app web AuraPEQ di configurare l'equalizzatore
		parametrico (PEQ) dei DAC USB compatibili con chip
		Savitech, Moondrop, Conexant, FiiO e KT02H20.
		
		Comunica via JSON:
		  - {"cmd":"list"} — elenca dispositivi HID
		  - {"cmd":"open","vendorId":...,"productId":...}
		  - {"cmd":"send_report","reportId":...,"data":[...]}
		  - {"cmd":"send_feature_report","reportId":...,"data":[...]}
		  - {"cmd":"close"}
		
		Avvio: aura-bridged [porta]
		Porta predefinita: 9001
		
		Accesso via app web: ws://fritz.box:9001
		
		Progetto originale:
		https://github.com/mandy321/Audiocular-Aura
```

## make/pkgs/avrdude/Config.in
```kconfig
config FREETZ_PACKAGE_AVRDUDE
	bool "avrdude 8.1"
	default n
	select FREETZ_LIB_libelf
	select FREETZ_LIB_libusb
	select FREETZ_LIB_libusb1
	select FREETZ_LIB_libftdi
	select FREETZ_LIB_readline
	select FREETZ_LIB_ncurses
	help
		AVR Downloader/Uploader for Microchip AVR MCUs.
		
		Installs:
		 - avrdude: main CLI programmer
		 - elf2tag: helper tool to generate UPDI tags
		 - /etc/avrdude.conf: default device/programmer definitions
```

## make/pkgs/bandwhich/Config.in
```kconfig
config FREETZ_PACKAGE_BANDWHICH
	bool "bandwhich 0.23.1"
	depends on FREETZ_TARGET_UCLIBC_1_0_58
	default n
	help
		bandwhich utility package built from source using Rust/Cargo.
```

## make/pkgs/bat/Config.in
```kconfig
config FREETZ_PACKAGE_BAT
	bool "bat 0.26.1"
	depends on FREETZ_TARGET_UCLIBC_1_0_58
	default n
	help
		bat is a cat clone with syntax highlighting, paging, and theme support.
```
