## make/pkgs/ble2uart_gateway/Config.in
```kconfig
config FREETZ_PACKAGE_BLE2UART_GATEWAY
	bool "ble2uart_gateway 0.1 (MySensors/MQTT/Matter/InfluxDB 3/SQLite)"
	depends on FREETZ_TARGET_UCLIBC_1_0_58_MIN
	depends on FREETZ_TARGET_IPV6_SUPPORT
	select FREETZ_LIB_libpthread if FREETZ_TARGET_UCLIBC_HAS_multiple_libs
	select FREETZ_LIB_librt if FREETZ_TARGET_UCLIBC_HAS_multiple_libs
	default n
	help
		Rust gateway between an ESP32-C3 running pvvx ADV_BLE2UART
		(ble50_scan, USB CDC-ACM) and home automation front-ends.

		It implements scanner control and serial framing for that firmware
		(frame layout, INFO/SCAN/WMAC/BMAC/CLRM/PRNT/GPIO/UART/RFSDK
		command builders, CRC-16/MODBUS) and decodes/encodes the BLE advertisement
		payloads and the device configuration structures of the ATC_Mi
		interface codec (ATC1441, ATC1441-enc, Xiaomi MiBeacon-like,
		BTHome v1/v2 and the encrypted variants, AES-128-CCM with the
		per-device bind key). New formats are added by editing the
		codec specification YAML, no rebuild needed.

		Five front-ends can be enabled in the configuration file:
		  * MySensors  - TCP gateway for Domoticz (recommended: Domoticz
		    understands the protocol natively, so devices, units and
		    commands need no mapping on its side)
		  * MQTT       - complete decoded JSON state via MQTT 3.1.1,
		    QoS 1, retained state and latest-state reconnect replay
		  * Matter     - read-only standard sensor clusters plus a vendor
		    cluster containing complete decoded JSON in byte chunks;
		    proprietary values require a controller that understands it
		    (rs-matter, development attestation credentials)
		  * InfluxDB 3 - decoded measurements as line protocol through the
		    v3 write API, bounded in-memory batches, optional token over
		    HTTPS (plain HTTP tokens only on loopback)
		  * SQLite     - local frame and typed measurement history, atomic
		    batches and WAL for concurrent readers; no separate server.
		    Choose an existing directory on local external storage.

		Configuration: /mod/etc/conf/ble2uart_gateway.cfg (service) plus one
		structured YAML store (serial port, devices with MAC and bind
		key, filters, derived rules, front-ends) that the web interface
		edits and the daemon validates.

                Two web interfaces, both behind the standard freetz login:
                  * /cgi-bin/conf/ble2uart_gateway       configuration editor
                  * /cgi-bin/extra/ble2uart_gateway/portal   read-only dashboard
                    with the latest value of every sensor and its charts; the
                    sensors, units and value types are read from the SQLite
                    database, nothing is hard-coded

config FREETZ_PACKAGE_BLE2UART_GATEWAY_THEENGS
	bool "  Second decoder: Theengs Decoder (GPL-3.0-or-later)"
	depends on FREETZ_PACKAGE_BLE2UART_GATEWAY
	default n
	help
		Link the Theengs Decoder C++ library as a static library, so a
		device can be decoded with `decoder: theengs` (that library only)
		or `decoder: both` (both attribute sets, the Theengs ones
		prefixed with theengs_) in the YAML configuration.

		The library supports more than 140 devices, including formats
		this gateway does not know, but it cannot decrypt bindkey
		advertisements: encrypted devices keep working with the built-in
		codec. It is licensed GPL-3.0-or-later, so the daemon binary
		built with this option has to be distributed under GPL-3.0; the
		option is off by default to keep the default build EUPL-1.2.

		Costs measured on a 7590 AX: about 0.5 MB of flash (libstdc++
		is linked statically) and 0.7-25 ms per advertisement (the worst
		case is an advertisement no decoder matches), 192 kB of RAM.
		The sources are pinned by revision and checksum and downloaded by
		`make ble2uart_gateway-download`.
```

## make/pkgs/bottom/Config.in
```kconfig
config FREETZ_PACKAGE_BOTTOM
	bool "bottom 0.12.3"
	depends on FREETZ_TARGET_UCLIBC_1_0_58
	default n
	help
		bottom utility package built from source using Rust/Cargo.
```

## make/pkgs/broot/Config.in
```kconfig
config FREETZ_PACKAGE_BROOT
	bool "broot 1.56.4"
	depends on FREETZ_TARGET_UCLIBC_1_0_58_MIN
	default n
	help
		broot utility package built from source using Rust/Cargo.
```

## make/pkgs/btop/Config.in
```kconfig
config FREETZ_PACKAGE_BTOP
	bool "btop 1.4.7"
	depends on FREETZ_TARGET_GCC_13_MIN  # upstream requires C++23
	select FREETZ_STDCXXLIB_FORCE_GNULIBSTDCXX
	select FREETZ_LIB_STDCXXLIB
	select FREETZ_LIB_libpthread  if FREETZ_TARGET_UCLIBC_HAS_multiple_libs
	select FREETZ_LIB_libm        if FREETZ_TARGET_UCLIBC_HAS_multiple_libs
	default n
	help
		btop is a modern terminal resource monitor for Linux.
		
		This package installs the btop binary and can optionally install
		upstream themes.
		
		Can be externalized to save flash memory.

if FREETZ_PACKAGE_BTOP

	config FREETZ_PACKAGE_BTOP_THEMES
		bool "Install upstream themes"
		default n
		help
			Install all upstream btop themes to /usr/share/btop/themes/.
			
			Useful if you want to switch themes at runtime without manually
			copying them to the box.

endif # FREETZ_PACKAGE_BTOP
```

## make/pkgs/caddy/Config.in
```kconfig
config FREETZ_PACKAGE_CADDY
	bool "caddy 2.11.2 (binary only)"
	default n
	help
		Caddy is a general-purpose web server with automatic HTTPS.

		This package cross-compiles the upstream Go sources and installs the
		caddy executable on the target.

		Can be externalized to save flash memory.
```

## make/pkgs/caps-ladspa/Config.in
```kconfig
config FREETZ_PACKAGE_CAPS_LADSPA
	bool
	help
		Internal helper package that deploys the CAPS LADSPA runtime files
		from staging into the final image without requiring fwmod special
		handling.
```

## make/pkgs/clonezilla/Config.in
```kconfig
config FREETZ_PACKAGE_CLONEZILLA
	bool "clonezilla 5.15.23 (script bundle)"
	depends on FREETZ_PACKAGE_BASH && !FREETZ_PACKAGE_BASH_MINIMAL
	depends on FREETZ_TARGET_UCLIBC_1_0_58
	select FREETZ_BUSYBOX_DD
	select FREETZ_PACKAGE_DIALOG
	select FREETZ_UTIL_LINUX_MOUNTPOINT
	select FREETZ_PACKAGE_PARTCLONE
	select FREETZ_PACKAGE_UDPCAST
	select FREETZ_PACKAGE_DDRESCUE
	select FREETZ_PACKAGE_FSARCHIVER
	select FREETZ_PACKAGE_NTFS
	select FREETZ_PACKAGE_NTFS_TOOLS
	select FREETZ_PACKAGE_NTFS_ntfsclone
	default n
	help
		Clonezilla script bundle for disk/partition cloning workflows.
		This package installs DRBL/Clonezilla scripts under /usr/share/drbl
		and wrappers in /usr/sbin (clonezilla, ocs-sr, ocs-onthefly).
		
		Requires uClibc 1.0.58 or newer (depends on fsarchiver and
		partclone, which need libblkid from util-linux 2.41).
```

## make/pkgs/cmus/Config.in
```kconfig
config FREETZ_PACKAGE_CMUS
	bool "cmus 2.11.0"
	depends on FREETZ_TARGET_GCC_4_8_MIN
	select FREETZ_LIB_libasound
	select FREETZ_LIB_libatomic
	select FREETZ_LIB_libncursesw
	select FREETZ_LIB_libmad
	select FREETZ_LIB_libFLAC
	select FREETZ_LIB_libvorbisfile
	select FREETZ_MODULE_snd_usb_audio if FREETZ_MODULES_AUDIO_AVAILABLE
	default n
	help
		cmus is a small and fast ncurses music player.
		This build enables ALSA output together with MP3, FLAC and Vorbis
		playback support.
```
