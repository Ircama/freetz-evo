## make/libs/libXpm/Config.in
```kconfig
config FREETZ_LIB_libXpm
	bool "libXpm 3.5.19 (X11 Pixmap)"
	select FREETZ_LIB_libX11
	default n
	help
		X11 pixmap library.
```

## make/libs/libXt/Config.in
```kconfig
config FREETZ_LIB_libXt
	bool "libXt (X11 Toolkit Intrinsics)"
	select FREETZ_LIB_libxorgproto
	select FREETZ_LIB_libX11
	select FREETZ_LIB_libSM
	select FREETZ_LIB_libICE
	default n
	help
		X11 Toolkit Intrinsics library (libXt.so).
		Required by Tk toolkit for widget framework.
		Website: https://www.x.org/
```

## make/libs/libarchive/Config.in
```kconfig
config FREETZ_LIB_libarchive
	bool "libarchive (libarchive.so)"
	default n
	help
		Multi-format archive and compression library used by tools
		like lnav to inspect compressed and archived log files.
```

## make/libs/libcares/Config.in
```kconfig
config FREETZ_LIB_libcares
	bool "libcares 1.28.1 (Async DNS resolver library)"
	default n
	help
		c-ares is a C library that performs DNS requests and name lookups
		asynchronously. It is intended for applications which need to perform
		DNS queries without blocking, or need to perform multiple DNS queries
		in parallel.

		This library is used by various download managers and networking tools
		for asynchronous DNS resolution.
```

## make/libs/libcoap/Config.in
```kconfig
config FREETZ_LIB_libcoap
	bool "libcoap (CoAP and CoAPs/DTLS implementation)"
	default n
	help
		libcoap is a C implementation of a lightweight application-protocol for
		devices that are constrained by their resources (RFC 7252, CoAP) with
		the secure DTLS variants (CoAPs, RFC 6347/7925).

		The package installs the shared library, the headers, the pkg-config
		file and the command line tools `coap-client-openssl`,
		`coap-server-openssl` and `coap-rd-openssl` (plus the plain
		`coap-client` alias) that talk CoAP and CoAPs/DTLS.

		It provides the CoAP primitives for Python bindings and scripts; the
		`coapcmd` helper of the IKEA TRADFRI tooling is a different program
		written in Go and is not provided here.

		https://libcoap.net/
```

## make/libs/libebml/Config.in
```kconfig
config FREETZ_LIB_libebml
	bool "libebml (EBML parser library)"
	depends on FREETZ_TARGET_UCLIBC_1_0_58_MIN
	default n
	help
		libebml is a C++ library for parsing EBML (Extensible Binary
		Markup Language) data, used as the foundation for Matroska
		container format.

		Requires uClibc 1.0.58 or newer (libebml 1.4.5 sets
		CMAKE_CXX_STANDARD 14 in CMakeLists.txt, which the old GCC
		4.6.4 toolchain does not support).
		
		https://github.com/Matroska-Org/libebml
```

## make/libs/libffmpegthumbnailer/Config.in
```kconfig
config FREETZ_LIB_libffmpegthumbnailer
	bool "libffmpegthumbnailer (video thumbnail generator)"
	depends on FREETZ_TARGET_UCLIBC_1_0_58
	select FREETZ_LIB_libavcodec
	select FREETZ_LIB_libavformat
	select FREETZ_LIB_libavutil
	select FREETZ_LIB_libswscale
	default n
	help
		libffmpegthumbnailer is a library for generating thumbnail
		images from video files, using FFmpeg for decoding.
		
		Requires uClibc 1.0.58 or newer (it uses C++11
		std::to_string/std::stoi, which older uClibc toolchains do
		not provide).
		
		https://github.com/dirkvdb/ffmpegthumbnailer
```

## make/libs/libfmt/Config.in
```kconfig
config FREETZ_LIB_libfmt
	bool "fmt (C++ formatting library)"
	depends on FREETZ_TARGET_UCLIBC_1_0_58_MIN
	default n
	help
		libfmt is a modern C++ formatting library providing
		a fast and safe alternative to C stdio and C++ iostreams.
		
		Required by spdlog and Gerbera.
		
		Requires uClibc 1.0.58 or newer (it needs a recent C++
		compiler, not available on the older toolchains).
		
		https://fmt.dev/
```

## make/libs/libixml/Config.in
```kconfig
config FREETZ_LIB_libixml
	bool "libixml (XML parser library, part of libupnp)"
	depends on FREETZ_TARGET_UCLIBC_1_0_58_MIN
	default y if FREETZ_LIB_libupnp
	help
		libixml is a lightweight XML parser library, part of the libupnp SDK.
		Required by Gerbera and other UPnP applications.

		Requires uClibc 1.0.58 or newer (built from the same source
		as libupnp, which needs C++14; see libupnp).
```

## make/libs/liblastfm/Config.in
```kconfig
config FREETZ_LIB_liblastfm
	bool "liblastfm (Last.fm API client)"
	depends on BROKEN
	default n
	help
		liblastfm is a C++ library for the Last.fm webservices API.
		NOTE: This library requires Qt (QtCore + QtNetwork), which is
		not available in the freetz cross-compilation toolchain.
		Packaging this is currently not feasible.
		
		https://github.com/lastfm/liblastfm
```

## make/libs/libmagic/Config.in
```kconfig
config FREETZ_LIB_libmagic
	bool "libmagic (file type identification)"
	select FREETZ_LIB_libz
	default n
	help
		libmagic is the library component of the file(1) command,
		providing file type identification based on magic numbers.
		
		https://www.darwinsys.com/file/
```

## make/libs/libmatroska/Config.in
```kconfig
config FREETZ_LIB_libmatroska
	bool "libmatroska (Matroska container library)"
	depends on FREETZ_TARGET_UCLIBC_1_0_58_MIN
	select FREETZ_LIB_libebml
	default n
	help
		libmatroska is a C++ library for handling Matroska container
		formats (MKV, MKA, MKS).

		Requires uClibc 1.0.58 or newer (libmatroska 1.7.1 sets
		CMAKE_CXX_STANDARD 14 in CMakeLists.txt, which the old GCC
		4.6.4 toolchain does not support). Also depends on libebml,
		which has the same requirement.
```

## make/libs/libmicrohttpd/Config.in
```kconfig
config FREETZ_LIB_libmicrohttpd
	bool "libmicrohttpd (GNU libmicrohttpd - embedded HTTP server)"
	default n
	help
		GNU libmicrohttpd is a small C library that provides an HTTP server
		as part of a C library, making it easy to embed HTTP server
		functionality into applications.
		
		Required by libnpupnp (NPUPnP library).
		
		https://www.gnu.org/software/libmicrohttpd/
```

## make/libs/libmpdclient/Config.in
```kconfig
config FREETZ_LIB_libmpdclient
	bool "libmpdclient (libmpdclient.so)"
	default n
	help
		libmpdclient is the official client library for Music Player Daemon.
		It is used by CLI and UI clients which connect to a local or remote
		MPD instance.
```

## make/libs/libnfs/Config.in
```kconfig
config FREETZ_LIB_libnfs
	bool "libnfs (libnfs.so)"
	default n
	help
		libnfs is a client library for accessing NFS shares.
```

## make/libs/libnl/Config.in
```kconfig
config FREETZ_LIB_libnl
	bool "libnl (libnl-3, libnl-cli-3, libnl-genl-3, libnl-route-3)"
	default n
	select FREETZ_LIB_libdl      if FREETZ_TARGET_UCLIBC_HAS_multiple_libs
	select FREETZ_LIB_libpthread if FREETZ_TARGET_UCLIBC_HAS_multiple_libs
	help
		libnl is a collection of libraries providing APIs to netlink protocol
		based Linux kernel interfaces.
```

## make/libs/libnpupnp/Config.in
```kconfig
config FREETZ_LIB_libnpupnp
	bool "libnpupnp (NPUPnP - modern UPnP library)"
	depends on FREETZ_TARGET_UCLIBC_1_0_58_MIN
	select FREETZ_LIB_libcurl
	select FREETZ_LIB_libmicrohttpd
	default n
	help
		libnpupnp is a new generation UPnP library based on libupnp,
		providing better performance and modern TLS support.
		
		Requires uClibc 1.0.58 or newer (it uses C++17
		std::scoped_lock, not supported by the older toolchains).
		
		https://www.lesbonscomptes.com/upmpdcli/pages/downloads.html
```

## make/libs/libsamplerate/Config.in
```kconfig
config FREETZ_LIB_libsamplerate
	bool "libsamplerate (libsamplerate.so)"
	default n
	help
		Secret Rabbit Code (libsamplerate) is a sample-rate conversion library.
```

## make/libs/libshout/Config.in
```kconfig
config FREETZ_LIB_libshout
	bool "libshout (libshout.so)"
	select FREETZ_LIB_libtheora
	default n
	help
		libshout is a library for communicating with Icecast servers.
```

## make/libs/libsndfile/Config.in
```kconfig
config FREETZ_LIB_libsndfile
	bool "libsndfile (libsndfile.so)"
	default n
	help
		libsndfile is a C library for reading and writing sampled audio data.
```

## make/libs/libsodium/Config.in
```kconfig
config FREETZ_LIB_libsodium
	bool "libsodium (libsodium.so)"
	default n
	help
		NaCl-compatible crypto library.
```

## make/libs/libtheora/Config.in
```kconfig
config FREETZ_LIB_libtheora
	bool "libtheora (libtheora.so)"
	default n
	help
		libtheora is a video codec library for the Theora format.
```

## make/libs/libunistring/Config.in
```kconfig
config FREETZ_LIB_libunistring
	bool "libunistring (libunistring.so)"
	default n
	help
		Unicode string library required by lnav.
```

## make/libs/libupnp/Config.in
```kconfig
config FREETZ_LIB_libupnp
	bool "libupnp (portable UPnP SDK)"
	depends on FREETZ_TARGET_UCLIBC_1_0_58_MIN
	select FREETZ_LIB_libuuid
	default n
	help
		libupnp is the open-source IGD UPnP library (pupnp).
		Required by Gerbera and other UPnP media servers.

		Requires uClibc 1.0.58 or newer (libupnp 1.14.31 sets
		CMAKE_CXX_STANDARD 14 in CMakeLists.txt, which the old GCC
		4.6.4 toolchain does not support).
		
		https://pupnp.github.io/pupnp/
```

## make/libs/libuv/Config.in
```kconfig
config FREETZ_LIB_libuv
	bool "libuv (libuv.so)"
	depends on FREETZ_TARGET_GCC_5_MIN
	depends on FREETZ_TARGET_UCLIBC_1_0_58_MIN
	select FREETZ_LIB_libm if FREETZ_TARGET_UCLIBC_HAS_multiple_libs
	default n
	help
		libuv is a async IO library for various programs

		Requires uClibc 1.0.58 or newer: on GCC <= 5 toolchains
		(uClibc 0.9.x-1.0.14) libuv 1.44.2 is built, which uses
		pthread_atfork. uClibc only provides pthread_atfork as a
		hidden static-only symbol, so any program linking libuv.so
		fails with "undefined reference to pthread_atfork". On
		uClibc 1.0.58+ (GCC > 5) libuv 1.52.1 is used, which no
		longer calls pthread_atfork.
```
