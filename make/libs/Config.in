## make/libs/Config.in
```kconfig
menu "Apache Portable Runtime libs"
	source "make/libs/apr/Config.in"
	source "make/libs/apr-util/Config.in"
endmenu ### "Apache Portable Runtime libs"

menu "Avahi libraries"
	source "make/pkgs/avahi/Config.in.libs"
endmenu ### "Avahi libraries"

menu "Charsets & Internationalization"
	source "make/pkgs/iconv/Config.in.libs"
	source "make/libs/gettext/Config.in"
	source "make/libs/fribidi/Config.in"
	source "make/libs/utf8proc/Config.in"
endmenu ### "Charsets & Internationalization"

menu "Crypto & SSL"
	comment "GnuPG ----------------------------------"
		source "make/libs/libgpg-error/Config.in"
		source "make/libs/libgcrypt/Config.in"
	comment "GnuTLS ---------------------------------"
		source "make/pkgs/gnutls/Config.in.libs"
		source "make/libs/libtasn1/Config.in"
	comment "mbed TLS -------------------------------"
		source "make/libs/mbedtls/Config.in"
	comment "Nettle ---------------------------------"
		source "make/libs/nettle/Config.in"
	comment "OpenSSL --------------------------------"
		source "make/pkgs/openssl/Config.in.libs"
		source "make/libs/libavmhmac/Config.in"
	comment "PolarSSL -------------------------------"
		source "make/libs/polarssl12/Config.in"
		source "make/libs/polarssl13/Config.in"
	comment "Misc -----------------------------------"
		source "make/libs/gsasl/Config.in"
		source "make/libs/libsodium/Config.in"
		source "make/libs/libssh2/Config.in"
endmenu ### "Crypto & SSL"

menu "Data compression"
	source "make/pkgs/bzip2/Config.in.libs"
	source "make/libs/libarchive/Config.in"
	source "make/libs/libdeflate/Config.in"
	source "make/libs/lz4/Config.in"
	source "make/libs/lzo/Config.in"
	source "make/pkgs/xz/Config.in.libs"
	source "make/libs/zlib/Config.in"
endmenu ### "Data compression"

menu "Database"
	source "make/libs/db/Config.in"
	source "make/libs/libmaxminddb/Config.in"
	source "make/libs/lmdb/Config.in"
	source "make/libs/tinycdb/Config.in"
	source "make/pkgs/postgresql/Config.in.libs"
	source "make/pkgs/unixodbc/Config.in.libs"
	source "make/pkgs/sqlite/Config.in.libs"
	source "make/pkgs/rrdtool/Config.in.libs"
endmenu ### "Database"

menu "File systems"
	source "make/pkgs/util-linux/Config.in.libs"
	source "make/pkgs/e2fsprogs/Config.in.libs"
	source "make/pkgs/fuse/Config.in.libs"
	source "make/pkgs/ntfs/Config.in.libs"
endmenu ### "File systems"

menu "Freetz"
	source "make/libs/libctlmgr/Config.in"
	source "make/libs/libmultid/Config.in"
endmenu ### "Freetz"

menu "GCC"
	source "make/libs/libatomic/Config.in"
	source "make/libs/libgcc_s/Config.in"
	source "make/libs/libstdcxx/Config.in"
endmenu ### "GCC"

menu "Graphics & fonts"
	source "make/libs/cairo/Config.in"
	source "make/pkgs/fontconfig/Config.in.libs"
	source "make/libs/freetype/Config.in"
	source "make/libs/harfbuzz/Config.in"
	source "make/libs/libart_lgpl/Config.in"
	source "make/libs/libexif/Config.in"
	source "make/libs/jpeg/Config.in"
	source "make/libs/leptonica/Config.in"
	source "make/libs/libpng/Config.in"
	source "make/libs/libgd/Config.in"
	source "make/libs/openjpeg/Config.in"
	source "make/libs/openjp2/Config.in"
	source "make/libs/pango/Config.in"
	source "make/libs/pixman/Config.in"
	source "make/pkgs/tesseract/Config.in.libs"
	source "make/pkgs/tiff/Config.in.libs"
	source "make/pkgs/netpbm/Config.in.libs"
endmenu ### "Graphics & fonts"

menu "libc"
	source "make/libs/glib2/Config.in"
	source "make/libs/uclibc/Config.in"
	source "make/libs/uclibcxx/Config.in"
endmenu ### "libc"

menu "Memory allocators"
	source "make/libs/gperftools/Config.in"
	source "make/libs/jemalloc/Config.in"
endmenu ### "Memory allocators"

menu "Multi precision arithmetic libs"
	source "make/libs/gmp/Config.in"
	source "make/libs/mpfr/Config.in"
	source "make/libs/mpc/Config.in"
	source "make/libs/openlibm/Config.in"
endmenu ### "Multi precision arithmetic libs"

menu "Multimedia"
	menu "Audio I/O"
		source "make/libs/alsa-lib/Config.in"
		source "make/libs/caps/Config.in"
	endmenu
	source "make/libs/libdvbcsa/Config.in"
	source "make/libs/libmpdclient/Config.in"
	menu "Audio and video codecs"
		menu "Audio codecs"
			source "make/libs/flac/Config.in"
			source "make/libs/libmad/Config.in"
			source "make/libs/libogg/Config.in"
			source "make/libs/opus/Config.in"
			source "make/libs/speex/Config.in"
		endmenu
		source "make/pkgs/ffmpeg/Config.in.libs"
		menu "Video codecs"
			comment "Vorbis video codec ---------------------"
			source "make/libs/libvorbis/Config.in"
		endmenu
	endmenu ## "Audio and video codecs"
	menu "ID3 tag reading libs"
		source "make/libs/libid3tag/Config.in"
		source "make/libs/taglib/Config.in"
	endmenu ## "ID3 tag reading libs"
	menu "Media analysis libraries"
		source "make/libs/libzen/Config.in"
		source "make/pkgs/mediainfo/Config.in.libs"
	endmenu ## "Media analysis libraries"
endmenu ### "Multimedia"

menu "Networking"
	comment "ATM ------------------------------------"
		source "make/libs/linux-atm/Config.in"
	comment "Bluetooth ------------------------------"
		source "make/libs/bluez-libs/Config.in"
		source "make/libs/openobex/Config.in"
	comment "ISDN & CAPI ----------------------------"
		source "make/libs/libcapi/Config.in"
	comment "Misc networking ------------------------"
		source "make/libs/libcares/Config.in"
		source "make/libs/libdnet/Config.in"
		source "make/libs/libgsm/Config.in"
		source "make/libs/iksemel/Config.in"
		source "make/libs/krb5/Config.in"
		source "make/libs/ldns/Config.in"
		source "make/pkgs/openldap/Config.in.libs"
		source "make/libs/libmnl/Config.in"
		source "make/libs/libnl/Config.in"
		source "make/libs/libnet/Config.in"
		source "make/libs/libzmq/Config.in"
		source "make/libs/liboping/Config.in"
		source "make/libs/libosip2/Config.in"
		source "make/libs/libpcap/Config.in"
		source "make/pkgs/unbound/Config.in.libs"
		source "make/libs/spandsp/Config.in"
		source "make/libs/srtp/Config.in"
		source "make/libs/libtirpc/Config.in"
		source "make/libs/udns/Config.in"
endmenu ### "Networking"

menu "PJ Project"
	source "make/libs/pjproject2/Config.in"
endmenu ### "PJ Project"

menu "Regular expressions"
	source "make/libs/libonig/Config.in"
	source "make/libs/pcre/Config.in"
	source "make/libs/pcre2/Config.in"
endmenu ### "Regular expressions"

menu "Terminal"
	source "make/libs/readline/Config.in"
menu "ncurses"
	source "make/libs/ncurses/Config.in"
	source "make/libs/ncursesw/Config.in"
endmenu ### "ncurses"
endmenu ### "Terminal"

menu "USB & related"
	source "make/libs/libftdi/Config.in"
	source "make/pkgs/ftdi1/Config.in.libs"
	source "make/pkgs/pcsc-lite/Config.in.libs"
	source "make/libs/libusb0/Config.in"
	source "make/libs/libusb1/Config.in"
endmenu ### "USB & related"

menu "Web and WebDAV"
	source "make/pkgs/aria2/Config.in.libs"
	source "make/pkgs/curl/Config.in.libs"
	source "make/libs/libidn/Config.in"
	source "make/libs/jansson/Config.in"
	source "make/libs/json-c/Config.in"
	source "make/pkgs/js/Config.in.libs"
	source "make/libs/libwebsockets/Config.in"
	source "make/pkgs/lua/Config.in.libs"
	source "make/libs/neon/Config.in"
	source "make/pkgs/psl/Config.in.libs"
	source "make/libs/serf/Config.in"
endmenu ### "Web and WebDAV"

menu "XML & XSLT"
	source "make/libs/expat/Config.in"
	source "make/libs/libxml2/Config.in"
	source "make/libs/xmlrpc/Config.in"
	source "make/pkgs/xsltproc/Config.in.libs"
endmenu ### "XML & XSLT"

comment " ---"

menu "Other"
	source "make/libs/attr/Config.in"
	source "make/pkgs/bind/Config.in.libs"
	source "make/pkgs/binutils-tools/Config.in.libs"
	source "make/libs/libcap/Config.in"
	source "make/libs/libcap-ng/Config.in"
	source "make/libs/libconfig/Config.in"
	source "make/libs/libcjson/Config.in"
	source "make/libs/libconfuse/Config.in"
	source "make/libs/libdaemon/Config.in"
	source "make/pkgs/dbus/Config.in.libs"
	source "make/libs/devmapper/Config.in"
	source "make/libs/libelf/Config.in"
	source "make/libs/libev/Config.in"
	source "make/libs/libevent/Config.in"
	source "make/libs/libffi/Config.in"
	source "make/libs/libnfsidmap/Config.in"
	source "make/libs/popt/Config.in"
	source "make/pkgs/privatekeypassword/Config.in.libs"
	source "make/libs/protobuf-c/Config.in"
	source "make/pkgs/python/Config.in.libs"
	source "make/pkgs/python3/Config.in.libs"
	source "make/pkgs/slang/Config.in.libs"
	source "make/libs/libsynce/Config.in"
	source "make/libs/sysfsutils/Config.in"
	source "make/libs/libtool/Config.in"
	source "make/libs/liburcu/Config.in"
	source "make/libs/libuv/Config.in"
	source "make/libs/yaml-cpp/Config.in"
	source "make/libs/yaml/Config.in"
endmenu ### "Other"

menu "X11 graphics"
	source "make/libs/util-macros/Config.in"
	source "make/libs/xorgproto/Config.in"
	source "make/libs/xcb-proto/Config.in"
	source "make/libs/xtrans/Config.in"
	source "make/libs/libXau/Config.in"
	source "make/libs/libxcb/Config.in"
	source "make/libs/libX11/Config.in"
	source "make/libs/libXext/Config.in"
	source "make/libs/libICE/Config.in"
	source "make/libs/libSM/Config.in"
	source "make/libs/libXt/Config.in"
	source "make/libs/libXmu/Config.in"
	source "make/libs/libXpm/Config.in"
	source "make/libs/libXaw/Config.in"
	source "make/libs/libXfixes/Config.in"
	source "make/libs/libXi/Config.in"
	source "make/libs/tcl/Config.in"
	source "make/libs/tk/Config.in"
endmenu ### "X11 graphics"
```

## make/libs/alsa-lib/Config.in
```kconfig
config FREETZ_LIB_libasound
	bool "alsa-lib (libasound.so)"
	select FREETZ_LIB_libdl if FREETZ_TARGET_UCLIBC_HAS_multiple_libs
	select FREETZ_LIB_libm if FREETZ_TARGET_UCLIBC_HAS_multiple_libs
	select FREETZ_LIB_libspeex
	default n
	help
		ALSA user-space library for audio playback and mixer/control access.
		Installs libasound together with the required ALSA runtime modules
		and configuration files.

config FREETZ_LIB_libasound_WITH_SAMPLERATE
	bool "samplerate rate converter plugin (libsamplerate)"
	depends on FREETZ_LIB_libasound
	select FREETZ_LIB_libsamplerate
	default y
	help
		Provides libasound_module_rate_samplerate.so via alsa-plugins.
		Uses libsamplerate (Secret Rabbit Code) for high-quality
		sample rate conversion.

config FREETZ_LIB_libasound_WITH_SPEEXRATE
	bool "speexrate rate converter plugin (built-in speex resampler)"
	depends on FREETZ_LIB_libasound
	default y
	help
		Provides libasound_module_rate_speexrate.so via alsa-plugins.
		Uses the built-in speex resampler (Public Parrot Hack).
		No external library dependency needed.

config FREETZ_LIB_libasound_WITH_LAVRATE
	bool "lavrate rate converter plugin (ffmpeg/libswresample)"
	depends on FREETZ_LIB_libasound
	select FREETZ_LIB_libswresample
	default y
	help
		Provides libasound_module_rate_lavrate.so via alsa-plugins.
		Uses ffmpeg/libswresample for sample rate conversion.

config FREETZ_LIB_libasound_DEFAULT_PCM_PLUGHW
	bool "pcm.default = pcm.plughw (bypass mixer, use hw-native rates)"
	depends on FREETZ_LIB_libasound
	default y
	help
		Sets the default ALSA PCM device to "plughw" instead of
		"cards.pcm.default". This bypasses the ALSA mixer and uses
		the sound card's native sample rates directly, avoiding
		CPU-heavy sample rate conversion on soft-float MIPS.
		If disabled, the standard "cards.pcm.default" is used.
```

## make/libs/boost/Config.in
```kconfig
config FREETZ_LIB_libboost_thread
	bool "boost (headers, libboost_thread, libboost_system)"
	depends on FREETZ_TARGET_UCLIBC_1_0_58_MIN
	default n
	select FREETZ_LIB_libboost_system
	help
		Boost 1.87.0 C++ libraries, cross-built with b2 exactly like the Boost
		copy bundled in this tree by the pdns-recursor package.

		Installs the complete Boost header tree below /usr/include/boost plus:
		  - libboost_thread.so (Boost.Thread, requires nptl pthreads)
		  - libboost_system.so (Boost.System)

		A minimal CMake package config is installed into the staging prefix as
		well, because CMake 4.x no longer ships the FindBoost module. CMake
		based consumers therefore use:

		  find_package(Boost CONFIG REQUIRED COMPONENTS thread)

		Required by the Domoticz package (Boost.Asio, Boost.Signals2 and
		Boost.Thread are used throughout its source).

config FREETZ_LIB_libboost_system
	bool
	default n
	select FREETZ_LIB_libpthread if FREETZ_TARGET_UCLIBC_HAS_multiple_libs
	help
		Boost.System shared library.

		boost::system is header-only since Boost 1.69, so this library is only
		needed by consumers that link it explicitly. It is selected
		automatically together with libboost_thread.

		The whole header tree and both libraries are provided by the single
		"boost" package.
```

## make/libs/caps/Config.in
```kconfig
config FREETZ_LIB_caps
	bool "CAPS LADSPA plugins (caps.so)"
	select FREETZ_PACKAGE_CAPS_LADSPA
	select FREETZ_LIB_STDCXXLIB
	select FREETZ_LIB_libm if FREETZ_TARGET_UCLIBC_HAS_multiple_libs
	default n
	help
		CAPS is the C* Audio Plugin Suite for LADSPA hosts.
		It provides the caps.so plugin library, including the Eq10 module
		commonly used by alsaequal.
```

## make/libs/duktape/Config.in
```kconfig
config FREETZ_LIB_libduktape
	bool "duktape (Embedded JavaScript engine)"
	default n
	help
		Duktape is a small, portable, embeddable JavaScript engine,
		written in C. It implements ES5/E5.1 with some features
		from ES2015+.
		
		Required by Gerbera for JavaScript scripting support.
		
		https://duktape.org/
```

## make/libs/exiv2/Config.in
```kconfig
config FREETZ_LIB_libexiv2
	bool "exiv2 (image metadata library)"
	depends on FREETZ_TARGET_UCLIBC_1_0_58_MIN
	select FREETZ_LIB_libexpat
	select FREETZ_LIB_libz
	default n
	help
		Exiv2 is a C++ library for reading and writing image metadata,
		supporting Exif, IPTC, XMP, ICC profiles and more.
		
		Requires uClibc 1.0.58 or newer (older uClibc versions fail to
		compile exiv2 0.28.x due to -Werror=sign-compare warnings).
		
		https://exiv2.org/
```

## make/libs/faad2/Config.in
```kconfig
config FREETZ_LIB_libfaad2
	bool "FAAD2 (libfaad2.so)"
	default n
	help
		FAAD2 is a HE-AAC/AAC audio decoder library.
```

## make/libs/fluidsynth/Config.in
```kconfig
config FREETZ_LIB_libfluidsynth
	bool "fluidsynth (libfluidsynth.so)"
	select FREETZ_LIB_libgthread_2
	select FREETZ_LIB_libsndfile
	default n
	help
		FluidSynth is a real-time software synthesizer library.
```

## make/libs/gperftools/Config.in
```kconfig
config FREETZ_LIB_libtcmalloc_minimal
	bool "libtcmalloc_minimal (libtcmalloc_minimal.so)"
	default n
	help
		TCMalloc (Thread-Caching Malloc) from Google's gperftools.
		A high-performance, thread-safe drop-in replacement for malloc that
		is significantly faster than glibc malloc, especially for multi-threaded
		programs.

		This is the minimal variant without heap profiling or checking support,
		suitable for embedded targets.

		https://gperftools.github.io/gperftools/tcmalloc.html

config FREETZ_LIB_libprofiler
	bool "libprofiler (libprofiler.so)"
	default n
	select FREETZ_LIB_libtcmalloc_minimal
	help
		CPU profiler from Google's gperftools. Allows profiling CPU usage of
		programs at runtime by setting the CPUPROFILE environment variable.

		https://gperftools.github.io/gperftools/cpuprofile.html
```
