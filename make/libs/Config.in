## make/libs/hidapi/Config.in
```kconfig
config FREETZ_LIB_hidapi
	bool "hidapi (libhidapi-libusb.so)"
	select FREETZ_LIB_libpthread if FREETZ_TARGET_UCLIBC_HAS_multiple_libs
	select FREETZ_LIB_libusb1
	default n
	help
		HIDAPI is a multi-platform library enabling applications to easily
		interface with Bluetooth and USB HID-class devices.

		This builds the libusb backend (libhidapi-libusb), which uses
		the Linux kernel's usbfs interface directly and does NOT require
		the kernel HID/INPUT subsystem (not available on GRX5 devices).

if FREETZ_LIB_hidapi

config FREETZ_LIB_hidapi_hidraw
	bool "libhidapi-hidraw.so (hidraw backend)"
	depends on FREETZ_AVM_HAS_INPUT_BUILTIN || FREETZ_AVM_HAS_INPUT_MODULE || FREETZ_REPLACE_KERNEL
	select FREETZ_MODULE_hid if !FREETZ_AVM_HAS_HID_BUILTIN && !FREETZ_AVM_HAS_HID_MODULE
	select FREETZ_MODULE_hid_generic if !FREETZ_AVM_HAS_HID_GENERIC_BUILTIN && !FREETZ_AVM_HAS_HID_GENERIC_MODULE
	select FREETZ_MODULE_usbhid if !FREETZ_AVM_HAS_USB_HID_BUILTIN && !FREETZ_AVM_HAS_USB_HID_MODULE
	default n
	help
		Also build the hidraw backend (libhidapi-hidraw), which talks
		directly to the kernel's hidraw interface.
		
		Required kernel modules (hid.ko, hid-generic.ko, usbhid.ko)
		are auto-selected when not already provided by the AVM baseline.
		
		Note: NOT compatible with GRX5 devices (e.g. 7590AX) because the
		AVM kernel lacks CONFIG_INPUT — hid.ko cannot load (unknown symbol
		input_allocate_device). Use the libusb backend instead.

endif
```

## make/libs/icu/Config.in
```kconfig
config FREETZ_LIB_libicu
	bool "ICU (International Components for Unicode)"
	depends on FREETZ_TARGET_UCLIBC_1_0_58_MIN
	select FREETZ_LIB_STDCXXLIB
	select FREETZ_LIB_STDCXXLIB_WITH_WCHAR
	default n
	help
		ICU is a mature, widely used set of C/C++ and Java libraries
		providing Unicode and Globalization support for software applications.
		WARNING: ICU is very large (~30MB source, hundreds of MB compiled).
		
		Requires uClibc 1.0.58 or newer (ICU 76.x uses C++17 features not
		supported by the older GCC toolchains).
		
		https://icu.unicode.org/
```

## make/libs/jemalloc/Config.in
```kconfig
config FREETZ_LIB_libjemalloc
	bool "libjemalloc (libjemalloc.so)"
	default n
	help
		jemalloc is a general purpose malloc(3) implementation that emphasises
		fragmentation avoidance and scalable concurrency support.

		It is used as the allocator in Firefox, FreeBSD, and many other
		high-performance applications. Compared to the default uClibc allocator
		it provides better heap metadata management and avoids SIGFPE crashes
		caused by corrupted heap state on MIPS targets.

		https://jemalloc.net/
```

## make/libs/json-c/Config.in
```kconfig
config FREETZ_LIB_libjson_c
	bool "json-c (libjson-c.so)"
	default n
	help
		json-c is a JSON library implementing an object model allowing the
		creation and manipulation of JSON formatted strings.

		This library is required by ttyd.

		Project homepage:
		https://github.com/json-c/json-c
```

## make/libs/jsoncpp/Config.in
```kconfig
config FREETZ_LIB_libjsoncpp
	bool "jsoncpp (C++ JSON library)"
	depends on FREETZ_TARGET_UCLIBC_1_0_58_MIN
	default n
	help
		jsoncpp is a C++ library for parsing and generating JSON.
		Required by Gerbera.

		Requires uClibc 1.0.58 or newer (jsoncpp 1.9.8 needs the C++11
		feature cxx_delegating_constructors, which the old GCC 4.6.4
		toolchain does not support).
		
		https://github.com/open-source-parsers/jsoncpp
```

## make/libs/krb5/Config.in
```kconfig
config FREETZ_LIB_libkrb5
	bool "MIT Kerberos core library (libkrb5.so)"
	default n
	select FREETZ_LIB_libcrypto
	select FREETZ_LIB_libcom_err
	select FREETZ_LIB_libk5crypto
	select FREETZ_LIB_libkrb5support
	help
		MIT Kerberos 5 core runtime library required by software using
		Kerberos authentication.

config FREETZ_LIB_libgssapi_krb5
	bool "MIT Kerberos GSSAPI library (libgssapi_krb5.so)"
	default n
	select FREETZ_LIB_libkrb5
	help
		Kerberos GSSAPI library. Required by PowerDNS ldap backend and
		other GSS/Kerberos-enabled software.

config FREETZ_LIB_libcom_err
	bool
	default n

config FREETZ_LIB_libk5crypto
	bool
	default n

config FREETZ_LIB_libkrb5support
	bool
	default n
```

## make/libs/lame/Config.in
```kconfig
config FREETZ_LIB_libmp3lame
	bool "libmp3lame (libmp3lame.so)"
	default n
	help
		LAME is a high quality MP3 (MPEG Audio Layer 3) encoding library.
```

## make/libs/libICE/Config.in
```kconfig
config FREETZ_LIB_libICE
	bool "libICE (X11 Inter-Client Exchange)"
	select FREETZ_LIB_libxorgproto
	default n
	help
		X11 Inter-Client Exchange library (libICE.so).
		Required by libSM for session management.
		Website: https://www.x.org/
```

## make/libs/libSM/Config.in
```kconfig
config FREETZ_LIB_libSM
	bool "libSM (X11 Session Management)"
	select FREETZ_LIB_libxorgproto
	select FREETZ_LIB_libICE
	default n
	help
		X11 Session Management library (libSM.so).
		Required by libXt for session management support.
		Website: https://www.x.org/
```

## make/libs/libX11/Config.in
```kconfig
config FREETZ_LIB_libX11
	bool "libX11 (Core X11 protocol library)"
	select FREETZ_LIB_libxorgproto
	select FREETZ_LIB_libxtrans
	select FREETZ_LIB_libxcb
	default n
	help
		Core X11 protocol client library (libX11.so).
		Required by Xt, Xext, and most X11 applications.
		
		Website: https://www.x.org/
```

## make/libs/libXau/Config.in
```kconfig
config FREETZ_LIB_libXau
	bool "libXau (X11 authorization library)"
	select FREETZ_LIB_libxorgproto
	default n
	help
		X11 authorization library (libXau.so).
		Provides the X Authority file handling.
		
		Website: https://www.x.org/
```

## make/libs/libXaw/Config.in
```kconfig
config FREETZ_LIB_libXaw
	bool "libXaw 1.0.16 (X11 Athena Widgets)"
	select FREETZ_LIB_libXmu
	select FREETZ_LIB_libXpm
	select FREETZ_LIB_libXt
	select FREETZ_LIB_libXext
	select FREETZ_LIB_libX11
	default n
	help
		X11 Athena Widgets library (Xaw7).
```

## make/libs/libXext/Config.in
```kconfig
config FREETZ_LIB_libXext
	bool "libXext (X11 Extension library)"
	select FREETZ_LIB_libxorgproto
	select FREETZ_LIB_libX11
	default n
	help
		X11 Extension library (libXext.so).
		Provides common X11 extensions (Shape, MIT-SHM, etc.).
		Website: https://www.x.org/
```

## make/libs/libXfixes/Config.in
```kconfig
config FREETZ_LIB_libXfixes
	bool "libXfixes 6.0.2 (X11 Fixes)"
	select FREETZ_LIB_libX11
	default n
	help
		X11 Fixes extension library.
```

## make/libs/libXi/Config.in
```kconfig
config FREETZ_LIB_libXi
	bool "libXi 1.8.3 (X11 Input)"
	select FREETZ_LIB_libXfixes
	select FREETZ_LIB_libXext
	select FREETZ_LIB_libX11
	default n
	help
		X11 Input extension library.
```

## make/libs/libXmu/Config.in
```kconfig
config FREETZ_LIB_libXmu
	bool "libXmu 1.3.1 (X11 Misc Utilities)"
	select FREETZ_LIB_libXt
	select FREETZ_LIB_libXext
	select FREETZ_LIB_libX11
	default n
	help
		X11 miscellaneous utility library.
```
