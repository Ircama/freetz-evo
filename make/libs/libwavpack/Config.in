## make/libs/libwavpack/Config.in
```kconfig
config FREETZ_LIB_libwavpack
	bool "libwavpack (WavPack audio compression)"
	default n
	help
		WavPack is a completely open audio compression format providing
		lossless, lossy, and hybrid compression modes.
		
		https://www.wavpack.com/
```

## make/libs/libwebsockets/Config.in
```kconfig
config FREETZ_LIB_libwebsockets
	bool "libwebsockets (libwebsockets.so)"
	depends on FREETZ_LIB_libuv
	default n
	help
		libwebsockets is a lightweight, low-latency C library for
		WebSocket clients and servers, HTTP/2, and more.

		Required by ttyd (web-based terminal).

		Project homepage:
		https://libwebsockets.org/

if FREETZ_LIB_libwebsockets

config FREETZ_LIB_libwebsockets_WITH_SSL
	bool "SSL/TLS support"
	depends on FREETZ_LIB_libwebsockets
	select FREETZ_LIB_libssl
	default n
	help
		Build libwebsockets with SSL/TLS support via OpenSSL.
		Required for HTTPS/WSS connections.

endif
```

## make/libs/libwildmidi/Config.in
```kconfig
config FREETZ_LIB_libwildmidi
	bool "libwildmidi (libWildMidi.so)"
	default n
	help
		WildMIDI is a software MIDI player library.
```

## make/libs/libxcb/Config.in
```kconfig
config FREETZ_LIB_libxcb
	bool "libxcb (X11 C Binding)"
	select FREETZ_LIB_libxorgproto
	select FREETZ_LIB_libxcbproto
	select FREETZ_LIB_libXau
	default n
	help
		X C-language Binding library (libxcb.so).
		Replaces the core X11 protocol library for modern X11.
		
		Website: https://www.x.org/
```

## make/libs/libzip/Config.in
```kconfig
config FREETZ_LIB_libzip
	bool "libzip (C ZIP library)"
	select FREETZ_LIB_libz
	default n
	help
		libzip is a C library for reading, creating,
		and modifying ZIP archives.
		Required by Gerbera.
		
		https://libzip.org/
```

## make/libs/libzmq/Config.in
```kconfig
config FREETZ_LIB_libzmq
	bool "ZeroMQ (libzmq.so)"
	depends on FREETZ_TARGET_GCC_4_8_MIN
	select FREETZ_LIB_libpthread if FREETZ_TARGET_UCLIBC_HAS_multiple_libs
	select FREETZ_LIB_libstdcxx
	default n
	help
		ZeroMQ messaging library.
```

## make/libs/lirc/Config.in
```kconfig
config FREETZ_LIB_liblirc_client
	bool "liblirc_client 0.10.2"
	default n
	help
		LIRC client library. Provides infrared remote control support
		for client applications like ncmpc.
```

## make/libs/lmdb/Config.in
```kconfig
config FREETZ_LIB_liblmdb
	bool "LMDB (liblmdb.so)"
	select FREETZ_LIB_libpthread if FREETZ_TARGET_UCLIBC_HAS_multiple_libs
	default n
	help
		Lightning Memory-Mapped Database embedded key-value store.
```

## make/libs/mpg123/Config.in
```kconfig
config FREETZ_LIB_libmpg123
	bool "mpg123 (libmpg123.so)"
	select FREETZ_LIB_libasound
	default n
	help
		mpg123 is a fast MPEG audio decoder library.
```

## make/libs/openlibm/Config.in
```kconfig
config FREETZ_LIB_libopenlibm
	bool "OpenLibm (libopenlibm.so)"
	default n
	help
		OpenLibm is a portable standalone C math library (libm).

		It provides a consistent, high-quality implementation of math
		functions across platforms and toolchains.
```

## make/libs/openzwave/Config.in
```kconfig
config FREETZ_LIB_libopenzwave
	bool "libopenzwave (libopenzwave.so)"
	default n
	select FREETZ_LIB_libstdcxx
	help
		OpenZWave is a C++ library that provides an interface to the
		Z-Wave home automation protocol. It talks to the controller
		stick through a plain serial device (/dev/ttyUSB*,
		/dev/ttyACM*), so it does not need libusb; the bundled hidapi
		back end (and with it libudev) stays disabled on this target.
		The Z-Wave device database lives in Domoticz's own Config
		directory, which is why it is not installed twice. The Domoticz
		package points its build at this library explicitly, because its
		own detection would not find the headers in
		usr/include/openzwave.

		This is the master branch of OpenZWave, not the v1.6 release:
		Domoticz includes ValueIDIndexesDefines.h, a header that the
		release predates. The commit is pinned, the build is the same as
		the release one (same soname, same install layout).
```

## make/libs/pugixml/Config.in
```kconfig
config FREETZ_LIB_libpugixml
	bool "pugixml (C++ XML processing library)"
	default n
	help
		pugixml is a lightweight C++ XML processing library.
		Required by Gerbera.
		
		https://pugixml.org/
```

## make/libs/rtl-sdr/Config.in
```kconfig
config FREETZ_LIB_rtl_sdr
	bool "rtl-sdr (librtlsdr.so)"
	select FREETZ_LIB_libusb1
	default n
	help
		Turn a Realtek RTL2832U based DVB-T USB dongle into an SDR
		receiver. This library (librtlsdr) is the driver used by
		rtl_433 and other SDR applications to access RTL-SDR devices.

		Project homepage:
		https://osmocom.org/projects/rtl-sdr/
```

## make/libs/shine/Config.in
```kconfig
config FREETZ_LIB_libshine
	bool "shine (libshine.so)"
	default n
	help
		Shine is a fast, fixed-point MP3 encoding library.
```

## make/libs/soapysdr/Config.in
```kconfig
config FREETZ_LIB_libsoapysdr
	bool "soapysdr (libSoapySDR.so)"
	depends on FREETZ_TARGET_UCLIBC_1_0_58_MIN
	default n
	help
		SoapySDR is a vendor and platform neutral SDR support library and
		API. Hardware support is not part of it: it is provided by
		loadable modules (e.g. soapyrtlsdr for RTL-SDR dongles) that have
		to be installed below /usr/lib/SoapySDR/modules0.8.

		Used by rtl_433 as an alternative input besides librtlsdr.

		Resolution uClibc 1.0.58 or newer (SoapySDR needs a C++11 capable
		toolchain).

		https://github.com/pothosware/SoapySDR
```

## make/libs/soxr/Config.in
```kconfig
config FREETZ_LIB_libsoxr
	bool "soxr (libsoxr.so)"
	default n
	help
		The SoX Resampler library performs sample-rate conversion.
```

## make/libs/spdlog/Config.in
```kconfig
config FREETZ_LIB_libspdlog
	bool "spdlog (C++ logging library)"
	depends on FREETZ_TARGET_UCLIBC_1_0_58
	select FREETZ_LIB_libfmt
	default n
	help
		spdlog is a fast C++ logging library.
		Required by Gerbera.
		
		Requires uClibc 1.0.58 or newer.
		
		https://github.com/gabime/spdlog
```

## make/libs/taglib/Config.in
```kconfig
config FREETZ_LIB_libtag
	bool "taglib (libtag.so)"
	depends on FREETZ_TARGET_UCLIBC_1_0_58_MIN
	select FREETZ_LIB_STDCXXLIB
	select FREETZ_LIB_STDCXXLIB_WITH_WCHAR
	select FREETZ_LIB_libm if FREETZ_TARGET_UCLIBC_HAS_multiple_libs
	select FREETZ_LIB_libz
	default n
	help
		TagLib is a library for reading and editing the meta-data of several
		popular audio formats. Currently it supports both ID3v1 and ID3v2
		for MP3 files, Ogg Vorbis comments and ID3 tags and Vorbis comments
		in FLAC, MPC, Speex, WavPack TrueAudio, WAV, AIFF, MP4 and ASF files.
		
		Requires uClibc 1.0.58 or newer (taglib 2.3 fails to compile
		on the older toolchains).
		
		https://taglib.org/
```

## make/libs/tcl/Config.in
```kconfig
config FREETZ_LIB_libtcl
	bool "Tcl (libtcl8.6.so)"
	select FREETZ_LIB_libz
	default n
	help
		Tcl is a very powerful but easy to learn dynamic programming language,
		providing a wide range of useful features. This package provides the
		Tcl shared library (libtcl8.6.so) required by Python's tkinter module.
		
		Website: https://www.tcl.tk/
		Source: https://core.tcl-lang.org/tcl/
```

## make/libs/telldus-core/Config.in
```kconfig
config FREETZ_LIB_libtelldus_core
	bool "libtelldus-core (libtelldus-core.so)"
	select FREETZ_LIB_libstdcxx
	default n
	help
		libtelldus-core is the client library of telldus-core, the
		open source driver of the Tellstick (USB and Duo) 433 MHz
		transmitter/receiver. Programs using it (e.g. Domoticz) talk to
		the telldusd daemon through a local socket, so the daemon is
		required at run time to actually reach a Tellstick.

		Only the client library and its header are installed here; the
		telldusd daemon needs libftdi and libconfuse and is not part of
		this package.

		https://github.com/telldus/telldus
```

## make/libs/tinycdb/Config.in
```kconfig
config FREETZ_LIB_libcdb
	bool "tinycdb (libcdb.so)"
	default n
	help
		Tiny constant database library.
```

## make/libs/tk/Config.in
```kconfig
config FREETZ_LIB_libtk
	bool "Tk (libtk8.6.so)"
	select FREETZ_LIB_libtcl
	select FREETZ_LIB_libX11
	select FREETZ_LIB_libXt
	default n
	help
		Tk is a cross-platform toolkit for creating graphical user interfaces.
		This package provides the Tk shared library (libtk8.6.so) required by
		Python's tkinter module.
		
		Tk requires X11 client libraries (libX11, libXt) to build and to
		connect to a remote X11 display server via DISPLAY=<host>:<screen>.
		
		Website: https://www.tcl.tk/
		Source: https://core.tcl-lang.org/tk/
```

## make/libs/tremor/Config.in
```kconfig
config FREETZ_LIB_libvorbisidec
	bool "tremor (libvorbisidec.so)"
	default n
	help
		Tremor is a low-memory Vorbis decoder library (libvorbisidec).
```

## make/libs/util-macros/Config.in
```kconfig
config FREETZ_LIB_libutilmacros
	bool "util-macros (X.org autoconf macros)"
	default n
	help
		X.org autoconf macros package (xorg-macros.pc).
		Required by all X.org packages at configure time.
		This is a header/macros-only package, no shared library.
		
		Website: https://www.x.org/
```

## make/libs/xcb-proto/Config.in
```kconfig
config FREETZ_LIB_libxcbproto
	bool "xcb-proto (XCB protocol descriptions)"
	default n
	help
		XCB protocol descriptions needed to build libxcb.
		This is a header-only package, no shared library.
		
		Website: https://www.x.org/
```
