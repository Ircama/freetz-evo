## make/pkgs/domoticz-tasmoticz/Config.in
```kconfig
config FREETZ_PACKAGE_DOMOTICZ_TASMOTICZ
	bool "Domoticz plugin: Tasmoticz"
	depends on FREETZ_PACKAGE_DOMOTICZ
	select FREETZ_PACKAGE_PYTHON3_REQUESTS
	default n
	help
		expose the Tasmota devices of an MQTT broker in Domoticz, with automatic configuration and sync commands (it ships its own MQTT client and the Tasmota support).

		It is a Python plugin of Domoticz: the package installs it into
		/usr/share/domoticz/plugins/Tasmoticz, the directory Domoticz is
		started with (-approot of the domoticz package), and it needs no
		change of the Domoticz build.

		Setup -> Hardware -> Tasmoticz, enter the MQTT broker and the Tasmota topic prefix.

		Licensed upstream (LICENSE is installed with the plugin). The
		repository has no release tags, so the build fetches a pinned commit of
		the default branch.
```

## make/pkgs/domoticz-theme-manager/Config.in
```kconfig
config FREETZ_PACKAGE_DOMOTICZ_THEME_MANAGER
	bool "Domoticz plugin: theme manager"
	depends on FREETZ_PACKAGE_DOMOTICZ
	default n
	help
		install and update the web interface themes of Domoticz from its own page

		It is a Python plugin of Domoticz: the package installs it into
		/usr/share/domoticz/plugins/domoticz-theme-manager, the directory Domoticz is
		started with (-approot of the domoticz package), and it needs no
		change of the Domoticz build.

		The plugin imports the Domoticz module and the Python standard
		library only, so no additional Python package is required.

		Setup: Use the page registered in the Domoticz web interface to install a theme.

		Licensed upstream (LICENSE is installed with the plugin). The
		repository has no release tags, so the build fetches a pinned commit of
		the default branch.
```

## make/pkgs/domoticz-wan-ip-checker/Config.in
```kconfig
config FREETZ_PACKAGE_DOMOTICZ_WAN_IP_CHECKER
	bool "Domoticz plugin: WAN IP checker"
	depends on FREETZ_PACKAGE_DOMOTICZ
	default n
	help
		watch the public IP address of the WAN connection and alert on changes

		It is a Python plugin of Domoticz: the package installs it into
		/usr/share/domoticz/plugins/WAN-IP-CHECKER, the directory Domoticz is
		started with (-approot of the domoticz package), and it needs no
		change of the Domoticz build.

		The plugin imports the Domoticz module and the Python standard
		library only, so no additional Python package is required.

		Setup: Setup -> Hardware -> WAN IP checker, choose the check interval.

		Licensed upstream (LICENSE is installed with the plugin). The
		repository has no release tags, so the build fetches a pinned commit of
		the default branch.
```

## make/pkgs/domoticz-wlan-thermo/Config.in
```kconfig
config FREETZ_PACKAGE_DOMOTICZ_WLAN_THERMO
	bool "Domoticz plugin: WLANThermo"
	depends on FREETZ_PACKAGE_DOMOTICZ
	select FREETZ_PACKAGE_PYTHON3_REQUESTS
	default n
	help
		temperature readings of the WLANThermo probes (grills and barbecues) (it uses requests for the HTTP API of WLANThermo).

		It is a Python plugin of Domoticz: the package installs it into
		/usr/share/domoticz/plugins/Domoticz-WLANThermo-Plugin, the directory Domoticz is
		started with (-approot of the domoticz package), and it needs no
		change of the Domoticz build.

		Setup -> Hardware -> WLANThermo, enter the address of the device.

		Licensed upstream (LICENSE is installed with the plugin). The
		repository has no release tags, so the build fetches a pinned commit of
		the default branch.
```

## make/pkgs/domoticz-wled/Config.in
```kconfig
config FREETZ_PACKAGE_DOMOTICZ_WLED
	bool "Domoticz plugin: WLED"
	depends on FREETZ_PACKAGE_DOMOTICZ
	select FREETZ_PACKAGE_PYTHON3_REQUESTS
	default n
	help
		control of the LED strips running the WLED firmware (power, brightness, colour, effects) (it uses requests for the HTTP API of WLED).

		It is a Python plugin of Domoticz: the package installs it into
		/usr/share/domoticz/plugins/wled, the directory Domoticz is
		started with (-approot of the domoticz package), and it needs no
		change of the Domoticz build.

		Setup -> Hardware -> WLED, enter the address of the WLED controller.

		Upstream ships no license file: the README is installed with the plugin. The
		repository has no release tags, so the build fetches a pinned commit of
		the default branch.
```

## make/pkgs/domoticz-wudirect/Config.in
```kconfig
config FREETZ_PACKAGE_DOMOTICZ_WUDIRECT
	bool "Domoticz plugin: local weather station (WuDirect)"
	depends on FREETZ_PACKAGE_DOMOTICZ
	default n
	help
		receive a local weather station that sends Weather Underground formatted data

		It is a Python plugin of Domoticz: the package installs it into
		/usr/share/domoticz/plugins/domoticz-wudirect, the directory Domoticz is
		started with (-approot of the domoticz package), and it needs no
		change of the Domoticz build.

		The plugin imports the Domoticz module and the Python standard
		library only, so no additional Python package is required.

		Setup: Setup -> Hardware -> WuDirect, enter the UDP port to listen on and map the fields of the station.

		Upstream publishes no license file, so the plugin keeps the licensing
		status upstream gave it. The
		repository has no release tags, so the build fetches a pinned commit of
		the default branch.
```

## make/pkgs/domoticz-xiaomi-robot-vacuum/Config.in
```kconfig
config FREETZ_PACKAGE_DOMOTICZ_XIAOMI_ROBOT_VACUUM
	bool "Domoticz plugin: Xiaomi robot vacuum"
	depends on FREETZ_PACKAGE_DOMOTICZ
	select FREETZ_PACKAGE_PYTHON3_GEVENT
	select FREETZ_PACKAGE_PYTHON3_MSGPACK
	select FREETZ_PACKAGE_PYTHON3_MIIO
	default n
	help
		control of the Xiaomi and roborock robot vacuums: start, stop, return to base, status and battery (it runs a helper server next to Domoticz with gevent and talks to the vacuum through python-miio).

		It is a Python plugin of Domoticz: the package installs it into
		/usr/share/domoticz/plugins/xiaomi-mirobot, the directory Domoticz is
		started with (-approot of the domoticz package), and it needs no
		change of the Domoticz build.

		Setup -> Hardware -> Xiaomi MI Robot, enter the address and the token of the vacuum.

		Upstream ships no license file: the README is installed with the plugin. The
		repository has no release tags, so the build fetches a pinned commit of
		the default branch.
```

## make/pkgs/domoticz-yamaha/Config.in
```kconfig
config FREETZ_PACKAGE_DOMOTICZ_YAMAHA
	bool "Domoticz plugin: Yamaha AV receiver"
	depends on FREETZ_PACKAGE_DOMOTICZ
	default n
	help
		control Yamaha AV receivers over the LAN, with a Kodi remote

		It is a Python plugin of Domoticz: the package installs it into
		/usr/share/domoticz/plugins/domoticz-yamaha, the directory Domoticz is
		started with (-approot of the domoticz package), and it needs no
		change of the Domoticz build.

		The plugin imports the Domoticz module and the Python standard
		library only, so no additional Python package is required.

		Setup: Setup -> Hardware -> Yamaha, enter the address of the receiver.

		Licensed upstream (LICENSE is installed with the plugin). The
		repository has no release tags, so the build fetches a pinned commit of
		the default branch.
```

## make/pkgs/domoticz-yi-hack/Config.in
```kconfig
config FREETZ_PACKAGE_DOMOTICZ_YI_HACK
	bool "Domoticz plugin: Yi camera with yi-hack firmware"
	depends on FREETZ_PACKAGE_DOMOTICZ
	default n
	help
		control Xiaomi Yi cameras with the yi-hack firmware (snapshots, motion events)

		It is a Python plugin of Domoticz: the package installs it into
		/usr/share/domoticz/plugins/Domoticz-Yi-Hack-Plugin, the directory Domoticz is
		started with (-approot of the domoticz package), and it needs no
		change of the Domoticz build.

		The plugin imports the Domoticz module and the Python standard
		library only, so no additional Python package is required.

		Setup: Setup -> Hardware -> Yi Hack, enter the address of each camera.

		Licensed upstream (LICENSE is installed with the plugin). The
		repository has no release tags, so the build fetches a pinned commit of
		the default branch.
```

## make/pkgs/domoticz-zigbee2mqtt/Config.in
```kconfig
config FREETZ_PACKAGE_DOMOTICZ_ZIGBEE2MQTT
	bool "Domoticz plugin: Zigbee2MQTT"
	depends on FREETZ_PACKAGE_DOMOTICZ
	select FREETZ_PACKAGE_PYTHON3_REQUESTS
	default n
	help
		expose the Zigbee devices managed by Zigbee2MQTT in Domoticz, with adapters for hundreds of models and a configuration frontend (it ships its own model adapters and talks to Zigbee2MQTT through an MQTT broker).

		It is a Python plugin of Domoticz: the package installs it into
		/usr/share/domoticz/plugins/zigbee2mqtt, the directory Domoticz is
		started with (-approot of the domoticz package), and it needs no
		change of the Domoticz build.

		Setup -> Hardware -> Zigbee2MQTT, enter the address and port of the MQTT broker used by Zigbee2MQTT.

		Licensed upstream (LICENSE is installed with the plugin). The
		repository has no release tags, so the build fetches a pinned commit of
		the default branch.
```

## make/pkgs/domoticz/Config.in
```kconfig
config FREETZ_PACKAGE_DOMOTICZ
	bool "Domoticz 2026.4"
	depends on FREETZ_TARGET_UCLIBC_1_0_58_MIN
	depends on FREETZ_TARGET_IPV6_SUPPORT
	select FREETZ_LIB_STDCXXLIB
	select FREETZ_LIB_libboost_thread
	select FREETZ_LIB_libz
	select FREETZ_LIB_libcurl
	select FREETZ_LIB_libcrypto
	select FREETZ_LIB_libssl
	select FREETZ_LIB_libsqlite3
	select FREETZ_LIB_liblua
	select FREETZ_LIB_libusb0
	select FREETZ_LIB_libusb1
	select FREETZ_LIB_libatomic
	select FREETZ_LIB_libopenzwave
	select FREETZ_LIB_libtelldus_core
	select FREETZ_PACKAGE_PYTHON3
	select FREETZ_LIB_libpython3
	select FREETZ_PACKAGE_MOSQUITTO
	select FREETZ_PACKAGE_MOSQUITTO_CLIENTS
	default n
	help
		Domoticz is a lightweight home automation system: it lets you monitor
		and control lights, switches, sensors, thermostats, media players and
		many other devices from a web browser.

		Build characteristics in Freetz:

		 - Boost (Boost.Asio, Boost.Signals2, Boost.Thread) is provided by the
		   boost package, which is cross-built with b2 and also installs the
		   BoostConfig.cmake that CMake 4 requires (FindBoost was removed).
		 - SQLite, OpenSSL, zlib, libcurl, libusb, Lua 5.4 and libmosquitto
		   (the MQTT client library).
		 - The four git submodules of the 2026.4 tag (extern/jsoncpp,
		   extern/minizip, extern/jwtcpp, extern/libwebem) are downloaded and
		   unpacked by the package, because GitHub source archives never
		   contain submodule contents.
		 - Embedded Python plugin support is enabled (links libpython3.14),
		   dzVents/Lua event scripts use the tree's Lua 5.4.
		 - The built-in updater is disabled. OpenZWave (Z-Wave) and Telldus
		   (Tellstick) are compiled in: the OpenZWave device database is
		   installed in /usr/share/domoticz/Config, from which Domoticz loads
		   it at run time. Telldus only provides the client library here, so
		   a Tellstick additionally needs the telldusd daemon.

		Web interface: http://fritz.box:8080/ (configurable in
		/mod/etc/default.domoticz/domoticz.cfg)
```
