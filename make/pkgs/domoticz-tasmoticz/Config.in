## make/pkgs/e2fsprogs/Config.in
```kconfig
comment "E2fsprogs requires 'Remove e2fsprogs' patch or '-ng' suffix mode"
	depends on !FREETZ_REMOVE_AVM_E2FSPROGS

config FREETZ_PACKAGE_E2FSPROGS
	bool "E2fsprogs 1.47.4 (binary only)"
	default n
	help
		This package contains essential ext2, ext3 and ext4 filesystem
		utilities which consists of e2fsck, mke2fs, debugfs, dumpe2fs,
		tune2fs, and most of the other core ext2 filesystem utilities.
		Homepage: http://e2fsprogs.sourceforge.net/

if FREETZ_PACKAGE_E2FSPROGS

	config FREETZ_PACKAGE_E2FSPROGS_SUFFIX_NG
		bool "Install binaries with '-ng' suffix" if FREETZ_REMOVE_AVM_E2FSPROGS
		default y if !FREETZ_REMOVE_AVM_E2FSPROGS
		default n
		help
			Install selected e2fsprogs tools as <name>-ng in /usr/sbin
			to avoid conflicts with AVM-provided binaries.
			This mode is forced when "Remove e2fsprogs" patch is not active.

	comment "AVM e2fsprogs patch not active: '-ng' suffix mode is forced"
		depends on !FREETZ_REMOVE_AVM_E2FSPROGS

	config FREETZ_PACKAGE_E2FSPROGS_E2FSCK
		bool "Checking Tools"
		default n
		select FREETZ_LIB_libblkid	if FREETZ_PACKAGE_E2FSPROGS_ALL_DYN
		select FREETZ_LIB_libcom_err	if FREETZ_PACKAGE_E2FSPROGS_ALL_DYN
		select FREETZ_LIB_libe2p	if FREETZ_PACKAGE_E2FSPROGS_ALL_DYN
		select FREETZ_LIB_libext2fs	if FREETZ_PACKAGE_E2FSPROGS_ALL_DYN
		select FREETZ_LIB_libuuid	if FREETZ_PACKAGE_E2FSPROGS_ALL_DYN
		help
			Enable selection of checking tools below.

	config FREETZ_PACKAGE_E2FSPROGS_TOOL_E2FSCK
		bool "e2fsck"
		depends on FREETZ_PACKAGE_E2FSPROGS_E2FSCK
		default y

	config FREETZ_PACKAGE_E2FSPROGS_TOOL_FSCK
		bool "fsck"
		depends on FREETZ_PACKAGE_E2FSPROGS_E2FSCK
		default y

	config FREETZ_PACKAGE_E2FSPROGS_E2MAKING
		bool "Making tools"
		default n
		select FREETZ_LIB_libblkid	if FREETZ_PACKAGE_E2FSPROGS_ALL_DYN
		select FREETZ_LIB_libcom_err	if FREETZ_PACKAGE_E2FSPROGS_ALL_DYN
		select FREETZ_LIB_libe2p	if FREETZ_PACKAGE_E2FSPROGS_ALL_DYN
		select FREETZ_LIB_libext2fs	if FREETZ_PACKAGE_E2FSPROGS_ALL_DYN
		select FREETZ_LIB_libuuid	if FREETZ_PACKAGE_E2FSPROGS_ALL_DYN
		help
			Enable selection of making tools below.

	config FREETZ_PACKAGE_E2FSPROGS_TOOL_MKE2FS
		bool "mke2fs"
		depends on FREETZ_PACKAGE_E2FSPROGS_E2MAKING
		default y

	config FREETZ_PACKAGE_E2FSPROGS_TOOL_MKLOSTFOUND
		bool "mklost+found"
		depends on FREETZ_PACKAGE_E2FSPROGS_E2MAKING
		default y

	config FREETZ_PACKAGE_E2FSPROGS_E2TUNING
		bool "Tuning tools"
		default n
		select FREETZ_LIB_libblkid	if FREETZ_PACKAGE_E2FSPROGS_ALL_DYN
		select FREETZ_LIB_libcom_err	if FREETZ_PACKAGE_E2FSPROGS_ALL_DYN
		select FREETZ_LIB_libe2p	if FREETZ_PACKAGE_E2FSPROGS_ALL_DYN
		select FREETZ_LIB_libext2fs	if FREETZ_PACKAGE_E2FSPROGS_ALL_DYN
		select FREETZ_LIB_libuuid	if FREETZ_PACKAGE_E2FSPROGS_ALL_DYN
		help
			Enable selection of tuning tools below.

	config FREETZ_PACKAGE_E2FSPROGS_TOOL_TUNE2FS
		bool "tune2fs"
		depends on FREETZ_PACKAGE_E2FSPROGS_E2TUNING
		default y

	config FREETZ_PACKAGE_E2FSPROGS_TOOL_DUMPE2FS
		bool "dumpe2fs"
		depends on FREETZ_PACKAGE_E2FSPROGS_E2TUNING
		default y

	config FREETZ_PACKAGE_E2FSPROGS_TOOL_CHATTR
		bool "chattr"
		depends on FREETZ_PACKAGE_E2FSPROGS_E2TUNING
		default y

	config FREETZ_PACKAGE_E2FSPROGS_TOOL_LSATTR
		bool "lsattr"
		depends on FREETZ_PACKAGE_E2FSPROGS_E2TUNING
		default y

	config FREETZ_PACKAGE_E2FSPROGS_TOOL_E2LABEL
		bool "e2label"
		depends on FREETZ_PACKAGE_E2FSPROGS_E2TUNING && FREETZ_PACKAGE_E2FSPROGS_TOOL_TUNE2FS
		default y

	config FREETZ_PACKAGE_E2FSPROGS_TOOL_FINDFS
		bool "findfs"
		depends on FREETZ_PACKAGE_E2FSPROGS_E2TUNING && FREETZ_PACKAGE_E2FSPROGS_TOOL_TUNE2FS
		default y

	config FREETZ_PACKAGE_E2FSPROGS_E2DEBUG
		bool "Debugging tools"
		default n
		select FREETZ_LIB_libblkid	if FREETZ_PACKAGE_E2FSPROGS_ALL_DYN
		select FREETZ_LIB_libcom_err	if FREETZ_PACKAGE_E2FSPROGS_ALL_DYN
		select FREETZ_LIB_libe2p	if FREETZ_PACKAGE_E2FSPROGS_ALL_DYN
		select FREETZ_LIB_libext2fs	if FREETZ_PACKAGE_E2FSPROGS_ALL_DYN
		select FREETZ_LIB_libss		if FREETZ_PACKAGE_E2FSPROGS_ALL_DYN
		select FREETZ_LIB_libuuid	if FREETZ_PACKAGE_E2FSPROGS_ALL_DYN
		help
			Enable selection of debug tools below.

	config FREETZ_PACKAGE_E2FSPROGS_TOOL_E2IMAGE
		bool "e2image"
		depends on FREETZ_PACKAGE_E2FSPROGS_E2DEBUG
		default y

	config FREETZ_PACKAGE_E2FSPROGS_TOOL_E2UNDO
		bool "e2undo"
		depends on FREETZ_PACKAGE_E2FSPROGS_E2DEBUG
		default y

	config FREETZ_PACKAGE_E2FSPROGS_TOOL_DEBUGFS
		bool "debugfs"
		depends on FREETZ_PACKAGE_E2FSPROGS_E2DEBUG
		default y

	config FREETZ_PACKAGE_E2FSPROGS_TOOL_LOGSAVE
		bool "logsave"
		depends on FREETZ_PACKAGE_E2FSPROGS_E2DEBUG
		default y

	config FREETZ_PACKAGE_E2FSPROGS_BLKID
		bool "blkid"
		default n
		select FREETZ_LIB_libblkid	if FREETZ_PACKAGE_E2FSPROGS_ALL_DYN
		select FREETZ_LIB_libext2fs	if FREETZ_PACKAGE_E2FSPROGS_ALL_DYN
		help
			Copy blkid to image

	config FREETZ_PACKAGE_E2FSPROGS_E2FIXING
		bool "Repair and misc. tools"
		default n
		select FREETZ_PACKAGE_E2FSPROGS_BLKID if ! FREETZ_BUSYBOX_BLKID
		select FREETZ_LIB_libext2fs	if FREETZ_PACKAGE_E2FSPROGS_ALL_DYN
		select FREETZ_LIB_libcom_err	if FREETZ_PACKAGE_E2FSPROGS_ALL_DYN
		select FREETZ_LIB_libuuid	if FREETZ_PACKAGE_E2FSPROGS_ALL_DYN
		help
			Enable selection of repair/misc tools below.

	config FREETZ_PACKAGE_E2FSPROGS_TOOL_BADBLOCKS
		bool "badblocks"
		depends on FREETZ_PACKAGE_E2FSPROGS_E2FIXING
		default y

	config FREETZ_PACKAGE_E2FSPROGS_TOOL_FILEFRAG
		bool "filefrag"
		depends on FREETZ_PACKAGE_E2FSPROGS_E2FIXING
		default y

	config FREETZ_PACKAGE_E2FSPROGS_TOOL_E2FREEFRAG
		bool "e2freefrag"
		depends on FREETZ_PACKAGE_E2FSPROGS_E2FIXING
		default y

	config FREETZ_PACKAGE_E2FSPROGS_TOOL_UUIDD
		bool "uuidd"
		depends on FREETZ_PACKAGE_E2FSPROGS_E2FIXING
		default y

	config FREETZ_PACKAGE_E2FSPROGS_TOOL_UUIDGEN
		bool "uuidgen"
		depends on FREETZ_PACKAGE_E2FSPROGS_E2FIXING
		default y

	config FREETZ_PACKAGE_E2FSPROGS_E2RESIZE
		bool "Resize tools"
		default n
		select FREETZ_LIB_libe2p	if FREETZ_PACKAGE_E2FSPROGS_ALL_DYN
		select FREETZ_LIB_libext2fs	if FREETZ_PACKAGE_E2FSPROGS_ALL_DYN
		select FREETZ_LIB_libcom_err	if FREETZ_PACKAGE_E2FSPROGS_ALL_DYN
		help
			Enable selection of resize tools below.

	config FREETZ_PACKAGE_E2FSPROGS_TOOL_RESIZE2FS
		bool "resize2fs"
		depends on FREETZ_PACKAGE_E2FSPROGS_E2RESIZE
		default y

	choice
		prompt "Link"
		default FREETZ_PACKAGE_E2FSPROGS_PKG_STAT

		config FREETZ_PACKAGE_E2FSPROGS_ALL_DYN
			bool "all libraries dynamically"

		config FREETZ_PACKAGE_E2FSPROGS_PKG_STAT
			bool "e2fsprogs libraries statically"

		config FREETZ_PACKAGE_E2FSPROGS_ALL_STAT
			bool "all libraries statically"
	endchoice

endif # FREETZ_PACKAGE_E2FSPROGS
```

## make/pkgs/elfinder/Config.in
```kconfig
menuconfig FREETZ_PACKAGE_ELFINDER
	bool "elFinder web file manager"
	depends on FREETZ_PACKAGE_PHP || FREETZ_PACKAGE_PHP5
	# PHP 8.x required extensions
	select FREETZ_PACKAGE_PHP_cgi                if FREETZ_PACKAGE_PHP
	select FREETZ_PACKAGE_PHP_WITH_SESSION       if FREETZ_PACKAGE_PHP
	select FREETZ_PACKAGE_PHP_WITH_MBSTRING      if FREETZ_PACKAGE_PHP
	select FREETZ_PACKAGE_PHP_WITH_ZLIB          if FREETZ_PACKAGE_PHP
	select FREETZ_PACKAGE_PHP_WITH_CURL          if FREETZ_PACKAGE_PHP
	select FREETZ_PACKAGE_PHP_WITH_CTYPE         if FREETZ_PACKAGE_PHP
	select FREETZ_PACKAGE_PHP_WITH_FILEINFO      if FREETZ_PACKAGE_PHP
	select FREETZ_PACKAGE_PHP_WITH_GD            if FREETZ_PACKAGE_PHP
	# PHP5 5.6.40 required extensions
	select FREETZ_PACKAGE_PHP5_cgi               if FREETZ_PACKAGE_PHP5
	select FREETZ_PACKAGE_PHP5_WITH_SESSION      if FREETZ_PACKAGE_PHP5
	select FREETZ_PACKAGE_PHP5_WITH_MBSTRING     if FREETZ_PACKAGE_PHP5
	select FREETZ_PACKAGE_PHP5_WITH_ZLIB         if FREETZ_PACKAGE_PHP5
	select FREETZ_PACKAGE_PHP5_WITH_CURL         if FREETZ_PACKAGE_PHP5
	select FREETZ_PACKAGE_PHP5_WITH_CTYPE        if FREETZ_PACKAGE_PHP5
	select FREETZ_PACKAGE_PHP5_WITH_FILEINFO     if FREETZ_PACKAGE_PHP5
	default n
	help
		Installs elFinder 2.x web-based file manager to /usr/mww/elfinder.
		elFinder is a full-featured file manager for the web browser, inspired
		by the Finder application in Mac OS X.  It provides a familiar drag-and-
		drop interface for managing files on the FritzBox storage.

		Version: 2.1.66

		This option requires either PHP (8.x) or PHP5 (5.6.40).
		If not available, go to "Packages -> Web interface & server"
		and enable either "PHP" or "PHP5" first.

		PHP extensions enabled automatically:
		  - CGI support
		  - SESSION (required for login/state management)
		  - MBSTRING (multi-byte string handling for filenames)
		  - ZLIB (archive support)
		  - CURL (network volume mounts)
		  - CTYPE (character type checking)
		  - FILEINFO (MIME type detection)
		  - GD (thumbnail generation)

		Accessible at: http://fritz.box:81/elfinder/
		Configure at:  http://fritz.box:81/cgi-bin/conf/elfinder

		Note: League\\Flysystem PHP driver integration is available in the
		elFinder PHP connector (elFinderFlysystemGoogleDriveNetmount.php is
		included).  Installing the full league/flysystem library via Composer
		on an external USB drive allows additional cloud volume drivers.
		The FritzBox has no Java runtime, so the efw3.X JSP integration
		(https://github.com/efwGrp/efw3.X) is not applicable here.

if FREETZ_PACKAGE_ELFINDER

	config FREETZ_PACKAGE_ELFINDER_WITH_MEDIAINFO
		bool "Enable MediaInfo (detailed media file information)"
		select FREETZ_PACKAGE_MEDIAINFO
		default n
		help
			Integrates MediaInfo with elFinder for displaying detailed information
			about audio, video and image files (codec, bitrate, duration,
			resolution, etc.).

			Requires the MediaInfo package to be enabled.

	config FREETZ_PACKAGE_ELFINDER_WITH_UNRAR
		bool "Enable RAR support (RAR archive extraction)"
		select FREETZ_PACKAGE_UNRAR
		default n
		help
			Enables extraction of RAR archives (.rar) via unrar.
			Required to work with RAR archives in the file manager.

	config FREETZ_PACKAGE_ELFINDER_WITH_P7ZIP
		bool "Enable 7-Zip support (7z, zip, tar archives)"
		select FREETZ_PACKAGE_P7ZIP
		default n
		help
			Enables support for 7-Zip archives (.7z) and advanced operations
			on ZIP and TAR archives via 7za.

	config FREETZ_PACKAGE_ELFINDER_WITH_FTP_VOLUME
		bool "Enable FTP volume driver (access to remote FTP servers)"
		default n
		help
			Enables the driver for mounting remote FTP volumes inside elFinder
			via the "Mount network" (netmount) function.
			No additional packages required; the FTP driver is included in
			the elFinder PHP connector.

	config FREETZ_PACKAGE_ELFINDER_ALLOW_ALL_UPLOADS
		bool "Allow upload of all file types (no MIME filter)"
		default n
		help
			By default elFinder only accepts images and text files.
			This option removes the filter and allows uploading any file type.

			Warning: potentially dangerous if elFinder is accessible by
			untrusted users.

	config FREETZ_PACKAGE_ELFINDER_MAX_UPLOAD_SIZE
		string "Maximum allowed upload size"
		default "64M"
		help
			Maximum size of a single file uploaded through elFinder.
			Expressed as a PHP string (e.g. 32M, 64M, 128M, 1G).
			Must be consistent with PHP's upload_max_filesize and post_max_size.

	comment "Optional visual themes"

	config FREETZ_PACKAGE_ELFINDER_WITH_THEME_MOONO
		bool "Moono theme (dark style inspired by jQuery UI Moono)"
		default n
		help
			Installs the Moono theme by lokothodida at
			css/themes/moono/css/theme.css.
			The theme can be selected from the configuration page.
			Source: https://github.com/lokothodida/elfinder-theme-moono

	config FREETZ_PACKAGE_ELFINDER_WITH_THEME_WINDOWS10
		bool "Windows 10 theme (modern flat style)"
		default n
		help
			Installs the Windows 10 theme by lokothodida at
			css/themes/windows-10/css/theme.css.
			Includes a custom image set.
			Source: https://github.com/lokothodida/elfinder-theme-windows-10

	config FREETZ_PACKAGE_ELFINDER_WITH_THEME_MATERIAL
		bool "Material Design theme (Google Material style, color variants)"
		default n
		help
			Installs the Material Design theme by RobiNN1 at
			css/themes/material/css/theme.css.
			Includes variants: theme.css (dark), theme-light.css, theme-gray.css.
			Requires Material Icons font files (.woff2).
			Source: https://github.com/RobiNN1/elFinder-Material-Theme

	config FREETZ_PACKAGE_ELFINDER_WITH_THEME_BOOTSTRAP
		bool "Bootstrap theme (SVG LibreICONS icons, Bootstrap style)"
		default n
		help
			Installs the Bootstrap/LibreICONS theme by StudioJunkyard at
			css/themes/bootstrap/css/theme.css.
			Uses scalable SVG icons from LibreICONS.
			Note: downloads the entire LibreICONS repository (~4 MB) and extracts
			only the themes/elFinder/ subdirectory.
			Source: https://github.com/StudioJunkyard/LibreICONS/tree/master/themes/elFinder

endif # FREETZ_PACKAGE_ELFINDER
```

## make/pkgs/esp-serial-flasher/Config.in
```kconfig
config FREETZ_PACKAGE_ESP_SERIAL_FLASHER
	bool "esp-serial-flasher"
	default n
	help
		ESP Serial Flasher for Linux hosts.
		Builds one CLI tool:
                 - esp-flasher: generic CLI (<addr> <file> pairs). It drives the
                   esptool reset sequences itself, so an ESP32-C3/C6/H2/S3 on
                   native USB needs no BOOT/RESET button presses (--before and
                   --after select the strategy).
```

## make/pkgs/exfatprogs/Config.in
```kconfig
config FREETZ_PACKAGE_EXFATPROGS
	bool "exfatprogs 1.3.2 (binary only)"
	default n
	help
		exFAT userspace tools for create/check/label operations.
		
		Provides mkfs.exfat, fsck.exfat, exfatlabel and tune.exfat.

if FREETZ_PACKAGE_EXFATPROGS

	config FREETZ_PACKAGE_EXFATPROGS_mkfs_exfat
		bool "mkfs.exfat"
		default y
		help
			Create an exFAT filesystem.

	config FREETZ_PACKAGE_EXFATPROGS_fsck_exfat
		bool "fsck.exfat"
		default y
		help
			Check and repair an exFAT filesystem.

	config FREETZ_PACKAGE_EXFATPROGS_exfatlabel
		bool "exfatlabel"
		default y
		help
			Set or read exFAT filesystem labels.

	config FREETZ_PACKAGE_EXFATPROGS_tune_exfat
		bool "tune.exfat"
		default n
		help
			Tune exFAT parameters and labels.

endif # FREETZ_PACKAGE_EXFATPROGS
```

## make/pkgs/eza/Config.in
```kconfig
config FREETZ_PACKAGE_EZA
	bool "eza 0.23.4"
	depends on FREETZ_TARGET_UCLIBC_1_0_58_MIN
	default n
	help
		eza is a modern replacement for ls with colors, icons, and richer listings.
```

## make/pkgs/f2fs-tools/Config.in
```kconfig
config FREETZ_PACKAGE_F2FS_TOOLS
	bool "f2fs-tools 1.9.0 (binary only)"
	select FREETZ_LIB_libuuid
	default n
	help
		Userspace tools to create, check and manage F2FS (Flash-Friendly
		File System) filesystems.

		Provides mkfs.f2fs and fsck.f2fs (v1.9.0).

if FREETZ_PACKAGE_F2FS_TOOLS

	config FREETZ_PACKAGE_F2FS_TOOLS_mkfs_f2fs
		bool "mkfs.f2fs"
		default y
		help
			Create an F2FS filesystem.

	config FREETZ_PACKAGE_F2FS_TOOLS_fsck_f2fs
		bool "fsck.f2fs"
		default y
		help
			Check and repair an F2FS filesystem.


endif # FREETZ_PACKAGE_F2FS_TOOLS
```

## make/pkgs/fatresize/Config.in
```kconfig
config FREETZ_PACKAGE_FATRESIZE
	bool "fatresize 2026-04-03 snapshot (master, binary only)"
	select FREETZ_LIB_libuuid
	select FREETZ_PACKAGE_PARTED
	default n
	help
		Resize FAT partitions using libparted.
```
