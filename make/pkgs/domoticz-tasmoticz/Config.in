## make/pkgs/freetz-matter/Config.in
```kconfig
config FREETZ_PACKAGE_FREETZ_MATTER
	bool "freetz-matter 0.1 (FRITZ!Box as a Matter device)"
	depends on FREETZ_TARGET_UCLIBC_1_0_58_MIN
	depends on FREETZ_TARGET_IPV6_SUPPORT
	default n
	select FREETZ_PACKAGE_ALSA_UTILS
	help
		Exposes the FRITZ!Box itself as a Matter device, so a Matter
		controller (Apple Home, Google Home, Alexa, Home Assistant,
		python-matter-server, ...) can commission and read or control the
		box without any hub software and without Node.js.

		Built on project-chip/rs-matter, the pure-Rust Matter stack.

		Endpoints:
		 - Temperature Sensor (0x0302 / cluster 0x0402): the same
		   sensor chain the box_info page uses
		   (/proc/chip_temperature, the thermal zone, the AVM
		   power-management temperature and /proc/avm/temp_sensors).
		 - Smart Speaker (0x0022, OnOff + LevelControl): mute/unmute and
		   volume of the ALSA playback path (amixer, from alsa-utils).
		 - Root node BasicInformation carries the real vendor, model,
		   firmware version and serial number of the box.

		The application is built with Rust/Cargo and installs
		/usr/bin/freetz-matter, the rc.freetz-matter init script and the
		Freetz configuration (port, fabric store location, verbosity).

		After the first start the commissioning QR code and manual pairing
		code are written to the service log
		(http://fritz.box:81/cgi-bin/status/mod/logs -> rc.freetz-matter),
		because the device starts uncommissioned.

		No other Freetz-EVO package is required, in either direction.
		Optional companions: openthread/ot-br-posix if the box should also
		serve as a Thread border router, and any Matter controller (Home
		Assistant, or python-matter-server on a glibc host) to commission
		this device.

		matter-bridge is optional: its native controller can commission
		this device automatically for the local Domoticz Matter driver.
		Run matter-bridge-setup for that local chain.
		The two packages coexist without conflicts:
		matter-bridge serves WebSocket on TCP 5580, this device is a Matter
		node on UDP 5540.

		Can be externalized (External menu): /usr/bin/freetz-matter is the
		whole payload (4.5 MB) and is moved to external storage; the init
		script, the configuration and the fabric store stay in the firmware.
```

## make/pkgs/fsarchiver/Config.in
```kconfig
config FREETZ_PACKAGE_FSARCHIVER
	bool "fsarchiver 0.8.9 (binary only)"
	depends on FREETZ_TARGET_UCLIBC_1_0_58
	select FREETZ_LIB_libz
	select FREETZ_LIB_libbz2
	select FREETZ_LIB_libgcrypt
	select FREETZ_LIB_libblkid
	select FREETZ_LIB_libcom_err
	select FREETZ_LIB_libe2p
	select FREETZ_LIB_libext2fs
	select FREETZ_LIB_libuuid
	default n
	help
		fsarchiver is a filesystem archiver with restore capabilities.
		This package is built with conservative compression support
		(disabling lzma/lzo/lz4/zstd) to keep dependencies smaller.
		
		Requires uClibc 1.0.58 or newer (needs libblkid from
		util-linux 2.41, which is unavailable on older toolchains).
```

## make/pkgs/fzf/Config.in
```kconfig
config FREETZ_PACKAGE_FZF
	bool "fzf 0.72.0 (binary only)"
	default n
	help
		fzf is a command-line fuzzy finder.

		This package cross-compiles the upstream Go sources and installs the
		fzf executable on the target.

		Can be externalized to save flash memory.
```

## make/pkgs/gerbera-cgi/Config.in
```kconfig
config FREETZ_PACKAGE_GERBERA_CGI
	bool "Gerbera CGI web configuration interface"
	depends on FREETZ_PACKAGE_GERBERA_DAEMON
	default n
	help
		Provides a configuration interface for Gerbera media server.

		Access the configuration (e.g., http://fritz.box:81/cgi-bin/conf/gerbera)
```

## make/pkgs/gerbera/Config.in
```kconfig
menuconfig FREETZ_PACKAGE_GERBERA
	bool "Gerbera (UPnP media server)"
	select FREETZ_PACKAGE_SQLITE
	select FREETZ_LIB_libupnp
	select FREETZ_LIB_libfmt
	select FREETZ_LIB_libspdlog
	select FREETZ_LIB_libjsoncpp
	select FREETZ_LIB_libzip
	select FREETZ_LIB_libpugixml
	default n
	help
		Gerbera is a UPnP media server that streams your media
		to UPnP/DLNA clients (smart TVs, game consoles, etc.).
		
		Features:
		- UPnP AV MediaServer v1.0 compliant
		- Metadata extraction from audio/video/image files
		- On-the-fly transcoding via FFmpeg
		- Web interface for management
		- SQLite database for media inventory
		
		https://gerbera.io/

if FREETZ_PACKAGE_GERBERA

	config FREETZ_PACKAGE_GERBERA_DAEMON
		bool "Gerbera media server"
		default y
		help
			Installs the Gerbera UPnP media server daemon.

	config FREETZ_PACKAGE_GERBERA_CGI
		bool "Gerbera CGI web configuration interface"
		depends on FREETZ_PACKAGE_GERBERA_DAEMON
		default n

	config FREETZ_PACKAGE_GERBERA_WITH_CURL
		bool "Enable online services support (libcurl)"
		depends on FREETZ_PACKAGE_GERBERA_DAEMON
		select FREETZ_LIB_libcurl
		default n
		help
			Enables online content services (requires libcurl).

	config FREETZ_PACKAGE_GERBERA_WITH_AVCODEC
		bool "Enable FFmpeg/libavcodec metadata extraction"
		depends on FREETZ_PACKAGE_GERBERA_DAEMON
		select FREETZ_LIB_libavcodec
		select FREETZ_LIB_libavformat
		select FREETZ_LIB_libavutil
		default n
		help
			Enables metadata extraction from audio/video files using
			FFmpeg (libavcodec/libavformat/libavutil).

	config FREETZ_PACKAGE_GERBERA_WITH_EXIF
		bool "Enable EXIF metadata extraction (libexif)"
		depends on FREETZ_PACKAGE_GERBERA_DAEMON
		select FREETZ_LIB_libexif
		default n
		help
			Enables EXIF metadata extraction from images using libexif.

	config FREETZ_PACKAGE_GERBERA_WITH_INOTIFY
		bool "Enable inotify directory monitoring"
		depends on FREETZ_PACKAGE_GERBERA_DAEMON
		default n
		help
			Enables inotify-based automatic directory monitoring
			for changes to the media library.

	config FREETZ_PACKAGE_GERBERA_WITH_JS
		bool "Enable JavaScript scripting support"
		depends on FREETZ_PACKAGE_GERBERA_DAEMON
		select FREETZ_LIB_libduktape
		default n
		help
			Enables JavaScript scripting for the Gerbera web interface.
			Uses the duktape JS engine.

	config FREETZ_PACKAGE_GERBERA_STATIC_LIBUPNP
		bool "Statically link libupnp"
		depends on FREETZ_PACKAGE_GERBERA_DAEMON
		default n
		help
			Statically link libupnp (libnpupnp) into the Gerbera binary
			instead of using the shared library.

	config FREETZ_PACKAGE_GERBERA_WITH_TAGLIB
		bool "Enable TagLib metadata extraction (libtag)"
		depends on FREETZ_PACKAGE_GERBERA_DAEMON
		select FREETZ_LIB_libtag
		default n
		help
			Enables metadata extraction from audio files using TagLib
			(ID3v1, ID3v2, Ogg Vorbis, FLAC, MP4, ASF, etc.).

	config FREETZ_PACKAGE_GERBERA_WITH_MAGIC
		bool "Enable libmagic MIME type detection"
		depends on FREETZ_PACKAGE_GERBERA_DAEMON
		select FREETZ_LIB_libmagic
		default n
		help
			Enables file type detection using libmagic (file command).

	config FREETZ_PACKAGE_GERBERA_WITH_NPUPNP
		bool "Use libnpupnp instead of libupnp"
		depends on FREETZ_PACKAGE_GERBERA_DAEMON
		select FREETZ_LIB_libnpupnp
		default n
		help
			Uses libnpupnp (modern UPnP library) instead of libupnp.

	config FREETZ_PACKAGE_GERBERA_WITH_FFMPEGTHUMBNAILER
		bool "Enable FFmpeg video thumbnails"
		depends on FREETZ_PACKAGE_GERBERA_DAEMON
		select FREETZ_LIB_libffmpegthumbnailer
		default n
		help
			Enables video thumbnail generation using FFmpeg.

	config FREETZ_PACKAGE_GERBERA_WITH_EXIV2
		bool "Enable Exiv2 image metadata extraction"
		depends on FREETZ_PACKAGE_GERBERA_DAEMON && FREETZ_TARGET_UCLIBC_1_0_58
		select FREETZ_LIB_libexiv2
		default n
		help
			Enables image metadata extraction using Exiv2 (Exif, IPTC, XMP).

	config FREETZ_PACKAGE_GERBERA_WITH_MATROSKA
		bool "Enable Matroska metadata extraction"
		depends on FREETZ_PACKAGE_GERBERA_DAEMON
		select FREETZ_LIB_libmatroska
		default n
		help
			Enables metadata extraction from Matroska (MKV/MKA/MKS) files.

	config FREETZ_PACKAGE_GERBERA_WITH_WAVPACK
		bool "Enable WavPack metadata extraction"
		depends on FREETZ_PACKAGE_GERBERA_DAEMON
		select FREETZ_LIB_libwavpack
		default n
		help
			Enables metadata extraction from WavPack audio files.

	config FREETZ_PACKAGE_GERBERA_WITH_ICU
		bool "Enable ICU charset support"
		depends on FREETZ_PACKAGE_GERBERA_DAEMON
		select FREETZ_LIB_libicu
		default n
		help
			Enables ICU (International Components for Unicode) for
			improved charset conversion. WARNING: ICU is very large.

	config FREETZ_PACKAGE_GERBERA_WITH_WEBUI
		bool "Include built-in web UI (~3.9 MB)"
		depends on FREETZ_PACKAGE_GERBERA_DAEMON
		default n
		help
			Includes Gerbera's built-in web interface (HTML/JS/CSS)
			in the firmware image (~3.9 MB). Required for the web
			browser interface on port GERBERA_PORT.
			
			If disabled (default), the Gerbera web UI is not available.
			The separate "Gerbera CGI web configuration interface"
			(Packages -> Web interfaces) can be used for configuration.

	# Unavailable features (dependencies not available in freetz):
	# - WITH_LASTFM:   requires Qt (not available in freetz toolchain)

endif # FREETZ_PACKAGE_GERBERA
```

## make/pkgs/gitui/Config.in
```kconfig
config FREETZ_PACKAGE_GITUI
	bool "gitui 0.28.1"
	depends on FREETZ_TARGET_UCLIBC_1_0_58
	default n
	help
		gitui utility package built from source using Rust/Cargo.
```
