## make/pkgs/python3-psutil/Config.in
```kconfig
config FREETZ_PACKAGE_PYTHON3_PSUTIL
	bool "psutil 7.2.2"
	depends on FREETZ_PACKAGE_PYTHON3
	default n
	help
		Cross-platform process and system monitoring library.
```

## make/pkgs/python3-pyasn1-modules/Config.in
```kconfig
config FREETZ_PACKAGE_PYTHON3_PYASN1_MODULES
	bool "pyasn1-modules 0.4.2"
	depends on FREETZ_PACKAGE_PYTHON3
	select FREETZ_PACKAGE_PYTHON3_PYASN1
	default n
	help
		ASN.1 data modules built on pyasn1 (SNMP, PKCS, X.509 and related).
```

## make/pkgs/python3-pyasn1/Config.in
```kconfig
config FREETZ_PACKAGE_PYTHON3_PYASN1
	bool "pyasn1 0.6.4"
	depends on FREETZ_PACKAGE_PYTHON3
	default n
	help
		ASN.1 encoder and decoder in pure Python: the basis of the SNMP tooling.
```

## make/pkgs/python3-pycares/Config.in
```kconfig
config FREETZ_PACKAGE_PYTHON3_PYCARES
	bool "pycares 5.0.1"
	depends on FREETZ_PACKAGE_PYTHON3
	default n
	help
		Python interface for c-ares (asynchronous DNS requests).
```

## make/pkgs/python3-pychromecast/Config.in
```kconfig
config FREETZ_PACKAGE_PYTHON3_PYCHROMECAST
	bool "pychromecast 14.0.10"
	depends on FREETZ_PACKAGE_PYTHON3
	select FREETZ_PACKAGE_PYTHON3_PROTOBUF
	select FREETZ_PACKAGE_PYTHON3_CASTTUBE
	select FREETZ_PACKAGE_PYTHON3_ZEROCONF
	default n
	help
		Control of Chromecast and Google Cast devices (discovery and media playback): dependency of the Domoticz Chromecast plugin.
```

## make/pkgs/python3-pycparser/Config.in
```kconfig
config FREETZ_PACKAGE_PYTHON3_PYCPARSER
	bool "pycparser 3.0 (pure python, prerequisite)"
	depends on FREETZ_PACKAGE_PYTHON3
	default n
	help
		pycparser is a pure-Python prerequisite module.
		It is a complete parser for the C language in pure Python.
```

## make/pkgs/python3-pymicro-vad/Config.in
```kconfig
config FREETZ_PACKAGE_PYTHON3_PYMICRO_VAD
	bool "pymicro-vad 2.0.1"
	depends on FREETZ_PACKAGE_PYTHON3
	default n
	help
		Lightweight voice activity detection extension for Python.
```

## make/pkgs/python3-pynacl/Config.in
```kconfig
config FREETZ_PACKAGE_PYTHON3_PYNACL
	bool "pynacl 1.6.2"
	depends on FREETZ_PACKAGE_PYTHON3
	select FREETZ_PACKAGE_PYTHON3_CFFI
	default n
	help
		Python bindings to libsodium (NaCl cryptographic library).
```

## make/pkgs/python3-pynetgear/Config.in
```kconfig
config FREETZ_PACKAGE_PYTHON3_PYNETGEAR
	bool "pynetgear 0.10.10"
	depends on FREETZ_PACKAGE_PYTHON3
	select FREETZ_PACKAGE_PYTHON3_REQUESTS
	default n
	help
		Library for the SOAP API of NETGEAR routers: it reads the state
		of the router and the list of the connected devices (used by
		domoticz-idetect).
```

## make/pkgs/python3-pyopenssl/Config.in
```kconfig
config FREETZ_PACKAGE_PYTHON3_PYOPENSSL
	bool "pyopenssl 26.0.0"
	depends on FREETZ_PACKAGE_PYTHON3
	depends on FREETZ_TARGET_UCLIBC_1_0_58
	select FREETZ_PACKAGE_PYTHON3_CRYPTOGRAPHY
	default n
	help
		Python wrapper around OpenSSL via cryptography.
```

## make/pkgs/python3-pyqrcode/Config.in
```kconfig
config FREETZ_PACKAGE_PYTHON3_PYQRCODE
	bool "PyQRCode 1.2.1 [^]"
	default n
	help
		PyQRCode generates QR codes in PNG, EPS, SVG, and ANSI formats.
		Python 3 module for generating QR codes with various output formats.
		
		https://pypi.org/project/PyQRCode/
```

## make/pkgs/python3-pyric/Config.in
```kconfig
config FREETZ_PACKAGE_PYTHON3_PYRIC
	bool "PyRIC 0.1.6.3 (pure python, prerequisite)"
	depends on FREETZ_PACKAGE_PYTHON3
	default n
	help
		Python Radio Interface Controller (pyric).
		Linux wireless library providing nl80211 interface
		for managing wireless interfaces, channels, and connections.
		
		Website: http://wraith-wireless.github.io/PyRIC/
```

## make/pkgs/python3-pyserial/Config.in
```kconfig
config FREETZ_PACKAGE_PYTHON3_PYSERIAL
	bool "pyserial 3.5"
	depends on FREETZ_PACKAGE_PYTHON3
	default n
	help
		Accesso alle porte seriali (modulo `serial`): e' la dipendenza dei plugin modbus (DDS238, DTS238, PZEM-016, Emmeti) e di quasi tutte le librerie che parlano con lettori e contatori via RS-485/USB.
```

## make/pkgs/python3-pysnmp/Config.in
```kconfig
config FREETZ_PACKAGE_PYTHON3_PYSNMP
	bool "pysnmp 7.1.30"
	depends on FREETZ_PACKAGE_PYTHON3
	select FREETZ_PACKAGE_PYTHON3_PYASN1
	default n
	help
		SNMP v1, v2c and v3 client and agent in pure Python: dependency of the Domoticz SNMP reader plugin.
```

## make/pkgs/python3-pyspeex-noise/Config.in
```kconfig
config FREETZ_PACKAGE_PYTHON3_PYSPEEX_NOISE
	bool "pyspeex-noise 2.0.0"
	depends on FREETZ_PACKAGE_PYTHON3
	default n
	help
		Speex-based noise suppression extension for Python.
```

## make/pkgs/python3-pyturbojpeg/Config.in
```kconfig
menuconfig FREETZ_PACKAGE_PYTHON3_PYTURBOJPEG
	bool "pyturbojpeg 2.2.0/1.8.3"
	depends on FREETZ_PACKAGE_PYTHON3
	select FREETZ_PACKAGE_PYTHON3_NUMPY
	default n
	help
		Python wrapper for libjpeg-turbo (TurboJPEG API).

if FREETZ_PACKAGE_PYTHON3_PYTURBOJPEG

	choice
		prompt "Version"
		default FREETZ_PACKAGE_PYTHON3_PYTURBOJPEG_VERSION_CURRENT

		config FREETZ_PACKAGE_PYTHON3_PYTURBOJPEG_VERSION_ABANDON
			bool "1.8.3"

		config FREETZ_PACKAGE_PYTHON3_PYTURBOJPEG_VERSION_CURRENT
			bool "2.2.0"
	endchoice

endif
```

## make/pkgs/python3-pytz/Config.in
```kconfig
config FREETZ_PACKAGE_PYTHON3_PYTZ
	bool "pytz 2026.5"
	depends on FREETZ_PACKAGE_PYTHON3
	default n
	help
		World timezone definitions (dependency of micloud and of the Xiaomi cloud API).
```

## make/pkgs/python3-regex/Config.in
```kconfig
config FREETZ_PACKAGE_PYTHON3_REGEX
	bool "regex 2026.5.9 (C extension)"
	depends on FREETZ_PACKAGE_PYTHON3
	select FREETZ_PACKAGE_PYTHON3_SETUPTOOLS
	default n
	help
		Alternative regular expression module for Python 3,
		backwards-compatible with the standard 're' module.
		Provides additional features including fuzzy matching,
		POSIX matching, recursive patterns and more.
		
		Website: https://github.com/mrabarnett/mrab-regex
```

## make/pkgs/python3-requests/Config.in
```kconfig
config FREETZ_PACKAGE_PYTHON3_REQUESTS
	bool "requests 2.34.2"
	depends on FREETZ_PACKAGE_PYTHON3
	select FREETZ_PACKAGE_PYTHON3_CERTIFI
	select FREETZ_PACKAGE_PYTHON3_CHARSET_NORMALIZER
	select FREETZ_PACKAGE_PYTHON3_IDNA
	select FREETZ_PACKAGE_PYTHON3_URLLIB3
	default n
	help
		The de-facto standard HTTP client library for Python. It is the
		most common dependency of the Domoticz plugins that talk to cloud
		services (EV chargers, heat pumps, solar inverters, LED strips).
```

## make/pkgs/python3-setuptools/Config.in
```kconfig
config FREETZ_PACKAGE_PYTHON3_SETUPTOOLS
	bool "setuptools 82.0.1 (pure python, prerequisite)"
	depends on FREETZ_PACKAGE_PYTHON3
	default n
	help
		setuptools is a pure-Python prerequisite/tooling module.
		setuptools is a collection of enhancements to Python distutils.
		
		Required by pip and many Python packages for:
		- Package installation
		- Dependency management
		- Entry point discovery
		- Package resource management
		
		This is the runtime version of setuptools.
		The host version (python3-setuptools-host) is used during
		firmware build, while this version runs on the Fritz!Box.
		
		Automatically selected when you install pip.
		
		Website: https://setuptools.pypa.io/
		Docs: https://setuptools.pypa.io/en/latest/
```

## make/pkgs/python3-six/Config.in
```kconfig
config FREETZ_PACKAGE_PYTHON3_SIX
	bool "six 1.17.0 (pure python, prerequisite)"
	depends on FREETZ_PACKAGE_PYTHON3
	default n
	help
		six is a pure-Python prerequisite module.
		It is a Python 2 and 3 compatibility library.
```

## make/pkgs/python3-tqdm/Config.in
```kconfig
config FREETZ_PACKAGE_PYTHON3_TQDM
	bool "tqdm 4.70.1"
	depends on FREETZ_PACKAGE_PYTHON3
	default n
	help
		Progress bars for loops and downloads (used by micloud).
```

## make/pkgs/python3-tradfricoap/Config.in
```kconfig
config FREETZ_PACKAGE_PYTHON3_TRADFRICOAP
	bool "tradfricoap 0.1.0"
	depends on FREETZ_PACKAGE_PYTHON3
	select FREETZ_PACKAGE_PYTHON3_APPDIRS
	default n
	help
		Access to IKEA TRADFRI gateways over CoAPs (DTLS): it is the library
		that the Domoticz IKEA Tradfri plugin uses.

		Both back ends of tradfricoap need a helper that speaks the CLI or the
		Python API of the project and both of them are written in **Go**
		(`coapcmd` and `py3coap`), so they are not provided by this tree: with
		this package alone tradfricoap cannot reach a gateway. The library is
		still installed for completeness and it would work as soon as a Go
		cross toolchain helper is available; the CoAP and CoAPs primitives
		themselves come from the `libcoap` package.
```

## make/pkgs/python3-typing-extensions/Config.in
```kconfig
config FREETZ_PACKAGE_PYTHON3_TYPING_EXTENSIONS
	bool "typing-extensions 4.15.0 (pure python, prerequisite)"
	depends on FREETZ_PACKAGE_PYTHON3
	default n
	help
		Backported and experimental typing helpers for Python.
```

## make/pkgs/python3-ulid-transform/Config.in
```kconfig
config FREETZ_PACKAGE_PYTHON3_ULID_TRANSFORM
	bool "ulid-transform 2.2.9"
	depends on FREETZ_PACKAGE_PYTHON3
	default n
	help
		ulid-transform 2.2.9

		Create and transform ULIDs.
		This package builds a native extension and requires Rust/Cargo
		at build time.

		WWW: https://pypi.org/project/ulid-transform/
```
