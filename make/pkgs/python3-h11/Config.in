## make/pkgs/python3-h11/Config.in
```kconfig
config FREETZ_PACKAGE_PYTHON3_H11
	bool "h11 0.16.0"
	depends on FREETZ_PACKAGE_PYTHON3
	default n
	help
		Pure-Python HTTP/1.1 protocol implementation.
```

## make/pkgs/python3-ha-ffmpeg/Config.in
```kconfig
config FREETZ_PACKAGE_PYTHON3_HA_FFMPEG
	bool "ha-ffmpeg 3.2.2"
	depends on FREETZ_PACKAGE_PYTHON3
	select FREETZ_PACKAGE_PYTHON3_ASYNC_TIMEOUT
	default n
	help
		Home Assistant helper library for ffmpeg/ffprobe process handling.
```

## make/pkgs/python3-habluetooth/Config.in
```kconfig
config FREETZ_PACKAGE_PYTHON3_HABLUETOOTH
	bool "habluetooth 6.8.3 (pure python, prerequisite)"
	depends on FREETZ_PACKAGE_PYTHON3
	select FREETZ_PACKAGE_PYTHON3_BLUETOOTH_DATA_TOOLS
	select FREETZ_PACKAGE_PYTHON3_DBUS_FAST
	default n
	help
		High availability Bluetooth library for Home Assistant.
		Provides reliable BLE scanning and connection management
		with automatic recovery.
```

## make/pkgs/python3-hass-nabucasa/Config.in
```kconfig
config FREETZ_PACKAGE_PYTHON3_HASS_NABUCASA
	bool "hass-nabucasa 2.2.0"
	depends on FREETZ_PACKAGE_PYTHON3
	depends on FREETZ_TARGET_UCLIBC_1_0_58_MIN
	select FREETZ_PACKAGE_PYTHON3_AIOHTTP
	select FREETZ_PACKAGE_PYTHON3_ATTRS
	select FREETZ_PACKAGE_PYTHON3_CISO8601
	select FREETZ_PACKAGE_PYTHON3_CRYPTOGRAPHY
	select FREETZ_PACKAGE_PYTHON3_GRPCIO
	select FREETZ_PACKAGE_PYTHON3_VOLUPTUOUS
	select FREETZ_PACKAGE_PYTHON3_WEBRTC_MODELS
	select FREETZ_PACKAGE_PYTHON3_YARL
	default n
	help
		Nabu Casa client library used by Home Assistant cloud integrations.
```

## make/pkgs/python3-hidapi/Config.in
```kconfig
config FREETZ_PACKAGE_PYTHON3_HIDAPI
	bool "hidapi 0.15.0"
	depends on FREETZ_PACKAGE_PYTHON3
	select FREETZ_LIB_libusb1
	default n
	help
		Cython-based Python bindings for the cross-platform HIDAPI
		library, built with the libusb backend (no kernel HID/INPUT
		required). Provides the "hid" module:
		
		    import hid
		    dev = hid.device()
		    dev.open(0x2e8c, 0x0100)
		
		The hidraw/udev backend is intentionally not built (the target
		has no udev and no kernel HID stack).
		
		https://github.com/trezor/cython-hidapi
```

## make/pkgs/python3-httpcore/Config.in
```kconfig
config FREETZ_PACKAGE_PYTHON3_HTTPCORE
	bool "httpcore 1.0.9"
	depends on FREETZ_PACKAGE_PYTHON3
	select FREETZ_PACKAGE_PYTHON3_CERTIFI
	select FREETZ_PACKAGE_PYTHON3_H11
	default n
	help
		Low-level HTTP client core used by httpx.
```

## make/pkgs/python3-httpx/Config.in
```kconfig
config FREETZ_PACKAGE_PYTHON3_HTTPX
	bool "httpx 0.28.1"
	depends on FREETZ_PACKAGE_PYTHON3
	select FREETZ_PACKAGE_PYTHON3_CERTIFI
	select FREETZ_PACKAGE_PYTHON3_HTTPCORE
	select FREETZ_PACKAGE_PYTHON3_IDNA
	default n
	help
		Next-generation HTTP client for Python.
```

## make/pkgs/python3-idna/Config.in
```kconfig
config FREETZ_PACKAGE_PYTHON3_IDNA
	bool "idna 3.11 (pure python, prerequisite)"
	depends on FREETZ_PACKAGE_PYTHON3
	default n
	help
		idna is a pure-Python prerequisite module.
		It provides IDNA2008 and UTS #46 support for Python.
```

## make/pkgs/python3-ifaddr/Config.in
```kconfig
config FREETZ_PACKAGE_PYTHON3_IFADDR
	bool "ifaddr 0.2.0 (pure python, prerequisite)"
	depends on FREETZ_PACKAGE_PYTHON3
	default n
	help
		Cross-platform network interface/address discovery library.
```

## make/pkgs/python3-invoke/Config.in
```kconfig
config FREETZ_PACKAGE_PYTHON3_INVOKE
	bool "invoke 3.0.3"
	depends on FREETZ_PACKAGE_PYTHON3
	default n
	help
		Task execution library for Python: it runs shell commands and
		defines tasks out of Python functions (it is a requirement of
		python-paramiko).
```

## make/pkgs/python3-lru-dict/Config.in
```kconfig
config FREETZ_PACKAGE_PYTHON3_LRU_DICT
	bool "lru-dict 1.4.1"
	depends on FREETZ_PACKAGE_PYTHON3
	default n
	help
		Fast C implementation of a dictionary with LRU eviction.
```

## make/pkgs/python3-mashumaro/Config.in
```kconfig
config FREETZ_PACKAGE_PYTHON3_MASHUMARO
	bool "mashumaro 3.17 (pure python, prerequisite)"
	depends on FREETZ_PACKAGE_PYTHON3
	select FREETZ_PACKAGE_PYTHON3_TYPING_EXTENSIONS
	default n
	help
		Fast dataclass serialization/deserialization framework.
```

## make/pkgs/python3-micloud/Config.in
```kconfig
config FREETZ_PACKAGE_PYTHON3_MICLOUD
	bool "micloud 0.6"
	depends on FREETZ_PACKAGE_PYTHON3
	select FREETZ_PACKAGE_PYTHON3_REQUESTS
	default n
	help
		Client for the Xiaomi cloud API (python-miio uses it for the device tokens).
```

## make/pkgs/python3-miio/Config.in
```kconfig
config FREETZ_PACKAGE_PYTHON3_MIIO
	bool "python-miio 0.5.12"
	depends on FREETZ_PACKAGE_PYTHON3
	select FREETZ_PACKAGE_PYTHON3_ANDROID_BACKUP
	select FREETZ_PACKAGE_PYTHON3_APPDIRS
	select FREETZ_PACKAGE_PYTHON3_ATTRS
	select FREETZ_PACKAGE_PYTHON3_CLICK
	select FREETZ_PACKAGE_PYTHON3_CONSTRUCT
	select FREETZ_PACKAGE_PYTHON3_CRONITER
	select FREETZ_PACKAGE_PYTHON3_CRYPTOGRAPHY
	select FREETZ_PACKAGE_PYTHON3_DEFUSEDXML
	select FREETZ_PACKAGE_PYTHON3_MICLOUD
	select FREETZ_PACKAGE_PYTHON3_NETIFACES
	select FREETZ_PACKAGE_PYTHON3_PYTZ
	select FREETZ_PACKAGE_PYTHON3_PYYAML
	select FREETZ_PACKAGE_PYTHON3_TQDM
	select FREETZ_PACKAGE_PYTHON3_ZEROCONF
	default n
	help
		python-miio: control of Xiaomi devices over the LAN (the `miio` module and `miiocli`).
```

## make/pkgs/python3-minimalmodbus/Config.in
```kconfig
config FREETZ_PACKAGE_PYTHON3_MINIMALMODBUS
	bool "minimalmodbus 2.1.1"
	depends on FREETZ_PACKAGE_PYTHON3
	select FREETZ_PACKAGE_PYTHON3_PYSERIAL
	default n
	help
		Client Modbus RTU/ASCII semplice ed essenziale, sopra pyserial: i plugin CreasolTech ne includono una copia propria, quindi questo pacchetto serve a script e ad altri plugin.
```

## make/pkgs/python3-msgpack/Config.in
```kconfig
config FREETZ_PACKAGE_PYTHON3_MSGPACK
	bool "msgpack 1.2.3"
	depends on FREETZ_PACKAGE_PYTHON3
	default n
	help
		Compact binary serialisation (MessagePack), with its C extension: used between processes and services.
```

## make/pkgs/python3-multidict/Config.in
```kconfig
config FREETZ_PACKAGE_PYTHON3_MULTIDICT
	bool "multidict 6.7.1"
	depends on FREETZ_PACKAGE_PYTHON3
	default n
	help
		Multidict is dict-like collection of key-value pairs.
```

## make/pkgs/python3-netifaces/Config.in
```kconfig
config FREETZ_PACKAGE_PYTHON3_NETIFACES
	bool "netifaces 0.11.0"
	depends on FREETZ_PACKAGE_PYTHON3
	default n
	help
		Portable access to the network interfaces and their addresses (compiled extension, used by python-miio).
```

## make/pkgs/python3-numpy/Config.in
```kconfig
comment "NumPy requires external storage  (Enable 'External processing' in the main menu)"
	depends on FREETZ_PACKAGE_PYTHON3 && !EXTERNAL_ENABLED

menuconfig FREETZ_PACKAGE_PYTHON3_NUMPY
	bool "NumPy 2.5.0/2.4.3/2.3.2 (for Python 3)"
	depends on FREETZ_PACKAGE_PYTHON3
	depends on EXTERNAL_ENABLED
	select FREETZ_LIB_libopenlibm
	default n
	help
		NumPy is the fundamental package for scientific computing in Python.
		
		Available versions:
		- 2.3.2: stable older release
		- 2.4.3: previous release
		- 2.5.0: latest (recommended, adds PyDataType_TYPEOBJ/KIND/TYPE/BYTEORDER macros)
		
		Provides:
		- Powerful N-dimensional array object (ndarray)
		- Sophisticated broadcasting functions
		- Linear algebra, Fourier transform, random number capabilities
		- Tools for integrating C/C++ and Fortran code
		
		Common uses:
		- Data analysis and machine learning
		- Scientific and engineering computations
		- Image and signal processing
		- Statistical operations
		
		WARNING: NumPy is large (~15-20 MB) and MUST be externalized.
		Ensure sufficient USB storage is available.
		
		This build uses reference BLAS (slower but no extra dependencies).
		For performance-critical applications, consider optimized libraries.
		
		Website: https://numpy.org/
		Docs: https://numpy.org/doc/stable/

if FREETZ_PACKAGE_PYTHON3_NUMPY

	choice
		prompt "Version"
		default FREETZ_PACKAGE_PYTHON3_NUMPY_VERSION_CURRENT

		config FREETZ_PACKAGE_PYTHON3_NUMPY_VERSION_ABANDON
			bool "2.3.2"

		config FREETZ_PACKAGE_PYTHON3_NUMPY_VERSION_OLD
			bool "2.4.3"

		config FREETZ_PACKAGE_PYTHON3_NUMPY_VERSION_CURRENT
			bool "2.5.0"
	endchoice

endif
```

## make/pkgs/python3-orjson/Config.in
```kconfig
config FREETZ_PACKAGE_PYTHON3_ORJSON
	bool "orjson 3.11.9"
	depends on FREETZ_PACKAGE_PYTHON3
	depends on FREETZ_TARGET_UCLIBC_1_0_58
	default n
	help
		Fast, correct Python JSON library supporting dataclasses,
		datetimes, and numpy. Native Rust implementation via maturin.
		
		Dependencies:
		  - Python 3.x
		  - Rust/Cargo (build time)
		
		Build: Uses pyproject/pip (PEP 517) with maturin
```

## make/pkgs/python3-paho-mqtt/Config.in
```kconfig
config FREETZ_PACKAGE_PYTHON3_PAHO_MQTT
	bool "paho-mqtt 2.1.0"
	depends on FREETZ_PACKAGE_PYTHON3
	default n
	help
		MQTT client library of the Eclipse Paho project (module `paho`).
		Most Domoticz plugins that subscribe to an MQTT broker use it, for
		example the Zigbee2MQTT and Shelly bridges; on this box the broker
		itself is the `mosquitto` package.
```

## make/pkgs/python3-pandas/Config.in
```kconfig
comment "pandas requires external storage  (Enable 'External processing' in the main menu)"
	depends on FREETZ_PACKAGE_PYTHON3 && !EXTERNAL_ENABLED

menuconfig FREETZ_PACKAGE_PYTHON3_PANDAS
	bool "pandas 3.0.3/3.0.1/2.3.3 (for Python 3)"
	depends on FREETZ_PACKAGE_PYTHON3
	depends on EXTERNAL_ENABLED
	select FREETZ_PACKAGE_PYTHON3_NUMPY
	select FREETZ_PACKAGE_PYTHON3_DATEUTIL
	default n
	help
		pandas is a powerful data analysis and manipulation library.
		
		WARNING: Requires NumPy.
		
		Available versions:
		- 2.3.3: last 2.x release (NumPy 1.x compatible API)
		- 3.0.1: first 3.x release (NumPy 2.x API)
		- 3.0.3: latest (NumPy 2.x API, recommended)
		
		Provides:
		- DataFrame and Series data structures
		- Data alignment and integrated handling of missing data
		- Reshaping and pivoting of data sets
		- Label-based slicing, indexing, and subsetting
		- Time series functionality
		- Data I/O (CSV, Excel, SQL, HDF5, JSON, Parquet)
		
		Common uses:
		- Data cleaning and preparation
		- Statistical analysis
		- Time series analysis
		- Data visualization (with matplotlib)
		
		WARNING: pandas is large (~10-15 MB) and REQUIRES NumPy.

if FREETZ_PACKAGE_PYTHON3_PANDAS

	choice
		prompt "Version"
		default FREETZ_PACKAGE_PYTHON3_PANDAS_VERSION_CURRENT

		config FREETZ_PACKAGE_PYTHON3_PANDAS_VERSION_ABANDON
			bool "2.3.3"

		config FREETZ_PACKAGE_PYTHON3_PANDAS_VERSION_OLD
			bool "3.0.1"

		config FREETZ_PACKAGE_PYTHON3_PANDAS_VERSION_CURRENT
			bool "3.0.3"
	endchoice

endif
```

## make/pkgs/python3-paramiko/Config.in
```kconfig
config FREETZ_PACKAGE_PYTHON3_PARAMIKO
	bool "paramiko 5.0.0"
	depends on FREETZ_PACKAGE_PYTHON3
	select FREETZ_PACKAGE_PYTHON3_BCRYPT
	select FREETZ_PACKAGE_PYTHON3_CRYPTOGRAPHY
	select FREETZ_PACKAGE_PYTHON3_INVOKE
	select FREETZ_PACKAGE_PYTHON3_PYNACL
	default n
	help
		SSH2 protocol library (client and server) implemented in Python
		on top of cryptography: it opens SSH sessions and it runs commands
		on remote hosts, for example to list the clients of a router
		(used by domoticz-idetect).
```

## make/pkgs/python3-propcache/Config.in
```kconfig
config FREETZ_PACKAGE_PYTHON3_PROPCACHE
	bool "propcache 0.4.1"
	depends on FREETZ_PACKAGE_PYTHON3
	default n
	help
		propcache provides cached property helpers for Python.
```

## make/pkgs/python3-protobuf/Config.in
```kconfig
config FREETZ_PACKAGE_PYTHON3_PROTOBUF
	bool "protobuf 7.36.2"
	depends on FREETZ_PACKAGE_PYTHON3
	default n
	help
		Protocol Buffers runtime (module `google.protobuf` with its C extension), required by pychromecast.
```
