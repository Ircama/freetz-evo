## make/pkgs/python3-cached-ipaddress/Config.in
```kconfig
config FREETZ_PACKAGE_PYTHON3_CACHED_IPADDRESS
	bool "cached-ipaddress 1.1.2 [^]"
	default n
	help
		cached-ipaddress provides a cached IP address resolution utility.
		Python 3 module for resolving and caching IP addresses.
		
		https://pypi.org/project/cached-ipaddress/
```

## make/pkgs/python3-casttube/Config.in
```kconfig
config FREETZ_PACKAGE_PYTHON3_CASTTUBE
	bool "casttube 0.2.1"
	depends on FREETZ_PACKAGE_PYTHON3
	select FREETZ_PACKAGE_PYTHON3_REQUESTS
	default n
	help
		YouTube casting to Chromecast devices, used by pychromecast.
```

## make/pkgs/python3-certifi/Config.in
```kconfig
config FREETZ_PACKAGE_PYTHON3_CERTIFI
	bool "certifi 2025.10.5 (pure python, prerequisite)"
	depends on FREETZ_PACKAGE_PYTHON3
	default n
	help
		Mozilla CA bundle for Python TLS verification.
```

## make/pkgs/python3-cffi/Config.in
```kconfig
config FREETZ_PACKAGE_PYTHON3_CFFI
	bool "cffi 2.0.0"
	depends on FREETZ_PACKAGE_PYTHON3
	select FREETZ_PACKAGE_PYTHON3_PYCPARSER
	select FREETZ_LIB_libffi
	default n
	help
		CFFI (C Foreign Function Interface) for Python 3.
		
		Interact with almost any C code from Python, based on C-like
		declarations that you can often copy-paste from header files
		or documentation.
		
		Required by many modern Python packages including:
		- cryptography
		- PyNaCl
		- bcrypt
		- argon2-cffi
		
		Website: https://cffi.readthedocs.io/
		GitHub: https://github.com/python-cffi/cffi
```

## make/pkgs/python3-charset-normalizer/Config.in
```kconfig
config FREETZ_PACKAGE_PYTHON3_CHARSET_NORMALIZER
	bool "charset-normalizer 3.4.6"
	depends on FREETZ_PACKAGE_PYTHON3
	default n
	help
		Unicode charset detector for Python.
```

## make/pkgs/python3-ciso8601/Config.in
```kconfig
config FREETZ_PACKAGE_PYTHON3_CISO8601
	bool "ciso8601 2.3.3"
	depends on FREETZ_PACKAGE_PYTHON3
	default n
	help
		Fast ISO 8601 date/time parser written in C.
```

## make/pkgs/python3-click/Config.in
```kconfig
config FREETZ_PACKAGE_PYTHON3_CLICK
	bool "click 8.5.0"
	depends on FREETZ_PACKAGE_PYTHON3
	default n
	help
		Composable command line interface toolkit (used by the miiocli tools and python-miio).
```

## make/pkgs/python3-construct/Config.in
```kconfig
config FREETZ_PACKAGE_PYTHON3_CONSTRUCT
	bool "construct 2.10.70"
	depends on FREETZ_PACKAGE_PYTHON3
	default n
	help
		Declarative parser and builder for binary data, used by python-miio to encode the device protocol.
```

## make/pkgs/python3-croniter/Config.in
```kconfig
config FREETZ_PACKAGE_PYTHON3_CRONITER
	bool "croniter 6.2.4"
	depends on FREETZ_PACKAGE_PYTHON3
	select FREETZ_PACKAGE_PYTHON3_DATEUTIL
	default n
	help
		Evaluate cron style schedules (used by micloud and by scheduler code).
```

## make/pkgs/python3-cryptography/Config.in
```kconfig
config FREETZ_PACKAGE_PYTHON3_CRYPTOGRAPHY
	bool "cryptography 48.0.0"
	depends on FREETZ_PACKAGE_PYTHON3
	depends on FREETZ_TARGET_UCLIBC_1_0_58_MIN
	select FREETZ_PACKAGE_PYTHON3_CFFI
	select FREETZ_PACKAGE_PYTHON3_TYPING_EXTENSIONS
	select FREETZ_LIB_libcrypto if !FREETZ_PACKAGE_OPENSSL
	select FREETZ_LIB_libssl if !FREETZ_PACKAGE_OPENSSL
	default n
	help
		cryptography 48.0.0

		cryptography is a package which provides cryptographic recipes and
		primitives to Python developers.
		
		Features:
		  - SSL/TLS support
		  - X.509 certificate handling
		  - Symmetric encryption (AES, ChaCha20, etc.)
		  - Asymmetric encryption (RSA, ECDSA, etc.)
		  - Message digests and signatures
		  - Key derivation functions
		
		Dependencies:
		  - Python 3.x
		  - cffi (Python C Foreign Function Interface)
		  - typing-extensions
		  - OpenSSL
		  - Rust/Cargo (build time)
		
		Build: Uses pyproject/pip (PEP 517)
		
		Size: ~2-3 MB installed
		
		WWW: https://cryptography.io/
```

## make/pkgs/python3-dateutil/Config.in
```kconfig
config FREETZ_PACKAGE_PYTHON3_DATEUTIL
	bool "python-dateutil 2.9.0.post0 (pure python, prerequisite)"
	depends on FREETZ_PACKAGE_PYTHON3
	select FREETZ_PACKAGE_PYTHON3_SIX
	default n
	help
		python-dateutil is a pure-Python prerequisite module.
		It provides extensions to the standard datetime module.
```

## make/pkgs/python3-dbus-fast/Config.in
```kconfig
config FREETZ_PACKAGE_PYTHON3_DBUS_FAST
	bool "dbus-fast 4.0.0"
	depends on FREETZ_PACKAGE_PYTHON3
	default n
	help
		High-performance DBus client/service library.
		Build is configured to require Cython extension compilation.
```

## make/pkgs/python3-defusedxml/Config.in
```kconfig
config FREETZ_PACKAGE_PYTHON3_DEFUSEDXML
	bool "defusedxml 0.7.1"
	depends on FREETZ_PACKAGE_PYTHON3
	default n
	help
		XML parsers protected against the common XML attacks (used by python-miio for the miIO responses).
```

## make/pkgs/python3-faust-cchardet/Config.in
```kconfig
config FREETZ_PACKAGE_PYTHON3_FAUST_CCHARDET
	bool "faust-cchardet 2.1.19"
	depends on FREETZ_PACKAGE_PYTHON3
	default n
	help
		Fast universal character encoding detector (C/C++ extension).
```

## make/pkgs/python3-feedparser-sgmllib/Config.in
```kconfig
config FREETZ_PACKAGE_PYTHON3_FEEDPARSER_SGMLLIB
	bool "feedparser-sgmllib 2.1.0"
	depends on FREETZ_PACKAGE_PYTHON3
	default n
	help
		Parser SGML permissivo richiesto da feedparser 6 (modulo `sgmllib`).
```

## make/pkgs/python3-feedparser/Config.in
```kconfig
config FREETZ_PACKAGE_PYTHON3_FEEDPARSER
	bool "feedparser 6.0.14"
	depends on FREETZ_PACKAGE_PYTHON3
	select FREETZ_PACKAGE_PYTHON3_FEEDPARSER_SGMLLIB
	default n
	help
		Parsing di feed RSS e Atom, con gestione dei formati piu' comuni: e' la dipendenza di MeteoAlarmEU.
```

## make/pkgs/python3-fnv-hash-fast/Config.in
```kconfig
config FREETZ_PACKAGE_PYTHON3_FNV_HASH_FAST
	bool "fnv-hash-fast 2.0.3"
	depends on FREETZ_PACKAGE_PYTHON3
	select FREETZ_PACKAGE_PYTHON3_FNVHASH
	default n
	help
		A fast version of fnv1a hash using an optional Cython C extension.
		Falls back to pure Python fnvhash if Cython is not available.
```

## make/pkgs/python3-fnvhash/Config.in
```kconfig
config FREETZ_PACKAGE_PYTHON3_FNVHASH
	bool "fnvhash 0.2.1 (pure python, prerequisite)"
	depends on FREETZ_PACKAGE_PYTHON3
	default n
	help
		fnvhash is a pure-Python prerequisite module.
		It provides FNV hash implementations (fnv1, fnv1a).
```

## make/pkgs/python3-fritzconnection/Config.in
```kconfig
config FREETZ_PACKAGE_PYTHON3_FRITZCONNECTION
	bool "fritzconnection 1.15.1"
	depends on FREETZ_PACKAGE_PYTHON3
	select FREETZ_PACKAGE_PYTHON3_REQUESTS
	default n
	help
		Library to talk to the TR-064 interface of a FRITZ!Box from
		Python: it reads the device and network status and it can call the
		actions of the router, for example for presence detection
		(devices seen by the WLAN) or for rebooting the box.

		It is installed for the Domoticz plugin that uses it
		(domoticz-fritz-presence), but it can also be used by scripts on
		the box, for example from the Freetz configuration pages.
```

## make/pkgs/python3-frozenlist/Config.in
```kconfig
config FREETZ_PACKAGE_PYTHON3_FROZENLIST
	bool "frozenlist 1.8.0"
	depends on FREETZ_PACKAGE_PYTHON3
	default n
	help
		A list-like structure which implements collections.abc.MutableSequence.
```

## make/pkgs/python3-gevent/Config.in
```kconfig
config FREETZ_PACKAGE_PYTHON3_GEVENT
	bool "gevent 26.9.0"
	depends on FREETZ_PACKAGE_PYTHON3
	select FREETZ_LIB_libev
	select FREETZ_LIB_libcares
	select FREETZ_PACKAGE_PYTHON3_GREENLET
	select FREETZ_PACKAGE_PYTHON3_CFFI
	select FREETZ_PACKAGE_PYTHON3_ZOPE_EVENT
	select FREETZ_PACKAGE_PYTHON3_ZOPE_INTERFACE
	default n
	help
		Coroutine-based networking library built on libev and greenlet: dependency of the Domoticz plugin for the Xiaomi robot vacuum.
```

## make/pkgs/python3-greenlet/Config.in
```kconfig
config FREETZ_PACKAGE_PYTHON3_GREENLET
	bool "greenlet 3.5.6"
	depends on FREETZ_PACKAGE_PYTHON3
	default n
	help
		Lightweight coroutines with their own stacks (C extension): the basis of gevent.
```

## make/pkgs/python3-grpcio-reflection/Config.in
```kconfig
config FREETZ_PACKAGE_PYTHON3_GRPCIO_REFLECTION
	bool "grpcio-reflection 1.78.1"
	depends on FREETZ_PACKAGE_PYTHON3
	select FREETZ_PACKAGE_PYTHON3_GRPCIO
	default n
	help
		gRPC server reflection support for Python services.
```

## make/pkgs/python3-grpcio-status/Config.in
```kconfig
config FREETZ_PACKAGE_PYTHON3_GRPCIO_STATUS
	bool "grpcio-status 1.78.1"
	depends on FREETZ_PACKAGE_PYTHON3
	select FREETZ_PACKAGE_PYTHON3_GRPCIO
	default n
	help
		gRPC status helpers and rich error details support.
```

## make/pkgs/python3-grpcio/Config.in
```kconfig
config FREETZ_PACKAGE_PYTHON3_GRPCIO
	bool "grpcio 1.78.0"
	depends on FREETZ_PACKAGE_PYTHON3
	default n
	help
		gRPC Python bindings with native C/C++ core extensions.
```
