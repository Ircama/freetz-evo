## make/pkgs/tac/Config.in
```kconfig
config FREETZ_PACKAGE_TAC
	bool "tac 0.9.0"
	depends on FREETZ_TARGET_UCLIBC_1_0_58_MIN
	default n
	help
		tac from uutils/coreutils, packaged as a dedicated target-side command.
```

## make/pkgs/telink_tools/Config.in
```kconfig
config FREETZ_PACKAGE_TELINK_TOOLS
	bool "telink_tools 1.0"
	default n
	help
		Telink BLE chip bootloader utility implemented in C.
		
		Supports firmware flashing and flash utility operations
		for devices such as TB-03F-KIT and TB-04-KIT.
		
		Installs:
		 - /usr/bin/telink_tools
```

## make/pkgs/telldus/Config.in
```kconfig
config FREETZ_PACKAGE_TELLDUS
	bool "telldusd (Tellstick daemon)"
	select FREETZ_LIB_libconfuse
	select FREETZ_LIB_libftdi
	select FREETZ_LIB_libtelldus_core
	default n
	help
		telldusd is the daemon of telldus-core, the open source driver of
		the Tellstick 433 MHz transmitter/receiver. It owns the USB stick
		(Tellstick Classic or Duo, driven through libftdi) and serves the
		client library over a local socket, so that programs like Domoticz
		(its Telldus hardware type) or the tdtool command line client -
		shipped by this package - can send and receive 433 MHz codes.

		A Tellstick Duo can also receive, which is what makes it useful
		for remote controls and sensors of that frequency.

		The configuration of the known devices is stored in
		/mod/etc/conf/tellstick.conf and can be edited from the web
		interface below; devices learned at run time are written to
		/mod/etc/conf/tellstick-state.conf. Both files live in the
		persistent part of the freetz configuration framework, because
		the firmware image itself is read only.

		Web interface: http://fritz.box:81/cgi-bin/conf/telldus
		Log file: /tmp/rc.telldus.log
```

## make/pkgs/termscp/Config.in
```kconfig
config FREETZ_PACKAGE_TERMSCP
	bool "termscp 1.0.0"
	depends on FREETZ_TARGET_UCLIBC_1_0_58_MIN
	default n
	help
		termscp utility package built from source using Rust/Cargo.
```

## make/pkgs/testdisk/Config.in
```kconfig
config FREETZ_PACKAGE_TESTDISK
	bool "testdisk 7.2"
	select FREETZ_LIB_libncursesw
	default n
	help
		TestDisk is a powerful data recovery tool designed to recover
		lost partitions and repair non-booting disks caused by software
		faults or accidental deletion of the partition table. PhotoRec
		is a companion tool focused on file data recovery, supporting
		over 480 file extensions. fidentify uses PhotoRec's signature
		database to identify file types from raw data.

		TestDisk and PhotoRec provide an ncurses TUI and are intended
		for use over SSH on the FRITZ!Box.

		Project home: https://www.cgsecurity.org/wiki/TestDisk
		GitHub:       https://github.com/cgsecurity/testdisk

		These are large binaries; can be externalized to save flash memory.

if FREETZ_PACKAGE_TESTDISK

	config FREETZ_PACKAGE_TESTDISK_testdisk
		bool "testdisk"
		default y
		help
			Partition scanner and undelete tool. Supports GPT, MBR,
			Mac partition maps and BSD disklabels. Rebuilds lost
			partition tables and fixes boot sectors.

	config FREETZ_PACKAGE_TESTDISK_photorec
		bool "photorec"
		default y
		help
			File data recovery tool. Ignores the filesystem and
			recovers lost files from hard disks, CD-ROMs and
			digital camera memory (hence the name, though it
			recovers far more than just photos).

	config FREETZ_PACKAGE_TESTDISK_fidentify
		bool "fidentify"
		default n
		help
			File type identification tool that uses PhotoRec's
			signature database to determine the type of a file
			from its content rather than its extension.

endif # FREETZ_PACKAGE_TESTDISK
```

## make/pkgs/tflite-micro/Config.in
```kconfig
config FREETZ_PACKAGE_TFLITE_MICRO
	bool "tflite-micro (TensorFlow Lite for Microcontrollers)"
	default n
	help
		TensorFlow Lite for Microcontrollers (TFLM) is a port of TensorFlow
		Lite designed to run ML inference on resource-constrained devices.

		This package cross-compiles TFLM into a static library (libtflm.a)
		and installs the public headers into the staging area so that other
		packages can link against it.

		The build uses the official project-generation script
		(create_tflm_tree.py) to produce a self-contained source tree, then
		compiles it with the freetz cross-toolchain (C++17 required).

		Requires Python 3 on the build host.

		Homepage:  https://github.com/tensorflow/tflite-micro
		Reference: https://www.tensorflow.org/lite/microcontrollers

if FREETZ_PACKAGE_TFLITE_MICRO

	config FREETZ_PACKAGE_TFLITE_MICRO_HELLO_WORLD
		bool "Build hello_world example binary"
		default n
		help
			Cross-compiles the bundled hello_world example and installs it
			as /usr/bin/tflm-hello-world on the target.
			Useful for verifying that TFLM inference runs correctly on the
			device.

endif # FREETZ_PACKAGE_TFLITE_MICRO
```

## make/pkgs/tput/Config.in
```kconfig
menuconfig FREETZ_PACKAGE_TPUT
	bool "tput (ncurses terminal control)"
	select FREETZ_LIB_libncurses
	select FREETZ_SHARE_terminfo
	default n
	help
		tput is a command-line utility from the ncurses package that queries
		the terminfo database to provide terminal-dependent capabilities
		(e.g. clear screen, set colors, get terminal size).

		Common uses:
		  tput cols     - number of columns
		  tput lines    - number of lines
		  tput clear    - clear screen
		  tput bold     - enable bold
		  tput sgr0     - reset attributes

		https://invisible-island.net/ncurses/

if FREETZ_PACKAGE_TPUT

config FREETZ_PACKAGE_TPUT_infocmp
	bool "infocmp (terminfo decompiler)"
	default n
	help
		infocmp prints the capabilities of a terminal type, comparing or
		printing terminfo descriptions. Useful for debugging terminal issues.

config FREETZ_PACKAGE_TPUT_reset
	bool "reset / clear"
	default n
	help
		reset and clear are simple programs that emit terminal control
		sequences. reset initializes the terminal, clear clears the screen.

config FREETZ_PACKAGE_TPUT_tic
	bool "tic (terminfo compiler)"
	default n
	help
		tic is the terminfo compiler from the ncurses package. It translates
		terminfo source files into the compiled binary format used by
		ncurses-based programs. Useful for installing new terminal types
		or fixing the terminfo database on the target device.

endif # FREETZ_PACKAGE_TPUT
```

## make/pkgs/ttyd-cgi/Config.in
```kconfig
config FREETZ_PACKAGE_TTYD_CGI
	bool "Web Terminal (ttyd CGI)"
	depends on FREETZ_PACKAGE_TTYD
	select FREETZ_BUSYBOX_START_STOP_DAEMON
	help
		Provides the freetz CGI control page for ttyd, including
		service management and the embedded web terminal UI.
```

## make/pkgs/ttyd/Config.in
```kconfig
config FREETZ_PACKAGE_TTYD
	bool "ttyd 1.7.7"
	depends on FREETZ_TARGET_GCC_5_MIN
	depends on FREETZ_TARGET_UCLIBC_1_0_58_MIN
	select FREETZ_LIB_libuv
	select FREETZ_LIB_libwebsockets
	select FREETZ_LIB_libjson_c
	select FREETZ_LIB_libz
	default n
	help
		ttyd is a simple command-line tool for sharing a terminal over
		the web. Powered by libwebsockets with an embedded xterm.js
		terminal frontend.

		The web interface is embedded in the CGI control page of this
		package and connects to the ttyd WebSocket server.

		Access: http://fritz.box:81/cgi-bin/conf/ttyd
		ttyd WebSocket: http://fritz.box:7681/

		Project homepage:
		https://github.com/tsl0922/ttyd

if FREETZ_PACKAGE_TTYD

config FREETZ_PACKAGE_TTYD_CGI
	bool "Web Terminal (ttyd CGI)"
	default y
	help
		Provides the freetz CGI control page for ttyd, including
		service management and the embedded web terminal UI.
		This is the same symbol shown in "Packages -> Web interfaces".

config FREETZ_PACKAGE_TTYD_PORT
	int "Default port"
	depends on FREETZ_PACKAGE_TTYD_CGI
	default 7681
	help
		TCP port on which the ttyd web/WebSocket server will listen.
		Default: 7681

endif
```

## make/pkgs/tuya-iot-core-sdk/Config.in
```kconfig
config FREETZ_PACKAGE_TUYA_IOT_CORE_SDK
	bool "tuya-iot-core-sdk (Tuya IoT Core SDK for C)"
	depends on FREETZ_TARGET_UCLIBC_1_0_58_MIN
	default n
	help
		Tuya IoT Core SDK for C: MQTT/TLS connection of a device to the
		Tuya Cloud, including the data model, OTA and sub-device APIs.
		mbedTLS, coreMQTT, coreHTTP and coreJSON are bundled.

		The upstream example programs are built and installed; they get
		their device credentials from the environment (the upstream
		values are only placeholders):

		 TUYA_PRODUCT_ID=... TUYA_DEVICE_ID=... TUYA_DEVICE_SECRET=... \
			/mnt/data/tuya/usr/bin/data_model_basic_demo

		TUYA_MQTT_HOST can be set to select another data centre
		(default: m1.tuyacn.com).

		Installs:
		 - /usr/bin/custom_protocol_basic_demo
		 - /usr/bin/data_model_basic_demo
		 - /usr/bin/ota_basic_demo
		 - /usr/bin/subdevice_basic_demo

		Requires uClibc 1.0.58 or newer.

		https://github.com/tuya/tuya-iot-core-sdk
```

## make/pkgs/tuyapp/Config.in
```kconfig
config FREETZ_PACKAGE_TUYAPP
	bool "tuyapp (local Tuya API client tools)"
	depends on FREETZ_TARGET_UCLIBC_1_0_58_MIN
	select FREETZ_LIB_libjsoncpp
	select FREETZ_LIB_libcrypto
	select FREETZ_LIB_libssl
	default n
	help
		tuyapp is a small C++ client library for the Local Tuya API,
		shipped together with a set of ready to use command line
		clients that talk directly to Tuya devices on the local
		network (no cloud round trip).

		It was written as a lightweight replacement for the Python
		based tinytuya project, specifically targeting embedded
		machines.

		Installs these clients in /usr/bin:
		 - tuya_switch              read state, or switch on|off|toggle
		 - tuya_status              dump all data points (DPS)
		 - tuya_kwh_meter           poll a single energy meter
		 - tuya_multi_kwh_meter     poll several energy meters
		 - tuya_monitor_and_control combined monitor and control

		The clients that need device credentials read a
		"tuya-devices.json" file from the current directory.
		A documented sample is installed at
		 /usr/share/tuyapp/tuya-devices.json.sample

		Protocol versions 3.3, 3.4 and 3.5 are supported and the
		OpenSSL crypto backend is used.

		Requires uClibc 1.0.58 or newer (C++14 toolchain and the
		jsoncpp dependency).

		https://github.com/gordonb3/tuyapp
```

## make/pkgs/udpcast/Config.in
```kconfig
config FREETZ_PACKAGE_UDPCAST
	bool "udpcast 20250223 (binary only)"
	default n
	help
		udpcast is a multicast file transfer tool used by cloning workflows.
		This package installs udp-sender and udp-receiver.
```

## make/pkgs/unixodbc/Config.in
```kconfig
config FREETZ_PACKAGE_UNIXODBC
	bool "unixODBC 2.3.12 (tools)"
	select FREETZ_LIB_libodbc
	select FREETZ_LIB_libodbcinst
	select FREETZ_LIB_libodbccr
	default n
	help
		unixODBC tools package.
		Installs isql, iusql and odbcinst.
```
