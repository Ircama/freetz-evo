## make/pkgs/util-linux/Config.in
```kconfig
config FREETZ_PACKAGE_UTIL_LINUX
	bool "util-linux (Linux disk utilities)"
	# TODO: util-linux' libsysfs requires fdopendir, which is missing in uClibc-0.9.28/0.9.29
	depends on !FREETZ_TARGET_UCLIBC_0_9_28 && !FREETZ_TARGET_UCLIBC_0_9_29
	default n
	help
		Provides essential disk and block device utilities from util-linux project.

if FREETZ_PACKAGE_UTIL_LINUX

choice
	prompt "util-linux version"
	default FREETZ_UTIL_LINUX_VERSION_2_27_1 if FREETZ_TARGET_UCLIBC_0_9_32 || FREETZ_TARGET_UCLIBC_0_9_33 || FREETZ_TARGET_GCC_5_MAX || !FREETZ_TARGET_UCLIBC_1_0_58
	default FREETZ_UTIL_LINUX_VERSION_2_41

	config FREETZ_UTIL_LINUX_VERSION_2_27_1
		bool "2.27.1 (legacy - minimal, for old devices)"
		help
			Legacy version 2.27.1 (November 2015) - minimal build.
			
			Provides only:
			- blkid: Block device identification
			
			Recommended for old toolchains (uClibc 0.9.x or GCC <= 5.5).
			Includes 7 patches for old uClibc/toolchain compatibility.
			Automatically selected for uClibc 0.9.32/0.9.33 or GCC 5.x and older.

	config FREETZ_UTIL_LINUX_VERSION_2_41
		bool "2.41 (modern - full featured)"
		depends on FREETZ_TARGET_UCLIBC_1_0_58
		help
			Modern version 2.41 (August 2022) - full featured build.
			
			Provides configurable utilities (see below for selection).
			
			Requires uClibc 1.0.58 or newer (fails to build on the
			older toolchains). On older toolchains use 2.27.1 instead.
			All legacy patches applied upstream.

endchoice

if FREETZ_UTIL_LINUX_VERSION_2_41

menu "Utilities selection"

config FREETZ_UTIL_LINUX_BLKID
	bool "blkid - identify block devices (renamed to blkid-ng)"
	select FREETZ_LIB_libblkid
	default y
	help
		blkid is used to identify block device attributes such as
		filesystem type, UUID, LABEL, etc.
		
		Conflicts with busybox blkid, renamed to blkid-ng.

config FREETZ_UTIL_LINUX_FDISK
	bool "fdisk - partition table manipulator (renamed to fdisk-ng)"
	select FREETZ_LIB_libncursesw
	select FREETZ_LIB_libfdisk
	select FREETZ_LIB_libsmartcols
	default y
	help
		fdisk is a dialog-driven utility to create and manipulate partition
		tables.

		Conflicts with busybox fdisk, renamed to fdisk-ng).

config FREETZ_UTIL_LINUX_SFDISK
	bool "sfdisk - scriptable partition table tool (renamed to sfdisk-ng)"
	select FREETZ_LIB_libncursesw
	select FREETZ_LIB_libfdisk
	select FREETZ_LIB_libsmartcols
	default y
	help
		sfdisk is a script-oriented partition table utility.

		Conflicts with busybox sfdisk, renamed to sfdisk-ng).

config FREETZ_UTIL_LINUX_BLOCKDEV
	bool "blockdev - call block-device ioctls (renamed to blockdev-ng)"
	default y
	help
		blockdev allows getting/setting low-level block device parameters
		and triggering ioctls like partition table reread.
		
		Conflicts with busybox blockdev, renamed to blockdev-ng.

config FREETZ_UTIL_LINUX_PARTX
	bool "partx/addpart/delpart/resizepart - partition table helpers"
	select FREETZ_LIB_libblkid
	select FREETZ_LIB_libsmartcols
	default y
	help
		partx tells the kernel about partition table changes.
		This switch also installs addpart, delpart, and resizepart.

config FREETZ_UTIL_LINUX_FINDFS
	bool "findfs - find filesystem by LABEL/UUID"
	select FREETZ_LIB_libblkid
	default y
	help
		findfs finds a filesystem by LABEL or UUID.

config FREETZ_UTIL_LINUX_WIPEFS
	bool "wipefs - wipe filesystem/partition signatures"
	select FREETZ_LIB_libblkid
	select FREETZ_LIB_libsmartcols
	default y
	help
		wipefs erases filesystem, RAID or partition-table signatures.

config FREETZ_UTIL_LINUX_LOSETUP
	bool "losetup - manage loop devices (renamed to losetup-ng)"
	select FREETZ_LIB_libsmartcols
	default y
	help
		losetup is used to associate loop devices with regular files
		or block devices, to detach loop devices, and to query the
		status of a loop device.
		
		Conflicts with busybox losetup, renamed to losetup-ng.

config FREETZ_UTIL_LINUX_MKSWAP
	bool "mkswap - create swap area (renamed to mkswap-ng)"
	default y
	help
		mkswap sets up a Linux swap area on a device or in a file.
		
		Conflicts with busybox mkswap, renamed to mkswap-ng.

config FREETZ_UTIL_LINUX_SWAPON
	bool "swapon/swapoff - enable/disable swap (renamed to *-ng)"
	select FREETZ_LIB_libblkid
	select FREETZ_LIB_libmount
	select FREETZ_LIB_libsmartcols
	default y
	help
		swapon is used to activate swap areas.
		swapoff is used to deactivate swap areas.
		
		Conflicts with busybox swapon, renamed to swapon-ng and swapoff-ng.

config FREETZ_UTIL_LINUX_LSBLK
	bool "lsblk - list block devices"
	select FREETZ_LIB_libncursesw
	select FREETZ_LIB_libblkid
	select FREETZ_LIB_libmount
	select FREETZ_LIB_libsmartcols
	default y
	help
		lsblk lists information about all available or specified block
		devices. It reads the sysfs filesystem and udev db to gather
		information.
		
		Requires ncursesw library for colored output.
		Unique to util-linux (no busybox equivalent).

config FREETZ_UTIL_LINUX_LSFD
	bool "lsfd - list open file descriptors"
	depends on FREETZ_KERNEL_VERSION_5_MIN
	select FREETZ_LIB_libsmartcols
	default y
	help
		lsfd lists open file descriptors and their associated objects.

		Requires BPF_OBJ_NAME_LEN in linux/bpf.h from target kernel
		headers (not available on many 4.x kernel toolchains).

config FREETZ_UTIL_LINUX_CFDISK
	bool "cfdisk - curses partition editor"
	select FREETZ_LIB_libncursesw
	select FREETZ_LIB_libfdisk
	select FREETZ_LIB_libmount
	select FREETZ_LIB_libsmartcols
	default y
	help
		cfdisk displays and manipulates the partition table in a
		curses-based user interface.
		
		Requires libfdisk support in util-linux and ncursesw library.
		Unique to util-linux (no busybox equivalent).

config FREETZ_UTIL_LINUX_FINDMNT
	bool "findmnt - find mounted filesystems"
	select FREETZ_LIB_libblkid
	select FREETZ_LIB_libmount
	select FREETZ_LIB_libsmartcols
	default y
	help
		findmnt will list all mounted filesystems or search for a
		filesystem. It can search in /etc/fstab, /etc/mtab or /proc/self/mountinfo.
		
		Unique to util-linux (no busybox equivalent).

config FREETZ_UTIL_LINUX_UNSHARE
	bool "unshare - run program with unshared namespaces (renamed to unshare-ng)"
	depends on !FREETZ_TARGET_UCLIBC_0_9_32
	default y
	help
		unshare runs a program with some namespaces unshared from the parent.

		Can conflict with busybox unshare, renamed to unshare-ng.

config FREETZ_UTIL_LINUX_UUIDGEN
	bool "uuidgen - create UUIDs (renamed to uuidgen-ng)"
	select FREETZ_LIB_libuuid
	default y
	help
		uuidgen creates new UUID values.

		Can conflict with busybox uuidgen, renamed to uuidgen-ng.

config FREETZ_UTIL_LINUX_UUIDPARSE
	bool "uuidparse - parse and format UUIDs"
	select FREETZ_LIB_libuuid
	select FREETZ_LIB_libsmartcols
	default y
	help
		uuidparse parses and formats UUID values.

config FREETZ_UTIL_LINUX_LASTLOG2
	bool "lastlog2 - display recent login information"
	select FREETZ_LIB_liblastlog2
	default n
	help
		lastlog2 displays recent login information from the lastlog2
		database.

config FREETZ_UTIL_LINUX_MOUNTPOINT
	bool "mountpoint - check if directory is a mount point"
	select FREETZ_LIB_libmount
	default n
	help
		mountpoint checks whether a directory or file is a mountpoint.
		Replaces the standalone mountpoint package.
		
		Unique to util-linux (no busybox equivalent).

endmenu

endif # FREETZ_UTIL_LINUX_VERSION_2_41

endif # FREETZ_PACKAGE_UTIL_LINUX
```

## make/pkgs/valgrind/Config.in
```kconfig
config FREETZ_PACKAGE_VALGRIND
	bool "Valgrind 3.27.0"
	depends on FREETZ_KERNEL_VERSION_3_MIN
	select FREETZ_LIB_libdl if FREETZ_TARGET_UCLIBC_HAS_multiple_libs
	select FREETZ_LIB_libpthread if FREETZ_TARGET_UCLIBC_HAS_multiple_libs
	select FREETZ_LIB_librt if FREETZ_TARGET_UCLIBC_HAS_multiple_libs
	default n
	help
		Instrumentation framework for memory debugging and profiling.

		This package installs the core Valgrind executables and the
		runtime payload under /usr/lib/valgrind.

		Helper scripts requiring perl or python3 on the target are omitted.
```

## make/pkgs/vhs/Config.in
```kconfig
config FREETZ_PACKAGE_VHS
	bool "vhs 0.11.0 (binary only)"
	depends on FREETZ_TARGET_UCLIBC_1_0_58_MIN
	select FREETZ_PACKAGE_FFMPEG
	select FREETZ_PACKAGE_FFMPEG_ffmpeg
	select FREETZ_PACKAGE_FFMPEG_DECODER_png
	select FREETZ_PACKAGE_FFMPEG_DEMUXER_image2
	select FREETZ_PACKAGE_FFMPEG_PROTOCOL_file
	select FREETZ_PACKAGE_TTYD
	default n
	help
		VHS records scripted terminal sessions to media output.

		This package cross-compiles the upstream Go sources and installs the
		vhs executable on the target.

		Upstream requires the `ffmpeg` and `ttyd` executables at runtime.
		The Freetz package auto-selects them, including the minimal FFmpeg
		options needed for PNG frame sequences and GIF output.

		Can be externalized to save flash memory.
```

## make/pkgs/wavemon/Config.in
```kconfig
config FREETZ_PACKAGE_WAVEMON
	bool "wavemon 0.9.7 (binary only)"
	select FREETZ_LIB_libm         if FREETZ_TARGET_UCLIBC_HAS_multiple_libs
	select FREETZ_LIB_libpthread   if FREETZ_TARGET_UCLIBC_HAS_multiple_libs
	select FREETZ_LIB_libncursesw
	select FREETZ_LIB_libnl
	default n
	help
		wavemon is an ncurses-based wireless device monitoring application.
```

## make/pkgs/wish/Config.in
```kconfig
config FREETZ_PACKAGE_WISH
	bool "wish 8.6.16"
	select FREETZ_LIB_libtk
	default n
	help
		Wish is the Tcl/Tk shell interpreter.
		Use with DISPLAY=<remote-host>:0.
```

## make/pkgs/xclock/Config.in
```kconfig
config FREETZ_PACKAGE_XCLOCK
	bool "xclock 1.1.1"
	select FREETZ_LIB_libXaw
	select FREETZ_LIB_libXmu
	select FREETZ_LIB_libX11
	select FREETZ_LIB_libXext
	select FREETZ_LIB_libXt
	default n
	help
		X11 clock application.
		Use with DISPLAY=<remote-host>:0.
```

## make/pkgs/xeyes/Config.in
```kconfig
config FREETZ_PACKAGE_XEYES
	bool "xeyes 1.3.1"
	select FREETZ_LIB_libXi
	select FREETZ_LIB_libXmu
	select FREETZ_LIB_libX11
	select FREETZ_LIB_libXt
	select FREETZ_LIB_libXext
	default n
	help
		X11 eyes application.
		Use with DISPLAY=<remote-host>:0.
```

## make/pkgs/xterm/Config.in
```kconfig
config FREETZ_PACKAGE_XTERM
	bool "xterm 410"
	select FREETZ_LIB_libXmu
	select FREETZ_LIB_libX11
	select FREETZ_LIB_libXt
	select FREETZ_LIB_libXext
	select FREETZ_PACKAGE_NCURSES
	default n
	help
		X11 terminal emulator.
		Use with DISPLAY=<remote-host>:0.
```

## make/pkgs/yazi/Config.in
```kconfig
config FREETZ_PACKAGE_YAZI
	bool "yazi 26.5.6"
	depends on FREETZ_TARGET_UCLIBC_1_0_58_MIN
	default n
	help
		yazi utility package built from source using Rust/Cargo.
```

## make/pkgs/yq/Config.in
```kconfig
config FREETZ_PACKAGE_YQ
	bool "yq 4.53.2 (binary only)"
	default n
	help
		yq is a lightweight command-line YAML, JSON and XML processor.

		This package cross-compiles the upstream Go sources and installs the
		yq executable on the target.

		Can be externalized to save flash memory.
```

## make/pkgs/zoxide/Config.in
```kconfig
config FREETZ_PACKAGE_ZOXIDE
	bool "zoxide 0.9.9"
	depends on FREETZ_TARGET_UCLIBC_1_0_58_MIN
	default n
	help
		zoxide is a smarter cd companion that jumps to frequently used directories.
```
