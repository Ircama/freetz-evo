## make/pkgs/lf/Config.in
```kconfig
config FREETZ_PACKAGE_LF
	bool "lf r41 (binary only)"
	default n
	help
		lf is a terminal file manager written in Go.

		This package cross-compiles the upstream Go sources and installs the
		lf executable on the target.

		Can be externalized to save flash memory.
```

## make/pkgs/lnav-rs/Config.in
```kconfig
config FREETZ_PACKAGE_LNAV_RS
	bool "lnav-rs 0.1.0"
	depends on FREETZ_TARGET_UCLIBC_1_0_58
	default n
	help
		lnav-rs utility package built from source using Rust/Cargo.
```

## make/pkgs/lnav/Config.in
```kconfig
config FREETZ_PACKAGE_LNAV
	bool "lnav 0.14.0"
	select FREETZ_LIB_libatomic if FREETZ_TARGET_ARCH_MIPS && FREETZ_TARGET_GCC_4_8_MIN
	select FREETZ_LIB_libarchive
	default n
	help
		Advanced log file viewer and analyzer for the terminal.
		This is the native C/C++ lnav package for the target system.

if FREETZ_PACKAGE_LNAV

config FREETZ_PACKAGE_LNAV_WITH_CARGO
	bool "Build optional Rust extensions (PRQL support)"
	default n
	help
		Enable the bundled Rust/Cargo extension library used by upstream
		lnav for PRQL-related functionality.

		This keeps the default package lean, but allows the Rust-backed
		feature set to be built when the Rust host toolchain is available.

endif
```

## make/pkgs/matter-bridge/Config.in
```kconfig
config FREETZ_PACKAGE_MATTER_BRIDGE
	bool "matter-bridge 0.1 (native Matter controller for Domoticz)"
	depends on FREETZ_TARGET_UCLIBC_1_0_58_MIN
	depends on FREETZ_TARGET_IPV6_SUPPORT
	select FREETZ_LIB_libpthread if FREETZ_TARGET_UCLIBC_HAS_multiple_libs
	select FREETZ_LIB_librt if FREETZ_TARGET_UCLIBC_HAS_multiple_libs
	default n
	help
		Native Rust/rs-matter controller and WebSocket JSON server in one
		daemon. Domoticz connects to 127.0.0.1:5580 using its Matter hardware
		driver. No Node.js, Python server or external controller is required.

		For the local freetz-matter accessory, commissioning is automatic
		when its commissioning window is open. Run matter-bridge-setup to
		enable and start both services, then add Matter hardware in Domoticz
		with host 127.0.0.1, port 5580. Run modsave after commissioning.

		The controller persists its fabric, reads real attributes, subscribes
		to reports and sends OnOff/LevelControl commands over CASE.
		This is a known-address, already-networked-device controller, not
		a full python-matter-server replacement or certified Matter product.
		Multicast discovery, Wi-Fi/Thread provisioning and verified Device
		Attestation are not implemented. Test attestation is accepted only
		for loopback by default; remote use requires explicit opt-in.

		The WebSocket API binds to loopback and has no authentication.
		Do not expose it to an untrusted network. Fabric keys and nodes
		live in /tmp/flash/matter-bridge; back up both controller and device
		stores before upgrading firmware.

		Building requires Rust nightly and substantial RAM; builds are
		serialized. matter-bridge-ctl is a standalone diagnostic tool,
		not a second service required by Domoticz.
		See docs/make/matter-bridge.md for scope and verification.

		Can be externalized: /usr/bin/matter-bridge and
		/usr/bin/matter-bridge-ctl. Init/config/fabric remain on the box.
```

## make/pkgs/mediainfo/Config.in
```kconfig
config FREETZ_PACKAGE_MEDIAINFO
	bool "MediaInfo 25.10"
	depends on FREETZ_TARGET_GCC_4_7_MIN
	select FREETZ_LIB_libmediainfo
	default n
	help
		MediaInfo - multimedia file analyzer

		MediaInfo is a convenient unified display of the most relevant technical
		and tag data for video and audio files.

		It displays general information about the file (name, size, creation date...)
		and technical information about the codecs used (audio: codec, bitrate,
		sample rate, language; video: codec, bitrate, frame rate, resolution...)

		This is the command line interface (CLI) version.

		Requires GCC 4.7 or newer: MediaInfoLib compiles with -std=c++11
		(AM_CXXFLAGS in Makefile.am), which the old GCC 4.6.4 toolchain
		does not recognize.
```

## make/pkgs/melcloud/Config.in
```kconfig
config FREETZ_PACKAGE_MELCLOUD
	bool "MELCloud CLI + CGI dashboard"
	select FREETZ_LIB_libcurl
	select FREETZ_LIB_libcurl_WITH_SSL
	select FREETZ_LIB_libcurl_WITH_CA_BUNDLE
	select FREETZ_BUSYBOX_START_STOP_DAEMON
	default n
	help
		Reverse-engineered MELCloud integration with:
		- melcloud-cli (C)
		- /cgi-bin/conf/melcloud configuration page
		- /melcloud/index.html full monitoring/control GUI

		Use at your own risk: MELCloud API is unofficial and may change.

		Access the configuration page:
		http://fritz.box:81/cgi-bin/conf/melcloud
```

## make/pkgs/micronucleus/Config.in
```kconfig
config FREETZ_PACKAGE_MICRONUCLEUS
	bool "micronucleus 2.6"
	default n
	select FREETZ_LIB_libusb
	help
		Micronucleus bootloader command line utility.
		
		Installs:
		 - micronucleus: USB uploader for Digispark/ATTiny
		   Micronucleus bootloader targets.
		
		Usage example:
		 micronucleus --run firmware.hex
```
