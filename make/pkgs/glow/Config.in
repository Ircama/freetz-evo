## make/pkgs/glow/Config.in
```kconfig
config FREETZ_PACKAGE_GLOW
	bool "glow 2.1.2 (binary only)"
	default n
	help
		Glow renders Markdown on the CLI.

		This package cross-compiles the upstream Go sources and installs the
		glow executable on the target.

		Can be externalized to save flash memory.
```

## make/pkgs/go-librespot-cgi/Config.in
```kconfig
config FREETZ_PACKAGE_GO_LIBRESPOT_CGI
	bool "go-librespot CGI (Spotify Connect config/status web UI)"
	depends on FREETZ_PACKAGE_GO_LIBRESPOT
	select FREETZ_BUSYBOX_START_STOP_DAEMON
	default y
	help
		Provides the freetz CGI configuration page and live status page for
		go-librespot.

		Includes startup handling, runtime YAML generation and log-based
		service monitoring in the freetz web UI.

		http://fritz.box:81/cgi-bin/conf/go-librespot
```

## make/pkgs/go-librespot/Config.in
```kconfig
config FREETZ_PACKAGE_GO_LIBRESPOT
	bool "go-librespot 0.7.1 (binary only)"
	depends on FREETZ_TARGET_GCC_4_7_MIN
	select FREETZ_LIB_libasound
	select FREETZ_LIB_libFLAC
	select FREETZ_LIB_libogg
	select FREETZ_LIB_libvorbis
	select FREETZ_LIB_libvorbisenc
	select FREETZ_MODULE_snd_usb_audio if FREETZ_MODULES_AUDIO_AVAILABLE
	default n
	help
		go-librespot is a Spotify Connect audio daemon.

		This package cross-compiles the upstream Go daemon sources with
		CGO and installs the go-librespot executable on the target.

		Requires GCC 4.7 or newer: Go's cgo runtime (gcc_libinit.c)
		uses the C11 atomic builtins (__atomic_load_n, __atomic_store_n,
		__ATOMIC_*), which the old GCC 4.6.4 toolchain does not provide.

		Can be externalized to save flash memory.

if FREETZ_PACKAGE_GO_LIBRESPOT

config FREETZ_PACKAGE_GO_LIBRESPOT_CGI
	bool "go-librespot CGI (Spotify Connect config/status web UI)"
	default y
	help
		Provides the freetz CGI configuration page and live status page for
		go-librespot.
		This is the same symbol shown in "Packages -> Web interfaces".

endif
```

## make/pkgs/gptfdisk/Config.in
```kconfig
config FREETZ_PACKAGE_GPTFDISK
	bool "gptfdisk 1.0.10"
	select FREETZ_LIB_libm if FREETZ_TARGET_UCLIBC_HAS_multiple_libs
	select FREETZ_LIB_STDCXXLIB
	select FREETZ_LIB_libuuid
	default n
	help
		Interactive GUID partition table (GPT) manipulator

if FREETZ_PACKAGE_GPTFDISK

	config FREETZ_PACKAGE_GPTFDISK_gdisk
		bool "gdisk"
		default y
		help
			This option enables the GPT partition editor.

	config FREETZ_PACKAGE_GPTFDISK_cgdisk
		bool "cgdisk"
		select FREETZ_LIB_libncursesw
		default n
		help
			This option enables the curses-based GPT partition editor.

	config FREETZ_PACKAGE_GPTFDISK_sgdisk
		bool "sgdisk"
		select FREETZ_LIB_libpopt
		default n
		help
			This option enables the command-line GPT partition tool.

	config FREETZ_PACKAGE_GPTFDISK_fixparts
		bool "fixparts"
		default n
		help
			This option enables the MBR repair/partition tool.

endif # FREETZ_PACKAGE_GPTFDISK
```

## make/pkgs/grafana/Config.in
```kconfig
config FREETZ_PACKAGE_GRAFANA
	bool "Grafana 13.2.4"
	depends on FREETZ_TARGET_GCC_4_7_MIN
	select FREETZ_LIB_libpthread if FREETZ_TARGET_UCLIBC_HAS_multiple_libs
	select FREETZ_LIB_libdl if FREETZ_TARGET_UCLIBC_HAS_multiple_libs
	default n
	help
		Grafana is an open-source monitoring and visualization platform.
		Cross-compiles the OSS backend and installs the matching official
		frontend assets. The build downloads the Go 1.26.9 toolchain.

		Requires persistent USB storage and substantial free RAM (upstream
		recommends at least 512 MB). Externalize the binary and web assets:
		they are much too large for normal router flash memory.

		Configure through the Freetz web interface; Grafana listens on port
		3000. The service is disabled by default. Keep it on a trusted LAN.
		See https://grafana.com/oss/grafana/
```

## make/pkgs/gum/Config.in
```kconfig
config FREETZ_PACKAGE_GUM
	bool "gum 0.17.0 (binary only)"
	default n
	help
		Gum provides reusable TUI components for shell scripts.

		This package cross-compiles the upstream Go sources and installs the
		gum executable on the target.

		Can be externalized to save flash memory.
```

## make/pkgs/hey/Config.in
```kconfig
config FREETZ_PACKAGE_HEY
	bool "hey 0.1.5 (binary only)"
	default n
	help
		hey is a small HTTP load generator.

		This package cross-compiles the upstream Go sources and installs the
		hey executable on the target.

		Can be externalized to save flash memory.
```

## make/pkgs/hidws-cgi/Config.in
```kconfig
config FREETZ_PACKAGE_HIDWS_CGI
	bool "hidws CGI (freetz configuration web page)"
	depends on FREETZ_PACKAGE_HIDWS
	select FREETZ_BUSYBOX_START_STOP_DAEMON
	help
		Provides the freetz CGI configuration page and execution log for
		the hidws WebSocket <-> USB HID gateway daemon.

		Includes the init script (rc.hidws), the default configuration and
		the CGI script for managing hidws via the freetz web UI, plus links
		to the supported web apps (fiiocontrol, kt02h20-control,
		Audiocular-Aura, fiiocontrol-oss, webhid-explorer) that connect to
		the daemon over WebSocket.

		http://fritz.box:81/cgi-bin/conf/hidws
```

## make/pkgs/hidws/Config.in
```kconfig
menuconfig FREETZ_PACKAGE_HIDWS
        bool "hidws 1.3.1 (binary only)"
        depends on FREETZ_TARGET_UCLIBC_1_0_58_MIN
        select FREETZ_LIB_hidapi
        select FREETZ_LIB_libwebsockets
        select FREETZ_LIB_libwebsockets_WITH_SSL
        select FREETZ_LIB_libssl
        default n
        help
                Generic WebSocket to HID gateway daemon (libusb backend).

                Requires uClibc 1.0.58 or newer: hidws links against
                libwebsockets which needs libuv, and libuv on older
                toolchains (GCC <= 5 / uClibc 0.9.x-1.0.14) fails to link
                with "undefined reference to pthread_atfork".

                hidws is a daemon that bridges WebSocket clients to USB
                HID devices. It uses libwebsockets for the WebSocket
                server and hidapi (libusb backend) for HID access, so it
                also works on routers where the kernel HID/INPUT
                subsystem is unavailable (e.g. GRX5 models).

                hid-list is a diagnostic utility that lists all USB HID
                devices and the reports they support.

                Any web app can use hidws to talk to HID devices
                remotely over WebSocket:
                  - {"cmd":"list"} — list HID devices
                  - {"cmd":"open","vendorId":...,"productId":...}
                  - {"cmd":"send_report","reportId":...,"data":[...]}
                  - {"cmd":"send_feature_report","reportId":...,"data":[...]}
                  - {"cmd":"close"}
                Responses arrive as {"type":"device_list"},
                {"type":"opened"}, {"type":"input_report"} or
                {"type":"error"}.

                Run: hidws [port]   (default port: 9001)
                Web app access: ws://fritz.box:9001

                SSL/TLS (wss://) support is enabled: hidws serves both
                ws:// and wss:// on the same port, and generates a
                self-signed certificate automatically on first start
                (see the hidws web config page). This is required on
                HTTPS-hosted web apps (e.g. GitHub Pages) that block
                plain ws:// connections.

                Protocol based on the Audiocular Aura backend:
                https://github.com/mandy321/Audiocular-Aura

if FREETZ_PACKAGE_HIDWS

        config FREETZ_PACKAGE_HIDWS_CGI
                bool "hidws CGI (freetz configuration web page)"
                default y
                help
                        Provides a freetz web configuration page for the hidws
                        daemon: init script, default config and web UI with the
                        startup log and links to the supported web apps.

                        This is the same symbol shown in
                        "Packages -> Web interfaces".

endif # FREETZ_PACKAGE_HIDWS
```

## make/pkgs/homeassistant/Config.in
```kconfig
config FREETZ_PACKAGE_HOMEASSISTANT
	bool "Home Assistant (setup helper + autorun)"
	depends on FREETZ_TARGET_UCLIBC_1_0_58_MIN
	select FREETZ_PACKAGE_PYTHON3
	select FREETZ_LIB_libffi
	select FREETZ_LIB_libz
	select FREETZ_LIB_libatomic
	default n
	help
		Installs the "ha-setup" helper, a modconf configuration set and the
		init script that can start Home Assistant at boot.

		Home Assistant itself is NOT cross-compiled: /usr/bin/ha-setup
		bootstraps pip and installs it (plus its dependencies) into a prefix
		on external storage, e.g.

		    ha-setup --basedir /var/media/ftp/homeassistant

		Requires a USB stick or NAS formatted with ext4, at least ~1.5 GB
		free, swap (Home Assistant is memory hungry) and Internet access
		during the setup. Configuration: /mod/etc/default.homeassistant/

		Web interface: http://fritz.box:8123 (after the first setup)
		Authorun: enable "homeassistant" in the Freetz init-script list.

		Can be externalized (External menu): only /usr/bin/ha-setup is moved to
		external storage, since Home Assistant itself is installed there anyway
		by the setup helper.

choice
	prompt "Python support for Home Assistant"
	depends on FREETZ_PACKAGE_HOMEASSISTANT
	default FREETZ_PACKAGE_HOMEASSISTANT_PY_MINIMAL

config FREETZ_PACKAGE_HOMEASSISTANT_PY_MINIMAL
	bool "Minimal - modules required to run Home Assistant"
	select FREETZ_LIB_libssl
	select FREETZ_LIB_libcrypto
	select FREETZ_LIB_libsqlite3
	select FREETZ_LIB_libreadline
	select FREETZ_LIB_libncurses
	select FREETZ_PACKAGE_PYTHON3_MOD_SSL
	select FREETZ_PACKAGE_PYTHON3_MOD_CTYPES
	select FREETZ_PACKAGE_PYTHON3_MOD_SQLITE
	select FREETZ_PACKAGE_PYTHON3_MOD_MULTIPROCESSING
	select FREETZ_PACKAGE_PYTHON3_MOD_JSON
	select FREETZ_PACKAGE_PYTHON3_MOD_ELEMENTTREE
	select FREETZ_PACKAGE_PYTHON3_MOD_CSV
	select FREETZ_PACKAGE_PYTHON3_MOD_UNICODEDATA
	select FREETZ_PACKAGE_PYTHON3_MOD_READLINE
	select FREETZ_PACKAGE_PYTHON3_MOD_MMAP
	select FREETZ_PACKAGE_PYTHON3_MOD_CRYPT
	select FREETZ_PACKAGE_PYTHON3_MOD_SYSLOG
	select FREETZ_PACKAGE_PYTHON3_MOD_TERMIOS
	help
		Selected by default: the interpreter modules the Home Assistant core
		and its C-based dependencies (cryptography, orjson, aiohttp,
		SQLAlchemy) really need, plus the libraries they link against.

config FREETZ_PACKAGE_HOMEASSISTANT_PY_FULL
	bool "Full - every Python module Freetz can build"
	select FREETZ_LIB_libssl
	select FREETZ_LIB_libcrypto
	select FREETZ_LIB_libsqlite3
	select FREETZ_LIB_libreadline
	select FREETZ_LIB_libncurses
	select FREETZ_LIB_libtinfo
	select FREETZ_LIB_libgmp
	select FREETZ_LIB_libexpat
	select FREETZ_LIB_libxml2
	select FREETZ_LIB_libyaml
	select FREETZ_LIB_libjpeg
	select FREETZ_LIB_libpng16
	select FREETZ_PACKAGE_PYTHON3_MOD_SSL
	select FREETZ_PACKAGE_PYTHON3_MOD_CTYPES
	select FREETZ_PACKAGE_PYTHON3_MOD_SQLITE
	select FREETZ_PACKAGE_PYTHON3_MOD_MULTIPROCESSING
	select FREETZ_PACKAGE_PYTHON3_MOD_JSON
	select FREETZ_PACKAGE_PYTHON3_MOD_ELEMENTTREE
	select FREETZ_PACKAGE_PYTHON3_MOD_CSV
	select FREETZ_PACKAGE_PYTHON3_MOD_UNICODEDATA
	select FREETZ_PACKAGE_PYTHON3_MOD_READLINE
	select FREETZ_PACKAGE_PYTHON3_MOD_MMAP
	select FREETZ_PACKAGE_PYTHON3_MOD_CRYPT
	select FREETZ_PACKAGE_PYTHON3_MOD_SYSLOG
	select FREETZ_PACKAGE_PYTHON3_MOD_TERMIOS
	select FREETZ_PACKAGE_PYTHON3_MOD_CMATH
	select FREETZ_PACKAGE_PYTHON3_MOD_CPROFILE
	select FREETZ_PACKAGE_PYTHON3_MOD_CURSES
	select FREETZ_PACKAGE_PYTHON3_MOD_AUDIODEV
	select FREETZ_PACKAGE_PYTHON3_MOD_AUDIOOP
	select FREETZ_PACKAGE_PYTHON3_MOD_BSDDB
	select FREETZ_PACKAGE_PYTHON3_MOD_EASTERN_CODECS
	select FREETZ_PACKAGE_PYTHON3_MOD_GRP
	select FREETZ_PACKAGE_PYTHON3_MOD_HOTSHOT
	select FREETZ_PACKAGE_PYTHON3_MOD_SPWD
	select FREETZ_PACKAGE_PYTHON3_MOD_TEST
	select FREETZ_PACKAGE_PYTHON3_MOD_UNITTEST
	select FREETZ_PACKAGE_PYTHON3_MOD_WSGIREF
	select FREETZ_PACKAGE_PYTHON3_MOD_TKINTER
	help
		Selects every Python module available in this tree. Useful when
		installing extra Home Assistant integrations with pip at runtime
		(the interpreter modules cannot be added later without a rebuild).

		Note: the Tkinter module also pulls the X11 libraries, and the
		AUDIODEV/AUDIOOP modules pull the OSS devices; both are rarely
		useful on a router.
endchoice
```

## make/pkgs/hugo/Config.in
```kconfig
config FREETZ_PACKAGE_HUGO
	bool "hugo 0.161.1 (binary only)"
	default n
	help
		Hugo is a fast static site generator.

		This package cross-compiles the upstream Go sources and installs the
		hugo executable on the target.

		Can be externalized to save flash memory.
```

## make/pkgs/influxdb3/Config.in
```kconfig
config FREETZ_PACKAGE_INFLUXDB3
	bool "InfluxDB 3.12.1 (experimental port)"
	select FREETZ_LIB_STDCXXLIB
	select FREETZ_LIB_libatomic
	select FREETZ_PACKAGE_PYTHON3
	select FREETZ_LIB_libpython3
	select FREETZ_BUSYBOX_START_STOP_DAEMON
	select FREETZ_BUSYBOX_WGET
	default n
	help
		InfluxDB 3 Core time-series database with SQL and InfluxQL.
		This is an experimental source port, not a prebuilt 64-bit binary.
		All Freetz Rust target mappings are used, including 32-bit targets;
		selection alone does not certify architecture or runtime compatibility.
		Top-level cloud backend and jemalloc features are not selected;
		transitive dependencies may still contain these libraries.
		The embedded Python processing engine remains part of the server.
		WASM UDFs are unavailable on targets without native 64-bit atomics,
		including MIPS; requesting them returns an explicit unsupported error.
		Substantial RAM and persistent external storage are required.
		Includes a configuration page and rc.influxdb3 service script.
		Startup is disabled by default, with an authenticated loopback
		listener. Select an existing data directory before enabling it.
```

## make/pkgs/ja11-config-tui/Config.in
```kconfig
config FREETZ_PACKAGE_JA11_CONFIG_TUI
	bool "ja11-config-tui 1.0 (binary only)"
	select FREETZ_LIB_libncurses
	select FREETZ_LIB_hidapi
	default n
	help
		TUI configurator for the FiiO JA11 (KT02H20).
		
		Communicates over HID with the KT02H20 chip inside the
		FiiO JadeAudio JA11 to configure the 5-band parametric EQ.
		
		Uses hidapi's libusb backend (like hidws), NOT hidraw:
		on startup it lists all HID devices and lets you choose which
		one to connect to.
		
		Access via SSH: ja11-config-tui
```

## make/pkgs/ja11-config/Config.in
```kconfig
config FREETZ_PACKAGE_JA11_CONFIG
	bool "ja11-config 1.0 (binary only)"
	depends on FREETZ_TARGET_GCC_4_7_MIN
	select FREETZ_LIB_libncurses
	select FREETZ_LIB_hidapi
	default n
	help
		FiiO JA11 (KT02H20) tools: TUI configurator plus firmware update.

		- ja11-config-tui: interactive 5-band parametric EQ configurator.
		  Communicates over HID using hidapi's libusb backend (like hidws),
		  NOT hidraw: on startup it lists all HID devices and lets you choose
		  which one to connect to.
		- ja11-boot: puts the device into firmware-update mode by sending an
		  HID output report; the device then re-enumerates as a USB CDC serial
		  port.
		- ja11-flash: flashes firmware over the update-mode serial port.

		Access via SSH:
		  ja11-config-tui               (EQ configuration)
		  ja11-boot                     (enter update mode)
		  ja11-flash /dev/ttyACM1 fw.bin (flash firmware)

		Requires GCC 4.7 or newer: the sources are compiled with
		-std=c11, which the old GCC 4.6.4 toolchain does not recognize.
```

## make/pkgs/jless/Config.in
```kconfig
config FREETZ_PACKAGE_JLESS
	bool "jless 0.9.0"
	depends on FREETZ_TARGET_UCLIBC_1_0_58
	default n
	help
		jless utility package built from source using Rust/Cargo.
```

## make/pkgs/lazygit/Config.in
```kconfig
config FREETZ_PACKAGE_LAZYGIT
	bool "lazygit 0.61.1 (binary only)"
	select FREETZ_PACKAGE_GIT
	default n
	help
		lazygit is a terminal UI for Git.

		This package cross-compiles the upstream Go sources and installs the
		lazygit executable on the target.

		Can be externalized to save flash memory.
```
