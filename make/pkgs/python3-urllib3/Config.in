## make/pkgs/python3-urllib3/Config.in
```kconfig
config FREETZ_PACKAGE_PYTHON3_URLLIB3
	bool "urllib3 2.8.0"
	depends on FREETZ_PACKAGE_PYTHON3
	default n
	help
		HTTP client with connection pooling, TLS verification and retry
		handling. It is the transport below requests and it is also used
		directly by some Domoticz plugins.
```

## make/pkgs/python3-uv/Config.in
```kconfig
config FREETZ_PACKAGE_PYTHON3_UV
	bool "uv 0.11.16"
	depends on FREETZ_PACKAGE_PYTHON3
	depends on FREETZ_TARGET_UCLIBC_1_0_58_MIN
	default n
	help
		uv 0.11.16

		An extremely fast Python package and project manager,
		written in Rust.

		WWW: https://github.com/astral-sh/uv
```

## make/pkgs/python3-voluptuous/Config.in
```kconfig
config FREETZ_PACKAGE_PYTHON3_VOLUPTUOUS
	bool "voluptuous 0.16.0 (pure python, prerequisite)"
	depends on FREETZ_PACKAGE_PYTHON3
	default n
	help
		voluptuous is a pure-Python prerequisite module.
		It is a Python data validation library.
```

## make/pkgs/python3-webrtc-models/Config.in
```kconfig
config FREETZ_PACKAGE_PYTHON3_WEBRTC_MODELS
	bool "webrtc-models 0.3.0"
	depends on FREETZ_PACKAGE_PYTHON3
	depends on FREETZ_TARGET_UCLIBC_1_0_58
	select FREETZ_PACKAGE_PYTHON3_MASHUMARO
	select FREETZ_PACKAGE_PYTHON3_ORJSON
	default n
	help
		Model definitions used by WebRTC-related Home Assistant components.
```

## make/pkgs/python3-yarl/Config.in
```kconfig
config FREETZ_PACKAGE_PYTHON3_YARL
	bool "yarl 1.24.2"
	depends on FREETZ_PACKAGE_PYTHON3
	select FREETZ_PACKAGE_PYTHON3_IDNA
	select FREETZ_PACKAGE_PYTHON3_MULTIDICT
	select FREETZ_PACKAGE_PYTHON3_PROPCACHE
	default n
	help
		yarl is a URL library for Python.
```

## make/pkgs/python3-zeroconf/Config.in
```kconfig
config FREETZ_PACKAGE_PYTHON3_ZEROCONF
	bool "zeroconf 0.149.16"
	depends on FREETZ_PACKAGE_PYTHON3
	select FREETZ_PACKAGE_PYTHON3_IFADDR
	default n
	help
		Multicast DNS service discovery library (pure Python mode).
```

## make/pkgs/python3-zope-event/Config.in
```kconfig
config FREETZ_PACKAGE_PYTHON3_ZOPE_EVENT
	bool "zope.event 6.2"
	depends on FREETZ_PACKAGE_PYTHON3
	default n
	help
		Event dispatch used by the Zope interface stack and by gevent.
```

## make/pkgs/python3-zope-interface/Config.in
```kconfig
config FREETZ_PACKAGE_PYTHON3_ZOPE_INTERFACE
	bool "zope.interface 8.6"
	depends on FREETZ_PACKAGE_PYTHON3
	default n
	help
		Interfaces and adapters (C extension) used by gevent and by the Zope stack.
```

## make/pkgs/quickjs/Config.in
```kconfig
config FREETZ_PACKAGE_QUICKJS
	bool "QuickJS 2026-03-23 snapshot (binary only)"
	default n
	select FREETZ_LIB_libatomic
	select FREETZ_LIB_libdl       if FREETZ_TARGET_UCLIBC_HAS_multiple_libs
	select FREETZ_LIB_libm        if FREETZ_TARGET_UCLIBC_HAS_multiple_libs
	select FREETZ_LIB_libpthread  if FREETZ_TARGET_UCLIBC_HAS_multiple_libs
	help
		QuickJS is a small and embeddable JavaScript engine.

if FREETZ_PACKAGE_QUICKJS

	config FREETZ_PACKAGE_QUICKJS_WITH_QJSC
		bool "Build qjsc compiler"
		default n
		help
			Build and install qjsc in addition to the qjs interpreter.

endif # FREETZ_PACKAGE_QUICKJS
```

## make/pkgs/rainfrog/Config.in
```kconfig
config FREETZ_PACKAGE_RAINFROG
	bool "rainfrog 0.3.18"
	depends on FREETZ_TARGET_UCLIBC_1_0_58
	default n
	help
		rainfrog utility package built from source using Rust/Cargo.
```

## make/pkgs/rclone/Config.in
```kconfig
config FREETZ_PACKAGE_RCLONE
	bool "rclone 1.74.1 (binary only)"
	default n
	help
		rclone is a command-line program to manage files on cloud storage.

		This package cross-compiles the upstream Go sources and installs the
		rclone executable on the target.

		Can be externalized to save flash memory.
```

## make/pkgs/restic/Config.in
```kconfig
config FREETZ_PACKAGE_RESTIC
	bool "restic 0.18.1 (binary only)"
	default n
	help
		restic is a fast, secure and efficient backup program.

		This package cross-compiles the upstream Go sources and installs the
		restic executable on the target.

		Can be externalized to save flash memory.
```

## make/pkgs/ripgrep/Config.in
```kconfig
config FREETZ_PACKAGE_RIPGREP
	bool "ripgrep 15.1.0"
	depends on FREETZ_TARGET_UCLIBC_1_0_58
	default n
	help
		ripgrep (rg) recursively searches files for patterns.

		This package builds ripgrep from source using Rust/Cargo.
```

## make/pkgs/rmpc/Config.in
```kconfig
config FREETZ_PACKAGE_RMPC
	bool "rmpc 0.11.0"
	depends on FREETZ_TARGET_UCLIBC_1_0_58_MIN
	default n
	help
		A beautiful, configurable TUI client for MPD written in Rust.
		Features album art, lyrics, playlist management, and more.
		Depends on Rust support enabled in toolchain settings.
```

## make/pkgs/rtl_433/Config.in
```kconfig
config FREETZ_PACKAGE_RTL_433
	bool "rtl_433 25.12"
	depends on FREETZ_TARGET_GCC_4_8_MIN
	select FREETZ_LIB_rtl_sdr
	select FREETZ_LIB_libusb1
	default n
	help
		rtl_433 is a generic data receiver, mainly for the 433.92 MHz,
		868 MHz (SRD), 315 MHz, 345 MHz, and 915 MHz ISM bands. It
		decodes radio transmissions from many wireless sensors,
		weather stations, TPMS, and remote controls using an RTL-SDR
		USB dongle.

		Installs:
		 - /usr/bin/rtl_433

		Example usage:
		 rtl_433 -f 433.92M -F json -M utc

		Project homepage:
		https://github.com/merbanan/rtl_433

if FREETZ_PACKAGE_RTL_433

	config FREETZ_PACKAGE_RTL_433_WITH_SOAPYSDR
		bool "SoapySDR support"
		depends on FREETZ_TARGET_UCLIBC_1_0_58_MIN
		default y
		select FREETZ_LIB_libsoapysdr
		help
			Build rtl_433 with SoapySDR support, i.e. it can then use
			any device for which a SoapySDR module is installed below
			/usr/lib/SoapySDR/modules0.8 (e.g. soapyrtlsdr for RTL-SDR
			dongles). The modules themselves are not part of this
			package.

			Requires uClibc 1.0.58 or newer.

	config FREETZ_PACKAGE_RTL_433_WITH_OPENSSL
		bool "OpenSSL (TLS) support"
		depends on !FREETZ_PACKAGE_OPENSSL_STATIC
		default y
		select FREETZ_LIB_libcrypto
		select FREETZ_LIB_libssl
		help
			Build rtl_433 with OpenSSL, which enables TLS for the MQTT
			and InfluxDB outputs.

endif # FREETZ_PACKAGE_RTL_433
```

## make/pkgs/rtorrent-cgi/Config.in
```kconfig
config FREETZ_PACKAGE_RTORRENT_CGI
	bool "rTorrent CGI web configuration interface"
	depends on FREETZ_PACKAGE_RTORRENT_DAEMON
	select FREETZ_BUSYBOX_START_STOP_DAEMON
	default n
	help
		Provides a configuration interface for rTorrent daemon.

		Access the configuration (e.g., http://fritz.box:81/cgi-bin/conf/rtorrent)
```

## make/pkgs/rtorrent/Config.in
```kconfig
menuconfig FREETZ_PACKAGE_RTORRENT
	bool "rTorrent/ruTorrent"
	depends on FREETZ_TARGET_GCC_9_MIN
	select FREETZ_STDCXXLIB_FORCE_GNULIBSTDCXX
	default n
	select FREETZ_LIB_libatomic               if !FREETZ_PACKAGE_RTORRENT_STATIC
	select FREETZ_LIB_libstdcxx               if !FREETZ_PACKAGE_RTORRENT_STATIC
	select FREETZ_LIB_libcurl                 if !FREETZ_PACKAGE_RTORRENT_STATIC
	select FREETZ_LIB_libcurl_WITH_SSL        if !FREETZ_PACKAGE_RTORRENT_STATIC
	select FREETZ_LIB_libcrypto               if !FREETZ_PACKAGE_RTORRENT_STATIC
	select FREETZ_LIB_libcrypto_WITH_RC4      if !FREETZ_PACKAGE_RTORRENT_STATIC
	select FREETZ_LIB_libssl                  if !FREETZ_PACKAGE_RTORRENT_STATIC
	select FREETZ_LIB_libxml2                 if !FREETZ_PACKAGE_RTORRENT_STATIC
	select FREETZ_LIB_libncursesw             if !FREETZ_PACKAGE_RTORRENT_STATIC
	select FREETZ_LIB_libz                    if !FREETZ_PACKAGE_RTORRENT_STATIC
	select FREETZ_LIB_libcurl_WITH_CA_BUNDLE if !FREETZ_PACKAGE_RTORRENT_STATIC
	help
		rTorrent is a console-based BitTorrent client with optional ruTorrent web interface.

		Includes libtorrent dependency.

if FREETZ_PACKAGE_RTORRENT

	config FREETZ_PACKAGE_RTORRENT_DAEMON
		bool "rTorrent daemon and libtorrent library"
		default y
		help
			Installs rTorrent daemon and the related libtorrent library (by rakshasa).
			Version: 0.16.13

	config FREETZ_PACKAGE_RTORRENT_CGI
		bool "rTorrent CGI web configuration interface"
		depends on FREETZ_PACKAGE_RTORRENT_DAEMON
		select FREETZ_BUSYBOX_START_STOP_DAEMON
		default n

	config FREETZ_PACKAGE_RTORRENT_STATIC
		bool "Link statically"
		depends on FREETZ_PACKAGE_RTORRENT_DAEMON
		default n
		help
			Links rTorrent statically (larger binary, no library dependencies).

	config FREETZ_PACKAGE_RTORRENT_WITH_IPV6
		bool "With IPv6 support"
		depends on FREETZ_PACKAGE_RTORRENT_DAEMON
		depends on FREETZ_TARGET_IPV6_SUPPORT
		default y
		help
			Enables IPv6 support in rTorrent.

	config FREETZ_PACKAGE_RTORRENT_WITH_XMLRPC
		bool "With XMLRPC support"
		depends on FREETZ_PACKAGE_RTORRENT_DAEMON
		select FREETZ_LIB_libxmlrpc               if !FREETZ_PACKAGE_RTORRENT_STATIC
		select FREETZ_LIB_libxmlrpc_server        if !FREETZ_PACKAGE_RTORRENT_STATIC
		select FREETZ_LIB_libxmlrpc_util          if !FREETZ_PACKAGE_RTORRENT_STATIC
		select FREETZ_LIB_libxmlrpc_xmlparse      if !FREETZ_PACKAGE_RTORRENT_STATIC
		select FREETZ_LIB_libxmlrpc_xmltok        if !FREETZ_PACKAGE_RTORRENT_STATIC
		default y
		help
			Enables XMLRPC interface for remote control.
			Required for ruTorrent web interface.



	config FREETZ_PACKAGE_RTORRENT_WITH_AVMRULES
		bool "Enable AVM-Rules support"
		select FREETZ_PACKAGE_AVM_RULES
		default n
		help
			Enables AVM-Rules integration for rTorrent.
			Allows automatic port forwarding and firewall rule management.

	comment "ruTorrent web interface (requires PHP or PHP5 - enable in 'Packages -> Web interface & server' first)"
		depends on !FREETZ_PACKAGE_PHP && !FREETZ_PACKAGE_PHP5

	source "make/pkgs/rutorrent/Config.in.inc"

endif # FREETZ_PACKAGE_RTORRENT
```

## make/pkgs/sha256sum/Config.in
```kconfig
config FREETZ_PACKAGE_SHA256SUM
	bool "sha256sum 0.9.0"
	depends on FREETZ_TARGET_UCLIBC_1_0_58
	default n
	help
		sha256sum from uutils/coreutils, packaged as a dedicated target-side command.
```

## make/pkgs/shairport-sync-cgi/Config.in
```kconfig
config FREETZ_PACKAGE_SHAIRPORT_SYNC_CGI
	bool "shairport-sync CGI (AirPlay config/status web UI)"
	depends on FREETZ_PACKAGE_SHAIRPORT_SYNC
	select FREETZ_BUSYBOX_START_STOP_DAEMON
	default y
	help
		Provides the freetz CGI configuration page and live status page for
		shairport-sync.

		Includes startup handling, runtime configuration and metadata/status
		display in the freetz web UI.

		http://fritz.box:81/cgi-bin/conf/shairport-sync
```

## make/pkgs/shairport-sync/Config.in
```kconfig
menuconfig FREETZ_PACKAGE_SHAIRPORT_SYNC
	bool "shairport-sync 5.0.4"
	depends on FREETZ_OPENSSL_VERSION_10_MIN
	depends on FREETZ_TARGET_GCC_4_8_MIN
	select FREETZ_LIB_libasound
	select FREETZ_LIB_libconfig
	select FREETZ_LIB_libdaemon
	select FREETZ_LIB_libpopt
	select FREETZ_LIB_libssl
	select FREETZ_MODULE_snd_usb_audio if FREETZ_MODULES_AUDIO_AVAILABLE
	default n
	help
		Shairport Sync is an AirPlay audio receiver with ALSA output.
		This build enables the lightweight tinysvcmdns backend and
		metadata support for the Freetz status page.

if FREETZ_PACKAGE_SHAIRPORT_SYNC

config FREETZ_PACKAGE_SHAIRPORT_SYNC_CGI
	bool "shairport-sync CGI (AirPlay config/status web UI)"
	default y
	help
		Provides the freetz CGI configuration page and live status page for
		shairport-sync, including startup handling and metadata display.
		This is the same symbol shown in "Packages -> Web interfaces".

endif
```

## make/pkgs/smartmontools/Config.in
```kconfig
config FREETZ_PACKAGE_SMARTMONTOOLS
	bool "Smartmontools 7.2/7.5"
	select FREETZ_STDCXXLIB_FORCE_GNULIBSTDCXX
	select FREETZ_LIB_STDCXXLIB
	default n
	help
		Smartmontools contains utility programs (smartctl, smartd) to
		control/monitor storage systems using the Self-Monitoring, Analysis
		and Reporting Technology System (S.M.A.R.T.) built into most modern
		ATA and SCSI disks. It is derived from smartsuite.

		Version 7.5 is built as C++11 and requires GCC 4.7 or newer; on older
		toolchains (GCC < 4.7) or 2.6.39 kernels, version 7.2 is selected instead.

if FREETZ_PACKAGE_SMARTMONTOOLS

	choice
		prompt "Version"
			default FREETZ_PACKAGE_SMARTMONTOOLS_VERSION_CURRENT

		config FREETZ_PACKAGE_SMARTMONTOOLS_VERSION_ABANDON
			bool "7.2"
			depends on (FREETZ_KERNEL_VERSION_2_6_39 || !FREETZ_TARGET_GCC_4_7_MIN)

		config FREETZ_PACKAGE_SMARTMONTOOLS_VERSION_CURRENT
			bool "7.5"
			depends on !(FREETZ_KERNEL_VERSION_2_6_39 || !FREETZ_TARGET_GCC_4_7_MIN)

	endchoice

endif # FREETZ_PACKAGE_SMARTMONTOOLS
```

## make/pkgs/snapcast-cgi/Config.in
```kconfig
config FREETZ_PACKAGE_SNAPCAST_CGI
	bool "snapcast CGI (Snapserver/snapclient config/status web UI)"
	depends on FREETZ_PACKAGE_SNAPCAST
	select FREETZ_BUSYBOX_START_STOP_DAEMON
	default y
	help
		Provides the freetz CGI configuration page and status page for
		snapcast.

		Includes startup handling, generated snapserver.conf management and
		live status output for snapserver and the optional local snapclient.

		http://fritz.box:81/cgi-bin/conf/snapcast
```

## make/pkgs/snapcast/Config.in
```kconfig
config FREETZ_PACKAGE_SNAPCAST
	bool "snapcast 0.35.0"
	select FREETZ_STDCXXLIB_FORCE_GNULIBSTDCXX
	select FREETZ_LIB_STDCXXLIB
	select FREETZ_LIB_libatomic
	select FREETZ_LIB_libpthread  if FREETZ_TARGET_UCLIBC_HAS_multiple_libs
	select FREETZ_LIB_libm        if FREETZ_TARGET_UCLIBC_HAS_multiple_libs
	select FREETZ_LIB_libasound
	select FREETZ_LIB_libFLAC
	select FREETZ_LIB_libogg
	select FREETZ_LIB_libvorbis
	select FREETZ_LIB_libcrypto
	select FREETZ_LIB_libssl
	select FREETZ_MODULE_snd_usb_audio if FREETZ_MODULES_AUDIO_AVAILABLE
	default n
	help
		snapcast is a multiroom client/server audio player.

		This Freetz build provides the upstream snapserver and snapclient
		binaries with ALSA output on the client side plus FLAC and
		Ogg/Vorbis codec support.

		mDNS discovery, Opus, PulseAudio, JACK, PipeWire, and SDL2 are
		disabled to keep the embedded footprint smaller.

		Can be externalized to save flash memory.

if FREETZ_PACKAGE_SNAPCAST

config FREETZ_PACKAGE_SNAPCAST_CGI
	bool "snapcast CGI (Snapserver/snapclient config/status web UI)"
	default y
	help
		Provides the freetz CGI configuration page and status page for
		snapcast.
		This is the same symbol shown in "Packages -> Web interfaces".

endif
```

## make/pkgs/soapyrtlsdr/Config.in
```kconfig
config FREETZ_PACKAGE_SOAPYRTLSDR
	bool "soapyrtlsdr (SoapySDR module for RTL-SDR)"
	depends on FREETZ_TARGET_UCLIBC_1_0_58_MIN
	select FREETZ_LIB_libsoapysdr
	select FREETZ_LIB_rtl_sdr
	default n
	help
		SoapySDR hardware module for RTL-SDR (Realtek RTL2832U based
		DVB-T) USB dongles. It makes the dongle usable through SoapySDR
		by applications such as rtl_433.

		Installs:
		 - /usr/lib/SoapySDR/modules0.8/libsoapyrtlsdr.so

		Example:
		 rtl_433 -d driver=rtlsdr

		Requires uClibc 1.0.58 or newer.

		https://github.com/pothosware/SoapyRTLSDR
```
