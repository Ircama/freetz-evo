## make/pkgs/domoticz-plugins-manager/Config.in
```kconfig
config FREETZ_PACKAGE_DOMOTICZ_PLUGINS_MANAGER
	bool "Domoticz plugin: Plugins Manager"
	depends on FREETZ_PACKAGE_DOMOTICZ
	select FREETZ_PACKAGE_PYTHON3_REQUESTS
	default n
	help
		install, update and remove the Python plugins of Domoticz from the web interface, using the upstream plugin index (it downloads the plugins from the upstream Plugins Manager index and installs them into the plugins folder of Domoticz).

		It is a Python plugin of Domoticz: the package installs it into
		/usr/share/domoticz/plugins/plugins-manager, the directory Domoticz is
		started with (-approot of the domoticz package), and it needs no
		change of the Domoticz build.

		Setup -> Hardware -> Plugins Manager; the Plugins page of the Custom menu shows the catalogue with the install, update and remove buttons.

		Licensed upstream (LICENSE is installed with the plugin). The
		repository has no release tags, so the build fetches a pinned commit of
		the default branch.
```

## make/pkgs/domoticz-pzem-016/Config.in
```kconfig
config FREETZ_PACKAGE_DOMOTICZ_PZEM_016
	bool "Domoticz plugin: PZEM-016 (Modbus RS-485)"
	depends on FREETZ_PACKAGE_DOMOTICZ
	select FREETZ_PACKAGE_PYTHON3_PYSERIAL
	default n
	help
		readings of the PZEM-016 energy monitors (voltage, current, power, energy) (it ships its own copy of minimalmodbus and uses pyserial for the RS-485 port).

		It is a Python plugin of Domoticz: the package installs it into
		/usr/share/domoticz/plugins/domoticz-pzem-016, the directory Domoticz is
		started with (-approot of the domoticz package), and it needs no
		change of the Domoticz build.

		Setup -> Hardware -> PZEM-016, enter the serial port and the Modbus address.

		Licensed upstream (LICENSE is installed with the plugin). The
		repository has no release tags, so the build fetches a pinned commit of
		the default branch.
```

## make/pkgs/domoticz-quatt/Config.in
```kconfig
config FREETZ_PACKAGE_DOMOTICZ_QUATT
	bool "Domoticz plugin: Quatt heat pump"
	depends on FREETZ_PACKAGE_DOMOTICZ
	default n
	help
		read the status of a Quatt hybrid heat pump

		It is a Python plugin of Domoticz: the package installs it into
		/usr/share/domoticz/plugins/Domoticz-Quatt-Plugin, the directory Domoticz is
		started with (-approot of the domoticz package), and it needs no
		change of the Domoticz build.

		The plugin imports the Domoticz module and the Python standard
		library only, so no additional Python package is required.

		Setup: Setup -> Hardware -> Quatt, enter the address of the heat pump controller.

		Upstream publishes no license file, so the plugin keeps the licensing
		status upstream gave it. The
		repository has no release tags, so the build fetches a pinned commit of
		the default branch.
```

## make/pkgs/domoticz-smogtok/Config.in
```kconfig
config FREETZ_PACKAGE_DOMOTICZ_SMOGTOK
	bool "Domoticz plugin: SmogTok air quality monitor"
	depends on FREETZ_PACKAGE_DOMOTICZ
	default n
	help
		read a SmogTok air quality monitor over the LAN

		It is a Python plugin of Domoticz: the package installs it into
		/usr/share/domoticz/plugins/smogtokdomoticzplug, the directory Domoticz is
		started with (-approot of the domoticz package), and it needs no
		change of the Domoticz build.

		The plugin imports the Domoticz module and the Python standard
		library only, so no additional Python package is required.

		Setup: Setup -> Hardware -> SmogTok, enter the address of the monitor.

		Licensed upstream (LICENSE is installed with the plugin). The
		repository has no release tags, so the build fetches a pinned commit of
		the default branch.
```

## make/pkgs/domoticz-snmp-reader/Config.in
```kconfig
config FREETZ_PACKAGE_DOMOTICZ_SNMP_READER
	bool "Domoticz plugin: SNMP reader"
	depends on FREETZ_PACKAGE_DOMOTICZ
	select FREETZ_PACKAGE_PYTHON3_PYSNMP
	default n
	help
		readings from SNMP v1, v2c and v3 agents (switches, printers, NAS, UPS) exposed as Domoticz sensors (it queries the agents with pysnmp).

		It is a Python plugin of Domoticz: the package installs it into
		/usr/share/domoticz/plugins/SNMPreader, the directory Domoticz is
		started with (-approot of the domoticz package), and it needs no
		change of the Domoticz build.

		Setup -> Hardware -> SNMP reader, enter the address of the agent, the SNMP version, the community or credentials and the OIDs to read.

		Licensed upstream (LICENSE is installed with the plugin). The
		repository has no release tags, so the build fetches a pinned commit of
		the default branch.
```

## make/pkgs/domoticz-sony-bravia/Config.in
```kconfig
config FREETZ_PACKAGE_DOMOTICZ_SONY_BRAVIA
	bool "Domoticz plugin: Sony Bravia TV"
	depends on FREETZ_PACKAGE_DOMOTICZ
	default n
	help
		control Sony Bravia televisions over the LAN, with a Kodi remote

		It is a Python plugin of Domoticz: the package installs it into
		/usr/share/domoticz/plugins/sony-bravia, the directory Domoticz is
		started with (-approot of the domoticz package), and it needs no
		change of the Domoticz build.

		The plugin imports the Domoticz module and the Python standard
		library only, so no additional Python package is required.

		Setup: Setup -> Hardware -> Sony Bravia, enter the address of the television and its pre-shared key.

		Upstream publishes no license file, so the plugin keeps the licensing
		status upstream gave it. The
		repository has no release tags, so the build fetches a pinned commit of
		the default branch.
```

## make/pkgs/domoticz-sync-timer/Config.in
```kconfig
config FREETZ_PACKAGE_DOMOTICZ_SYNC_TIMER
	bool "Domoticz plugin: sync timer"
	depends on FREETZ_PACKAGE_DOMOTICZ
	select FREETZ_PACKAGE_PYTHON3_REQUESTS
	default n
	help
		periodic synchronisation of timers and switches between Domoticz and external devices (it uses requests for the endpoints it synchronises).

		It is a Python plugin of Domoticz: the package installs it into
		/usr/share/domoticz/plugins/Update_timer, the directory Domoticz is
		started with (-approot of the domoticz package), and it needs no
		change of the Domoticz build.

		Setup -> Hardware -> sync timer, enter the broker and the devices to synchronise.

		Upstream ships no license file: the README is installed with the plugin. The
		repository has no release tags, so the build fetches a pinned commit of
		the default branch.
```

## make/pkgs/domoticz-synology/Config.in
```kconfig
config FREETZ_PACKAGE_DOMOTICZ_SYNOLOGY
	bool "Domoticz plugin: Synology Surveillance Station"
	depends on FREETZ_PACKAGE_DOMOTICZ
	default n
	help
		read the cameras and the events of a Synology Surveillance Station

		It is a Python plugin of Domoticz: the package installs it into
		/usr/share/domoticz/plugins/SurveillanceStationDomoticz, the directory Domoticz is
		started with (-approot of the domoticz package), and it needs no
		change of the Domoticz build.

		The plugin imports the Domoticz module and the Python standard
		library only, so no additional Python package is required.

		Setup: Setup -> Hardware -> Synology Surveillance Station, enter the address and credentials of the NAS.

		Licensed upstream (LICENSE is installed with the plugin). The
		repository has no release tags, so the build fetches a pinned commit of
		the default branch.
```

## make/pkgs/domoticz-sysfs-switches/Config.in
```kconfig
config FREETZ_PACKAGE_DOMOTICZ_SYSFS_SWITCHES
	bool "Domoticz plugin: GPIO switches via sysfs"
	depends on FREETZ_PACKAGE_DOMOTICZ
	default n
	help
		expose the GPIOs of the system in Domoticz as switches, reading and writing the sysfs filesystem (it reaches the GPIOs through sysfs and needs no additional Python module).

		It is a Python plugin of Domoticz: the package installs it into
		/usr/share/domoticz/plugins/SYSFS-Switches, the directory Domoticz is
		started with (-approot of the domoticz package), and it needs no
		change of the Domoticz build.

		Setup -> Hardware -> SYSFS-Switches, name the GPIOs to expose.

		Licensed upstream (LICENSE is installed with the plugin). The
		repository has no release tags, so the build fetches a pinned commit of
		the default branch.
```

## make/pkgs/domoticz-tasmota-h801/Config.in
```kconfig
config FREETZ_PACKAGE_DOMOTICZ_TASMOTA_H801
	bool "Domoticz plugin: Tasmota H801"
	depends on FREETZ_PACKAGE_DOMOTICZ
	default n
	help
		control of the H801 LED controllers (and of the Tasmota devices with PWM channels) from Domoticz (it ships its own MQTT client and the device controllers).

		It is a Python plugin of Domoticz: the package installs it into
		/usr/share/domoticz/plugins/h801-tasmota-plugin, the directory Domoticz is
		started with (-approot of the domoticz package), and it needs no
		change of the Domoticz build.

		Setup -> Hardware -> Tasmota H801, enter the MQTT broker.

		Licensed upstream (LICENSE is installed with the plugin). The
		repository has no release tags, so the build fetches a pinned commit of
		the default branch.
```
