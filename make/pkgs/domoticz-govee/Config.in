## make/pkgs/domoticz-govee/Config.in
```kconfig
config FREETZ_PACKAGE_DOMOTICZ_GOVEE
	bool "Domoticz plugin: Govee devices (LAN discovery)"
	depends on FREETZ_PACKAGE_DOMOTICZ
	default n
	help
		discover Govee devices on the local network and create their Domoticz devices

		It is a Python plugin of Domoticz: the package installs it into
		/usr/share/domoticz/plugins/Domoticz-Govee-Plugin, the directory Domoticz is
		started with (-approot of the domoticz package), and it needs no
		change of the Domoticz build.

		The plugin imports the Domoticz module and the Python standard
		library only, so no additional Python package is required.

		Setup: Setup -> Hardware -> Govee, let the plugin discover the devices on the LAN.

		Licensed upstream (LICENSE is installed with the plugin). The
		repository has no release tags, so the build fetches a pinned commit of
		the default branch.
```

## make/pkgs/domoticz-growatt/Config.in
```kconfig
config FREETZ_PACKAGE_DOMOTICZ_GROWATT
	bool "Domoticz plugin: Growatt solar inverter"
	depends on FREETZ_PACKAGE_DOMOTICZ
	default n
	help
		read a Growatt photovoltaic inverter through its local web server

		It is a Python plugin of Domoticz: the package installs it into
		/usr/share/domoticz/plugins/Domoticz-Growatt-Webserver-Plugin, the directory Domoticz is
		started with (-approot of the domoticz package), and it needs no
		change of the Domoticz build.

		The plugin imports the Domoticz module and the Python standard
		library only, so no additional Python package is required.

		Setup: Setup -> Hardware -> Growatt, enter the address of the inverter, then its serial number and the API password of the web server.

		Upstream publishes no license file, so the plugin keeps the licensing
		status upstream gave it. The
		repository has no release tags, so the build fetches a pinned commit of
		the default branch.
```

## make/pkgs/domoticz-home-presence/Config.in
```kconfig
config FREETZ_PACKAGE_DOMOTICZ_HOME_PRESENCE
	bool "Domoticz plugin: presence detection from network devices"
	depends on FREETZ_PACKAGE_DOMOTICZ
	default n
	help
		detect whether somebody is at home from the devices seen on the network

		It is a Python plugin of Domoticz: the package installs it into
		/usr/share/domoticz/plugins/Detect-Presence-at-Home, the directory Domoticz is
		started with (-approot of the domoticz package), and it needs no
		change of the Domoticz build.

		The plugin imports the Domoticz module and the Python standard
		library only, so no additional Python package is required.

		Setup: Setup -> Hardware -> Home presence, then list the devices that count as presence and the timeout.

		Upstream publishes no license file, so the plugin keeps the licensing
		status upstream gave it. The
		repository has no release tags, so the build fetches a pinned commit of
		the default branch.
```

## make/pkgs/domoticz-homewizard-p1/Config.in
```kconfig
config FREETZ_PACKAGE_DOMOTICZ_HOMEWIZARD_P1
	bool "Domoticz plugin: HomeWizard Wi-Fi P1 meter"
	depends on FREETZ_PACKAGE_DOMOTICZ
	default n
	help
		Extended version of the HomeWizard Wi-Fi P1 Domoticz plugin: it
		reads the P1 telegram of a HomeWizard Wi-Fi P1 meter over the
		local network (no cloud account, no HomeWizard app) and creates
		the energy devices of a smart meter installation: imported and
		exported energy, the per-tariff counters, current power per
		phase and in total, voltage and current per phase, gas and
		water, plus a few computed utility devices (daily and monthly
		totals, peak consumption, power factor and the like).

		Labels, units and the date formats of the devices follow the
		language of the hardware entry (17 translation files are
		shipped with the plugin). Only the Python standard library and
		the Domoticz module are used, so no additional Python package is
		needed.

		The plugin is installed into
		/usr/share/domoticz/plugins/HomeWizard-Wifi-p1-plugin-Extended,
		the plugin directory that Domoticz is started with (-approot of
		the domoticz package init script).

		Setup: Setup -> Hardware -> "HomeWizard P1 meter", then enter
		the IP address of the meter, the Domoticz address (127.0.0.1)
		and its HTTP port (8080); the data interval and the debug switch
		follow.

		Upstream publishes neither release tags nor a license file, so
		the build fetches a pinned commit of the main branch (the
		version of this package is that commit) and the plugin keeps the
		licensing status upstream gave it.
```

## make/pkgs/domoticz-hw-energysocket/Config.in
```kconfig
config FREETZ_PACKAGE_DOMOTICZ_HW_ENERGYSOCKET
	bool "Domoticz plugin: HomeWizard Wi-Fi energy socket"
	depends on FREETZ_PACKAGE_DOMOTICZ
	default n
	help
		read a HomeWizard Wi-Fi energy socket over the LAN

		It is a Python plugin of Domoticz: the package installs it into
		/usr/share/domoticz/plugins/HomeWizard-Wifi-Energy-Socket, the directory Domoticz is
		started with (-approot of the domoticz package), and it needs no
		change of the Domoticz build.

		The plugin imports the Domoticz module and the Python standard
		library only, so no additional Python package is required.

		Setup: Setup -> Hardware -> HomeWizard energy socket, enter the IP address of the socket.

		Upstream publishes no license file, so the plugin keeps the licensing
		status upstream gave it. The
		repository has no release tags, so the build fetches a pinned commit of
		the default branch.
```

## make/pkgs/domoticz-idetect/Config.in
```kconfig
config FREETZ_PACKAGE_DOMOTICZ_IDETECT
	bool "Domoticz plugin: presence detection from the router (iDetect)"
	depends on FREETZ_PACKAGE_DOMOTICZ
	select FREETZ_PACKAGE_PYTHON3_FRITZCONNECTION
	select FREETZ_PACKAGE_PYTHON3_PARAMIKO
	select FREETZ_PACKAGE_PYTHON3_PYNETGEAR
	select FREETZ_PACKAGE_PYTHON3_REQUESTS
	default n
	help
		presence detection driven by the clients of the home router: the
		devices that the router lists as connected are reported as
		present in Domoticz

		It is a Python plugin of Domoticz: the package installs it into
		/usr/share/domoticz/plugins/Domoticz_iDetect, the directory Domoticz is
		started with (-approot of the domoticz package), and it needs no
		change of the Domoticz build.

		The plugin needs python3-fritzconnection, python-paramiko,
		pynetgear and requests (installed as dependencies of this
		package) in addition to the standard library: the trackers of the
		repository query the router over TR-064, SSH, HTTP or the SOAP
		API of NETGEAR. The supported routers include FRITZ!Box, OpenWrt
		(brctl), RouterOS, UniFi, USG, Zyxel, NETGEAR, TP-Link Omada,
		Orbi, AiMesh and every host that answers a ping; the credentials
		and the tracker to use are the settings of the plugin.

		Setup: Setup -> Hardware -> iDetect, choose the tracker of the
		router and enter its address and credentials.

		The upstream repository has no release tags, so the build fetches a
		pinned commit of the default branch. Upstream ships no license
		file: the README and the images it refers to are installed with
		the plugin.
```

## make/pkgs/domoticz-ir-climate-controller/Config.in
```kconfig
config FREETZ_PACKAGE_DOMOTICZ_IR_CLIMATE_CONTROLLER
	bool "Domoticz plugin: Tasmota IR climate controller"
	depends on FREETZ_PACKAGE_DOMOTICZ
	default n
	help
		Control of IR air conditioners and heat pumps through a Tasmota
		IR bridge: the plugin talks to a Tasmota device with an IR LED
		(an ESP8266/ESP32 with the IRremoteESP8266 firmware, or a
		commercial IR bridge flashed with Tasmota) and sends the
		IR commands of the selected air conditioner model.

		It works for devices that have no Wi-Fi interface of their own,
		which is typical of split air conditioners: the climate device in
		Domoticz (mode, fan speed, temperature setpoint, swing) is
		translated into IR codes by Tasmota, so no cloud account and no
		vendor app are involved.

		The plugin uses only the Domoticz module and the Python standard
		library, and its labels follow the language of the hardware entry
		(17 translations).

		Setup: Setup -> Hardware -> add the IR climate controller, enter
		the IP address of the Tasmota device and select the air
		conditioner model.

		Upstream publishes no license file, so the plugin keeps the
		licensing status upstream gave it; the build fetches a pinned
		commit of the main branch because there are no release tags.
```

## make/pkgs/domoticz-knmi/Config.in
```kconfig
config FREETZ_PACKAGE_DOMOTICZ_KNMI
	bool "Domoticz plugin: KNMI weather (NL)"
	depends on FREETZ_PACKAGE_DOMOTICZ
	default n
	help
		read the KNMI (Dutch weather service) forecast and warnings

		It is a Python plugin of Domoticz: the package installs it into
		/usr/share/domoticz/plugins/Domoticz-KNMI-Weather-Plugin, the directory Domoticz is
		started with (-approot of the domoticz package), and it needs no
		change of the Domoticz build.

		The plugin imports the Domoticz module and the Python standard
		library only, so no additional Python package is required.

		Setup: Setup -> Hardware -> KNMI, enter the location and the API key.

		Licensed upstream (LICENSE is installed with the plugin). The
		repository has no release tags, so the build fetches a pinned commit of
		the default branch.
```

## make/pkgs/domoticz-linky/Config.in
```kconfig
config FREETZ_PACKAGE_DOMOTICZ_LINKY
	bool "Domoticz plugin: Linky smart meter (FR, Enedis account)"
	depends on FREETZ_PACKAGE_DOMOTICZ
	default n
	help
		consumption of a Linky (French) smart meter read from the Enedis
		web services of the distribution network operator

		It is a Python plugin of Domoticz: the package installs it into
		/usr/share/domoticz/plugins/DomoticzLinky, the directory Domoticz is
		started with (-approot of the domoticz package), and it needs no
		change of the Domoticz build.

		The plugin imports the Domoticz module and the Python standard
		library only, so no additional Python package is required.

		It reads the hourly data of an Enedis account (the same figures
		as the Enedis web site), not the teleinformation output of the
		meter: Domoticz has a native Teleinfo driver for the local
		serial/TCP reading, so the two do not overlap, and this plugin
		keeps working when the box is far from the meter or the meter has
		no local output wired to it. It needs an Enedis account and the
		public authentication proxy the plugin relies on; upstream states
		that support and updates will probably be very limited.

		Setup: Setup -> Hardware -> Linky, enter the Enedis account data.

		Licensed upstream (LICENSE is installed with the plugin). The
		repository has no release tags, so the build fetches a pinned commit of
		the default branch.
```

## make/pkgs/domoticz-maxcube/Config.in
```kconfig
config FREETZ_PACKAGE_DOMOTICZ_MAXCUBE
	bool "Domoticz plugin: eQ-3 MAX! heating system"
	depends on FREETZ_PACKAGE_DOMOTICZ
	default n
	help
		control an eQ-3 MAX! Cube heating system (thermostats, wall thermostats, window contacts)

		It is a Python plugin of Domoticz: the package installs it into
		/usr/share/domoticz/plugins/maxcube-Domoticz-plugin, the directory Domoticz is
		started with (-approot of the domoticz package), and it needs no
		change of the Domoticz build.

		The plugin imports the Domoticz module and the Python standard
		library only, so no additional Python package is required.

		Setup: Setup -> Hardware -> MAX! Cube, enter the IP address of the cube.

		Upstream publishes no license file, so the plugin keeps the licensing
		status upstream gave it. The
		repository has no release tags, so the build fetches a pinned commit of
		the default branch.
```

## make/pkgs/domoticz-meteoalarm/Config.in
```kconfig
config FREETZ_PACKAGE_DOMOTICZ_METEOALARM
	bool "Domoticz plugin: MeteoAlarm EU"
	depends on FREETZ_PACKAGE_DOMOTICZ
	select FREETZ_PACKAGE_PYTHON3_FEEDPARSER
	default n
	help
		European weather alerts (MeteoAlarm) as sensors and notifications in Domoticz (it reads the feeds with feedparser).

		It is a Python plugin of Domoticz: the package installs it into
		/usr/share/domoticz/plugins/MeteoAlarmEU, the directory Domoticz is
		started with (-approot of the domoticz package), and it needs no
		change of the Domoticz build.

		Setup -> Hardware -> MeteoAlarmEU, enter the region and the feed to follow.

		Licensed upstream (LICENSE is installed with the plugin). The
		repository has no release tags, so the build fetches a pinned commit of
		the default branch.
```

## make/pkgs/domoticz-milight-esp8266/Config.in
```kconfig
config FREETZ_PACKAGE_DOMOTICZ_MILIGHT_ESP8266
	bool "Domoticz plugin: Milight ESP8266 hub"
	depends on FREETZ_PACKAGE_DOMOTICZ
	default n
	help
		control of the groups and lamps driven by the ESP8266 gateway for Milight/AppLamp, over MQTT (it speaks to the ESP8266 gateway with its own MQTT client, so the native RF driver of Domoticz is not involved).

		It is a Python plugin of Domoticz: the package installs it into
		/usr/share/domoticz/plugins/espmilighthub-domoticz, the directory Domoticz is
		started with (-approot of the domoticz package), and it needs no
		change of the Domoticz build.

		Setup -> Hardware -> espmilighthub, enter the address of the ESP8266 gateway.

		Licensed upstream (LICENSE is installed with the plugin). The
		repository has no release tags, so the build fetches a pinned commit of
		the default branch.
```

## make/pkgs/domoticz-moonphases/Config.in
```kconfig
config FREETZ_PACKAGE_DOMOTICZ_MOONPHASES
	bool "Domoticz plugin: moon phases"
	depends on FREETZ_PACKAGE_DOMOTICZ
	default n
	help
		create devices with the moon phase, the moonrise and the moonset

		It is a Python plugin of Domoticz: the package installs it into
		/usr/share/domoticz/plugins/MoonPhases, the directory Domoticz is
		started with (-approot of the domoticz package), and it needs no
		change of the Domoticz build.

		The plugin imports the Domoticz module and the Python standard
		library only, so no additional Python package is required.

		Setup: Setup -> Hardware -> Moon phases, then set the latitude and longitude of the location.

		Upstream publishes no license file, so the plugin keeps the licensing
		status upstream gave it. The
		repository has no release tags, so the build fetches a pinned commit of
		the default branch.
```

## make/pkgs/domoticz-nut-ups/Config.in
```kconfig
config FREETZ_PACKAGE_DOMOTICZ_NUT_UPS
	bool "Domoticz plugin: NUT UPS monitor"
	depends on FREETZ_PACKAGE_DOMOTICZ
	default n
	help
		monitor a UPS through a NUT (network ups tools) server

		It is a Python plugin of Domoticz: the package installs it into
		/usr/share/domoticz/plugins/NUT_UPS, the directory Domoticz is
		started with (-approot of the domoticz package), and it needs no
		change of the Domoticz build.

		The plugin imports the Domoticz module and the Python standard
		library only, so no additional Python package is required.

		Setup: Setup -> Hardware -> UPS monitor, enter the NUT server address, then the UPS name and credentials.

		Licensed upstream (LICENSE is installed with the plugin). The
		repository has no release tags, so the build fetches a pinned commit of
		the default branch.
```

## make/pkgs/domoticz-owrtwifi2domo/Config.in
```kconfig
config FREETZ_PACKAGE_DOMOTICZ_OWRTWIFI2DOMO
	bool "Domoticz plugin: presence detection from an OpenWrt router (owrtwifi2domo)"
	depends on FREETZ_PACKAGE_DOMOTICZ
	default n
	help
		presence detection driven by the WiFi clients associated to an OpenWrt router (it ships its own MQTT client and needs no additional Python module).

		It is a Python plugin of Domoticz: the package installs it into
		/usr/share/domoticz/plugins/owrtwifi2domo, the directory Domoticz is
		started with (-approot of the domoticz package), and it needs no
		change of the Domoticz build.

		Setup -> Hardware -> owrtwifi2domo, enter the address and the credentials of the OpenWrt router.

		Licensed upstream (LICENSE is installed with the plugin). The
		repository has no release tags, so the build fetches a pinned commit of
		the default branch.
```
