## make/pkgs/pdns-authoritative/Config.in
```kconfig
comment "PowerDNS Authoritative Server 5.0.5 (requires GCC 8+/C++17)"
	depends on !FREETZ_TARGET_GCC_8_MIN

menuconfig FREETZ_PACKAGE_POWERDNS
	bool "PowerDNS Authoritative Server 5.0.5"
	depends on FREETZ_TARGET_GCC_8_MIN
	select FREETZ_LIB_STDCXXLIB
	select FREETZ_LIB_libatomic if FREETZ_TARGET_ARCH_MIPS && FREETZ_TARGET_GCC_4_8_MIN
	select FREETZ_LIB_libjemalloc
	select FREETZ_LIB_libcrypto
	select FREETZ_LIB_liblua
	select FREETZ_LIB_libssl if FREETZ_PACKAGE_POWERDNS_WITH_DNS_OVER_TLS && FREETZ_PACKAGE_POWERDNS_TLS_PROVIDER_OPENSSL
	select FREETZ_LIB_libgnutls if FREETZ_PACKAGE_POWERDNS_WITH_DNS_OVER_TLS && FREETZ_PACKAGE_POWERDNS_TLS_PROVIDER_GNUTLS
	default n
	help
		PowerDNS Authoritative Server from the upstream pdns source tree.

		This freetz port packages the Authoritative Server only.
		Upstream recursor is not included here.
		dnsdist is available as a separate freetz package.

		jemalloc is selected to avoid allocator-related crashes observed
		on uClibc targets when using the default allocator.

		The default configuration stays close to the minimal upstream mode:
		no backend or optional server feature is enabled unless selected below.

if FREETZ_PACKAGE_POWERDNS

	config FREETZ_PACKAGE_POWERDNS_SERVER
		bool "pdns_server"
		default y
		help
			Authoritative server daemon.

	config FREETZ_PACKAGE_POWERDNS_PDNSUTIL
		bool "pdnsutil (binary only)"
		default n
		help
			DNSSEC and zone maintenance utility.

	config FREETZ_PACKAGE_POWERDNS_PDNS_CONTROL
		bool "pdns_control (binary only)"
		default n
		help
			Runtime control helper for pdns_server.

	config FREETZ_PACKAGE_POWERDNS_ZONE2SQL
		bool "zone2sql (binary only)"
		default n
		help
			Convert zone files to SQL statements.

	config FREETZ_PACKAGE_POWERDNS_ZONE2JSON
		bool "zone2json (binary only)"
		default n
		help
			Convert zone files to JSON.

	config FREETZ_PACKAGE_POWERDNS_ZONE2LDAP
		bool "zone2ldap (binary only)"
		default n
		help
			Convert zone files to LDIF format (for the LDAP backend).

	config FREETZ_PACKAGE_POWERDNS_TOOLS
		bool "Extra diagnostic tools"
		default n
		select FREETZ_LIB_libcurl
		help
			Build the optional Authoritative Server tool set:
			pdns_notify, sdig, calidns, dnsdemog, dnsgram,
			dnspcap2calidns, dnspcap2protobuf, dnsreplay, dnsscan,
			dnsscope, dnswasher, nproxy, nsec3dig, dumresp, kvresp,
			stubquery, saxfr, ixplore, dnstcpbench and dnsbulktest.

	config FREETZ_PACKAGE_POWERDNS_IXFRDIST
		bool "ixfrdist (binary only)"
		default n
		select FREETZ_LIB_libyaml_cpp
		help
			Incremental transfer distributor from the upstream Authoritative
			Server tree. This port ships the binary only; runtime setup stays
			manual.

	menu "Optional server features"

		config FREETZ_PACKAGE_POWERDNS_WITH_LUA_RECORDS
			bool "Enable Lua records"
			default n
			help
				Enable Lua record support. Disabled by default to keep the
				package in minimal mode.

		config FREETZ_PACKAGE_POWERDNS_WITH_DNS_OVER_TLS
			bool "Enable DNS-over-TLS support"
			default n
			help
				Enable DNS-over-TLS support and choose the TLS provider below.

		choice
			prompt "DNS-over-TLS provider"
			depends on FREETZ_PACKAGE_POWERDNS_WITH_DNS_OVER_TLS
			default FREETZ_PACKAGE_POWERDNS_TLS_PROVIDER_OPENSSL

			config FREETZ_PACKAGE_POWERDNS_TLS_PROVIDER_OPENSSL
				bool "OpenSSL libssl"
				help
					Use OpenSSL's libssl as the DNS-over-TLS provider.

			config FREETZ_PACKAGE_POWERDNS_TLS_PROVIDER_GNUTLS
				bool "Alternative GnuTLS provider"
				help
					Use GnuTLS instead of OpenSSL libssl for DNS-over-TLS.

		endchoice

		config FREETZ_PACKAGE_POWERDNS_WITH_LIBSODIUM
			bool "Enable libsodium support"
			default n
			select FREETZ_LIB_libsodium
			help
				Enable libsodium-backed features such as ED25519 signers,
				EDNS cookies support and related helper functionality.

		config FREETZ_PACKAGE_POWERDNS_WITH_IPCIPHER
			bool "Enable IPCipher support"
			default n
			help
				Enable the optional IPCipher helper code.

		config FREETZ_PACKAGE_POWERDNS_WITH_VERBOSE_LOGGING
			bool "Enable verbose logging"
			default n
			help
				Build with upstream verbose logging support.

	endmenu

	comment "HINT: Keep AVM DNS enabled unless you explicitly reconfigure PowerDNS for port 53."
		depends on FREETZ_PACKAGE_POWERDNS_SERVER

	config FREETZ_PACKAGE_POWERDNS_DISABLE_DNS
		bool "Disable multid's DNS/LLMNR"
		depends on FREETZ_AVM_HAS_AVMMULTID_PRELOAD
		depends on FREETZ_PACKAGE_POWERDNS_SERVER
		select FREETZ_AVMDAEMON_DISABLE_MULTIDPORTS
		select FREETZ_AVMDAEMON_DISABLE_DNS
		select FREETZ_AVMDAEMON_DISABLE_LLMNR
		default n
		help
			Use this only when you want PowerDNS to listen on the standard DNS port.

	menu "Backends"

		config FREETZ_PACKAGE_POWERDNS_BACKEND_BIND
			bool "bind backend"
			default n
			help
				Zone-file based backend.

		config FREETZ_PACKAGE_POWERDNS_BACKEND_BIND_DYNAMIC
			bool "Build bind backend as dynamic module"
			depends on FREETZ_PACKAGE_POWERDNS_BACKEND_BIND
			default n

		config FREETZ_PACKAGE_POWERDNS_BACKEND_PIPE
			bool "pipe backend"
			default n
			help
				External backend bridge.

		config FREETZ_PACKAGE_POWERDNS_BACKEND_PIPE_DYNAMIC
			bool "Build pipe backend as dynamic module"
			depends on FREETZ_PACKAGE_POWERDNS_BACKEND_PIPE
			default n

		config FREETZ_PACKAGE_POWERDNS_BACKEND_GODBC
			bool "godbc backend"
			default n
			select FREETZ_LIB_libodbc
			help
				Generic ODBC backend via unixODBC.

		config FREETZ_PACKAGE_POWERDNS_BACKEND_GODBC_DYNAMIC
			bool "Build godbc backend as dynamic module"
			depends on FREETZ_PACKAGE_POWERDNS_BACKEND_GODBC
			default n

		config FREETZ_PACKAGE_POWERDNS_BACKEND_GMYSQL
			bool "gmysql backend"
			depends on FREETZ_PACKAGE_MYSQL_mysql
			default n
			help
				Generic MySQL backend. Requires the MySQL client package.

		config FREETZ_PACKAGE_POWERDNS_BACKEND_GMYSQL_DYNAMIC
			bool "Build gmysql backend as dynamic module"
			depends on FREETZ_PACKAGE_POWERDNS_BACKEND_GMYSQL
			default n

		config FREETZ_PACKAGE_POWERDNS_BACKEND_GPGSQL
			bool "gpgsql backend"
			default n
			select FREETZ_LIB_libpq
			help
				Generic PostgreSQL backend.

		config FREETZ_PACKAGE_POWERDNS_BACKEND_GPGSQL_DYNAMIC
			bool "Build gpgsql backend as dynamic module"
			depends on FREETZ_PACKAGE_POWERDNS_BACKEND_GPGSQL
			default n

		config FREETZ_PACKAGE_POWERDNS_BACKEND_GSQLITE3
			bool "gsqlite3 backend"
			default n
			select FREETZ_LIB_libsqlite3
			help
				Generic SQLite3 backend.

		config FREETZ_PACKAGE_POWERDNS_BACKEND_GSQLITE3_DYNAMIC
			bool "Build gsqlite3 backend as dynamic module"
			depends on FREETZ_PACKAGE_POWERDNS_BACKEND_GSQLITE3
			default n

		config FREETZ_PACKAGE_POWERDNS_BACKEND_GEOIP
			bool "geoip backend"
			default n
			select FREETZ_LIB_libmaxminddb
			select FREETZ_LIB_libyaml_cpp
			help
				Geo backend using MaxMind DB.

		config FREETZ_PACKAGE_POWERDNS_BACKEND_GEOIP_DYNAMIC
			bool "Build geoip backend as dynamic module"
			depends on FREETZ_PACKAGE_POWERDNS_BACKEND_GEOIP
			default n

		config FREETZ_PACKAGE_POWERDNS_BACKEND_LDAP
			bool "ldap backend"
			default n
			select FREETZ_LIB_libldap
			select FREETZ_LIB_libkrb5
			select FREETZ_LIB_libgssapi_krb5
			help
				LDAP backend. Requires OpenLDAP plus MIT Kerberos/GSSAPI
				headers and runtime libraries.

		config FREETZ_PACKAGE_POWERDNS_BACKEND_LDAP_DYNAMIC
			bool "Build ldap backend as dynamic module"
			depends on FREETZ_PACKAGE_POWERDNS_BACKEND_LDAP
			default n

		config FREETZ_PACKAGE_POWERDNS_BACKEND_LMDB
			bool "lmdb backend"
			default n
			select FREETZ_LIB_liblmdb
			help
				LMDB-based backend.

		config FREETZ_PACKAGE_POWERDNS_BACKEND_LMDB_DYNAMIC
			bool "Build lmdb backend as dynamic module"
			depends on FREETZ_PACKAGE_POWERDNS_BACKEND_LMDB
			default n

		config FREETZ_PACKAGE_POWERDNS_BACKEND_LUA2
			bool "lua2 backend"
			default n
			help
				Lua-based backend.

		config FREETZ_PACKAGE_POWERDNS_BACKEND_LUA2_DYNAMIC
			bool "Build lua2 backend as dynamic module"
			depends on FREETZ_PACKAGE_POWERDNS_BACKEND_LUA2
			default n

		config FREETZ_PACKAGE_POWERDNS_BACKEND_REMOTE
			bool "remote backend"
			default n
			help
				Remote backend without the optional ZeroMQ connector.

		config FREETZ_PACKAGE_POWERDNS_BACKEND_REMOTE_DYNAMIC
			bool "Build remote backend as dynamic module"
			depends on FREETZ_PACKAGE_POWERDNS_BACKEND_REMOTE
			default n

		config FREETZ_PACKAGE_POWERDNS_BACKEND_REMOTE_ZEROMQ
			bool "Enable ZeroMQ connector for remote backend"
			depends on FREETZ_PACKAGE_POWERDNS_BACKEND_REMOTE
			default n
			select FREETZ_LIB_libzmq
			help
				Build the optional ZeroMQ connector into the remote backend.

		config FREETZ_PACKAGE_POWERDNS_BACKEND_TINYDNS
			bool "tinydns backend"
			default n
			select FREETZ_LIB_libcdb
			help
				TinyDNS/CDB backend.

		config FREETZ_PACKAGE_POWERDNS_BACKEND_TINYDNS_DYNAMIC
			bool "Build tinydns backend as dynamic module"
			depends on FREETZ_PACKAGE_POWERDNS_BACKEND_TINYDNS
			default n

	endmenu

	comment "HINT: Enable at least one backend before starting PowerDNS."
		depends on FREETZ_PACKAGE_POWERDNS_SERVER && \
			!FREETZ_PACKAGE_POWERDNS_BACKEND_BIND && \
			!FREETZ_PACKAGE_POWERDNS_BACKEND_PIPE && \
			!FREETZ_PACKAGE_POWERDNS_BACKEND_GODBC && \
			!FREETZ_PACKAGE_POWERDNS_BACKEND_GMYSQL && \
			!FREETZ_PACKAGE_POWERDNS_BACKEND_GPGSQL && \
			!FREETZ_PACKAGE_POWERDNS_BACKEND_GSQLITE3 && \
			!FREETZ_PACKAGE_POWERDNS_BACKEND_GEOIP && \
			!FREETZ_PACKAGE_POWERDNS_BACKEND_LDAP && \
			!FREETZ_PACKAGE_POWERDNS_BACKEND_LMDB && \
			!FREETZ_PACKAGE_POWERDNS_BACKEND_LUA2 && \
			!FREETZ_PACKAGE_POWERDNS_BACKEND_REMOTE && \
			!FREETZ_PACKAGE_POWERDNS_BACKEND_TINYDNS

endif # FREETZ_PACKAGE_POWERDNS
```
