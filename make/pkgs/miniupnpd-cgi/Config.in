## make/pkgs/miniupnpd-cgi/Config.in
```kconfig
config FREETZ_PACKAGE_MINIUPNPD_CGI
	bool "MiniUPnPd CGI web configuration interface"
	depends on FREETZ_PACKAGE_MINIUPNPD_DAEMON
	select FREETZ_BUSYBOX_START_STOP_DAEMON
	default n
	help
		Provides a web configuration interface for MiniUPnPd.

		Access the configuration (e.g., http://fritz.box:81/cgi-bin/conf/miniupnpd)
```

## make/pkgs/miniupnpd/Config.in
```kconfig
menuconfig FREETZ_PACKAGE_MINIUPNPD
	bool "MiniUPnPd (UPnP IGD daemon)"
	select FREETZ_PACKAGE_IPTABLES
	default n
	help
		MiniUPnPd is a UPnP Internet Gateway Device daemon.
		It implements the UPnP IGDv1 and IGDv2 specifications,
		allowing clients on the LAN to manage port mappings on
		the router automatically.
		
		This is useful for:
		- Peer-to-peer applications
		- Game consoles (Xbox, PlayStation)
		- VoIP/instant messaging
		- Any application needing inbound ports
		
		https://github.com/miniupnp/miniupnp

if FREETZ_PACKAGE_MINIUPNPD

	config FREETZ_PACKAGE_MINIUPNPD_DAEMON
		bool "MiniUPnPd daemon"
		default y
		help
			Installs the MiniUPnPd UPnP IGD daemon.

	config FREETZ_PACKAGE_MINIUPNPD_CGI
		bool "MiniUPnPd CGI web configuration interface"
		depends on FREETZ_PACKAGE_MINIUPNPD_DAEMON
		select FREETZ_BUSYBOX_START_STOP_DAEMON
		default n

	config FREETZ_PACKAGE_MINIUPNPD_SECURE_MODE
		bool "Enable secure mode (default)"
		depends on FREETZ_PACKAGE_MINIUPNPD_DAEMON
		default y
		help
			Secure mode only allows port mappings to the client's own IP.
			Disable to allow mappings to arbitrary IPs.

	config FREETZ_PACKAGE_MINIUPNPD_IPV6
		bool "Enable IPv6 support"
		depends on FREETZ_PACKAGE_MINIUPNPD_DAEMON
		depends on FREETZ_TARGET_IPV6_SUPPORT
		default y

endif # FREETZ_PACKAGE_MINIUPNPD
```

## make/pkgs/mpd-cgi/Config.in
```kconfig
config FREETZ_PACKAGE_MPD_CGI
	bool "MPD CGI (Music Player Daemon config/status web UI)"
	depends on FREETZ_PACKAGE_MPD
	default y
	help
		Provides the freetz CGI configuration page and status page for MPD.

		Includes startup handling, generated mpd.conf management and
		auto-refresh monitoring in the freetz web UI.

		http://fritz.box:81/cgi-bin/conf/mpd
```

## make/pkgs/mpd-mpc-cgi/Config.in
```kconfig
config FREETZ_PACKAGE_MPD_MPC_CGI
	bool "mpc CGI (MPD CLI radio control web UI)"
	depends on FREETZ_PACKAGE_MPD_MPC
	default y
	help
		Provides the freetz CGI configuration page and live radio-control
		status page for the mpc client.

		Supports WebRadioDB search/import, MPD playback controls, artwork
		display and saved startup playback presets.

		http://fritz.box:81/cgi-bin/conf/mpd-mpc
```

## make/pkgs/mpd-mpc/Config.in
```kconfig
config FREETZ_PACKAGE_MPD_MPC
	bool "mpc 0.35 (MPD CLI client)"
	select FREETZ_LIB_libmpdclient
	default n
	help
		mpc is the minimalist command-line client for Music Player Daemon.
		It installs the `mpc` CLI and can be used with the local MPD package
		or any reachable MPD server.

		Can be externalized to save flash memory.

if FREETZ_PACKAGE_MPD_MPC

config FREETZ_PACKAGE_MPD_MPC_CGI
	bool "mpc CGI (MPD CLI radio control web UI)"
	default y
	help
		Provides the freetz CGI configuration page and radio-control status
		page for the mpc client.
		This is the same symbol shown in "Packages -> Web interfaces".

endif
```

## make/pkgs/mpd/Config.in
```kconfig
config FREETZ_PACKAGE_MPD
	bool "MPD 0.24.13"
	depends on FREETZ_TARGET_GCC_13_MIN
	select FREETZ_STDCXXLIB_FORCE_GNULIBSTDCXX
	select FREETZ_LIB_STDCXXLIB
	select FREETZ_LIB_libjemalloc
	select FREETZ_LIB_libpthread  if FREETZ_TARGET_UCLIBC_HAS_multiple_libs
	select FREETZ_LIB_libm        if FREETZ_TARGET_UCLIBC_HAS_multiple_libs
	select FREETZ_LIB_libasound
	select FREETZ_LIB_libFLAC
	select FREETZ_LIB_libid3tag
	select FREETZ_LIB_libmad
	select FREETZ_LIB_libogg
	select FREETZ_LIB_libvorbis
	select FREETZ_LIB_libz
	select FREETZ_MODULE_snd_usb_audio if FREETZ_MODULES_AUDIO_AVAILABLE
	default n
	help
		Music Player Daemon is a network-controllable music player.

		This build enables the local database, TCP control interface,
		ALSA output and the MP3, FLAC and Vorbis decoders.
		jemalloc is selected to work around allocator-related crashes
		observed on some uClibc target combinations.
		Libcurl-based URI input support, SQLite, FFmpeg, ICU, WavPack,
		UPnP, Expat, Opus, iconv, Vorbis encoder, FAAD2, FluidSynth,
		libsamplerate, mpg123, NFS, shine, shout, soxr, Tremor,
		WildMIDI, WebDAV, IPv6, DSD, CUE, pipe, FIFO and HTTP output
		can be enabled in the sub-options below.

		Can be externalized to save flash memory.

if FREETZ_PACKAGE_MPD

	config FREETZ_PACKAGE_MPD_WITH_URI_INPUTS
		bool "Enable remote URI input support (libcurl)"
		select FREETZ_LIB_libcurl
		select FREETZ_LIB_libcurl_WITH_SSL
		select FREETZ_LIB_libcurl_WITH_CA_BUNDLE
		default y
		help
			Enables MPD's libcurl input backend for remote URIs such as
			http:// and https:// streams and playlists.

			This keeps heavier upstream integrations such as WebDAV, MMS,
			UPnP and FFmpeg disabled.

	config FREETZ_PACKAGE_MPD_WITH_SQLITE
		bool "Enable SQLite database plugin"
		select FREETZ_LIB_libsqlite3
		default n
		help
			Enables MPD's optional SQLite database backend.

	config FREETZ_PACKAGE_MPD_WITH_BZIP2
		bool "Enable bzip2 compressed playlist/archive support"
		select FREETZ_LIB_libbz2
		default n
		help
			Enables MPD's optional bzip2 support.

	config FREETZ_PACKAGE_MPD_WITH_FFMPEG
		bool "Enable FFmpeg decoder integration"
		select FREETZ_PACKAGE_FFMPEG_PATENTED
		select FREETZ_PACKAGE_FFMPEG_DECODER_aac
		select FREETZ_PACKAGE_FFMPEG_PARSER_aac
		select FREETZ_PACKAGE_FFMPEG_DEMUXER_aac
		select FREETZ_PACKAGE_FFMPEG_DEMUXER_hls
		select FREETZ_LIB_libavcodec
		select FREETZ_LIB_libavformat
		select FREETZ_LIB_libavutil
		default n
		help
			Enables MPD's optional FFmpeg decoder backend.

			This uses the FFmpeg library set configured in Freetz and
			is intended for users who want broader format coverage than
			the built-in MP3/FLAC/Vorbis stack, including AAC/HLS
			radio streams.

	config FREETZ_PACKAGE_MPD_WITH_ICU
		bool "Enable ICU (Unicode) support"
		depends on FREETZ_SHOW_DEVELOPER && FREETZ_TARGET_UCLIBC_1_0_58_MIN
		select FREETZ_LIB_libicu
		default n
		help
			Enables ICU support in MPD for Unicode string
			transliteration and case-insensitive matching.

	config FREETZ_PACKAGE_MPD_WITH_WAVPACK
		bool "Enable WavPack decoder"
		select FREETZ_LIB_libwavpack
		default n
		help
			Enables MPD's WavPack lossless audio decoder.

	config FREETZ_PACKAGE_MPD_WITH_UPNP
		bool "Enable UPnP Media Server"
		select FREETZ_LIB_libupnp
		default n
		help
			Enables MPD's UPnP Media Server capability.

	config FREETZ_PACKAGE_MPD_WITH_EXPAT
		bool "Enable Expat XML parser"
		select FREETZ_LIB_libexpat
		default n
		help
			Enables Expat XML parser support in MPD.

	config FREETZ_PACKAGE_MPD_WITH_OPUS
		bool "Enable Opus decoder"
		select FREETZ_LIB_libopus
		default n
		help
			Enables MPD's Opus audio decoder.

	config FREETZ_PACKAGE_MPD_WITH_ICONV
		bool "Enable iconv charset conversion"
		select FREETZ_LIB_libiconv
		default n
		help
			Enables character set conversion support via iconv.

	config FREETZ_PACKAGE_MPD_WITH_VORBISENC
		bool "Enable Vorbis encoder"
		select FREETZ_LIB_libvorbisenc
		default n
		help
			Enables MPD's Vorbis audio encoder (for the
			HTTP output plugin).

	config FREETZ_PACKAGE_MPD_WITH_IPV6
		bool "Enable IPv6 support"
		default n
		help
			Enables IPv6 support in MPD's TCP listener.

	config FREETZ_PACKAGE_MPD_WITH_DSD
		bool "Enable DSD support"
		default n
		help
			Enables DSD (Direct Stream Digital) support
			in MPD's ALSA output plugin.

	config FREETZ_PACKAGE_MPD_WITH_CUE
		bool "Enable CUE sheet support"
		default n
		help
			Enables CUE sheet parsing support in MPD.

	config FREETZ_PACKAGE_MPD_WITH_NEIGHBOR
		bool "Enable UPnP neighbor discovery"
		depends on FREETZ_PACKAGE_MPD_WITH_UPNP
		default n
		help
			Enables MPD's UPnP neighbor discovery (requires UPnP).

	config FREETZ_PACKAGE_MPD_WITH_WEBDAV
		bool "Enable WebDAV input"
		depends on FREETZ_PACKAGE_MPD_WITH_URI_INPUTS
		default n
		help
			Enables MPD's WebDAV input backend (requires curl).

	config FREETZ_PACKAGE_MPD_WITH_PIPE
		bool "Enable named pipe output"
		default n
		help
			Enables MPD's named pipe audio output plugin.

	config FREETZ_PACKAGE_MPD_WITH_FIFO
		bool "Enable FIFO output"
		default n
		help
			Enables MPD's FIFO audio output plugin.

	config FREETZ_PACKAGE_MPD_WITH_HTTPD
		bool "Enable HTTP daemon output"
		default n
		help
			Enables MPD's HTTP streaming audio output plugin.

	config FREETZ_PACKAGE_MPD_WITH_FAAD
		bool "Enable FAAD2 (AAC) decoder"
		select FREETZ_LIB_libfaad2
		default n
		help
			Enables MPD's FAAD2 AAC audio decoder.

	config FREETZ_PACKAGE_MPD_WITH_FLUIDSYNTH
		bool "Enable FluidSynth (MIDI) decoder"
		select FREETZ_LIB_libfluidsynth
		default n
		help
			Enables MPD's FluidSynth MIDI synthesis decoder.

	config FREETZ_PACKAGE_MPD_WITH_LIBSAMPLERATE
		bool "Enable libsamplerate (SRC) output"
		select FREETZ_LIB_libsamplerate
		default n
		help
			Enables MPD's libsamplerate-based sample rate conversion.

	config FREETZ_PACKAGE_MPD_WITH_MPG123
		bool "Enable mpg123 (MP3) decoder"
		select FREETZ_LIB_libmpg123
		default n
		help
			Enables MPD's mpg123 MP3 audio decoder.

	config FREETZ_PACKAGE_MPD_WITH_NFS
		bool "Enable NFS input"
		select FREETZ_LIB_libnfs
		default n
		help
			Enables MPD's NFS input backend.

	config FREETZ_PACKAGE_MPD_WITH_SHINE
		bool "Enable shine (MP3) encoder"
		select FREETZ_LIB_libshine
		default n
		help
			Enables MPD's shine fixed-point MP3 encoder.

	config FREETZ_PACKAGE_MPD_WITH_SHOUT
		bool "Enable Icecast (shout) output"
		select FREETZ_LIB_libshout
		default n
		help
			Enables MPD's Icecast streaming output plugin.

	config FREETZ_PACKAGE_MPD_WITH_SOXR
		bool "Enable libsoxr (SRC) output"
		select FREETZ_LIB_libsoxr
		default n
		help
			Enables MPD's libsoxr sample rate converter.

	config FREETZ_PACKAGE_MPD_WITH_TREMOR
		bool "Enable Tremor (low-memory Vorbis) decoder"
		select FREETZ_LIB_libvorbisidec
		default n
		help
			Enables MPD's Tremor low-memory Vorbis decoder.

	config FREETZ_PACKAGE_MPD_WITH_WILDMIDI
		bool "Enable WildMIDI decoder"
		select FREETZ_LIB_libwildmidi
		default n
		help
			Enables MPD's WildMIDI software MIDI playback.

config FREETZ_PACKAGE_MPD_CGI
	bool "MPD CGI (Music Player Daemon config/status web UI)"
	default y
	help
		Provides the freetz CGI configuration page and status page for MPD.
		This is the same symbol shown in "Packages -> Web interfaces".

endif
```

## make/pkgs/mympd-cgi/Config.in
```kconfig
config FREETZ_PACKAGE_MYMPD_CGI
	bool "myMPD CGI (config/status web UI)"
	depends on FREETZ_PACKAGE_MYMPD
	select FREETZ_BUSYBOX_START_STOP_DAEMON
	default y
	help
		Provides the freetz CGI configuration page and status page for myMPD.

		Includes startup handling and bootstrap settings for the embedded
		myMPD web interface.

		http://fritz.box:81/cgi-bin/conf/mympd
```

## make/pkgs/mympd/Config.in
```kconfig
config FREETZ_PACKAGE_MYMPD
	bool "myMPD 25.0.2"
	depends on FREETZ_TARGET_UCLIBC_1_0_58_MIN
	select FREETZ_LIB_libcrypto
	select FREETZ_LIB_libssl
	select FREETZ_LIB_libpcre2
	select FREETZ_LIB_libpthread  if FREETZ_TARGET_UCLIBC_HAS_multiple_libs
	select FREETZ_LIB_libm        if FREETZ_TARGET_UCLIBC_HAS_multiple_libs
	default n
	help
		myMPD is a standalone and lightweight web-based MPD client.

		This freetz build uses embedded web assets and embedded
		libmpdclient to keep the package self-contained.

		Requires uClibc 1.0.58 or newer: myMPD needs OpenSSL >= 1.1.0
		(CMake fails with "myMPD requires an OpenSSL version greater or
		equal 1.1.0"). On the 1.0.58 toolchain OpenSSL 1.0.2 is not
		selectable, so the default is 1.1.1 or newer.

		Can be externalized to save flash memory.

if FREETZ_PACKAGE_MYMPD

config FREETZ_PACKAGE_MYMPD_CGI
	bool "myMPD CGI (config/status web UI)"
	default y
	help
		Provides the freetz CGI configuration page and status page for myMPD.
		This is the same symbol shown in "Packages -> Web interfaces".

endif
```

## make/pkgs/ncdu-cgi/Config.in
```kconfig
config FREETZ_PACKAGE_NCDU_CGI
	bool "ncdu CGI (disk usage web UI)"
	depends on FREETZ_PACKAGE_NCDU
	default n
	help
		Provides a web interface for ncdu disk usage analysis.

		Runs ncdu in JSON export mode (-0xo-) on a selected path and
		renders the result as an interactive expandable directory tree
		in the browser.

		http://fritz.box:81/cgi-bin/conf/ncdu
```

## make/pkgs/ncdu/Config.in
```kconfig
menuconfig FREETZ_PACKAGE_NCDU
	bool "ncdu 1.19 (disk usage analyzer)"
	select FREETZ_LIB_libncurses
	default n
	help
		ncdu (NCurses Disk Usage) is a disk usage analyzer with an
		ncurses interface. It provides a fast way to see what directories
		are using your disk space.

		https://dev.yorhel.nl/ncdu

if FREETZ_PACKAGE_NCDU

config FREETZ_PACKAGE_NCDU_CGI
	bool "ncdu CGI (disk usage web UI)"
	default n
	depends on FREETZ_PACKAGE_NCDU
	help
		Provides the freetz CGI control page for ncdu.
		This is the same symbol shown in "Packages -> Web interfaces".

endif
```

## make/pkgs/ncmpc/Config.in
```kconfig
config FREETZ_PACKAGE_NCMPC
	bool "ncmpc 0.52"
	depends on FREETZ_TARGET_UCLIBC_1_0_58_MIN
	select FREETZ_LIB_libmpdclient
	select FREETZ_LIB_libncursesw
	select FREETZ_LIB_libfmt
	default n
	help
		Official ncurses client for the Music Player Daemon (MPD).
		Feature-rich terminal user interface with library browser,
		playlist editor, search, lyrics, and more.

		Requires uClibc 1.0.58 or newer: ncmpc depends on fmt (>= 9),
		and freetz's libfmt 12.2.0 is only available on uClibc >= 1.0.58.

config FREETZ_PACKAGE_NCMPC_WITH_ICONV
	bool "iconv support"
	depends on FREETZ_PACKAGE_NCMPC
	select FREETZ_LIB_libiconv
	default n
	help
		Enable iconv character set conversion support.

config FREETZ_PACKAGE_NCMPC_WITH_LIRC
	bool "LIRC support"
	depends on FREETZ_PACKAGE_NCMPC
	select FREETZ_LIB_liblirc_client
	default n
	help
		Enable LIRC (Linux Infrared Remote Control) support.

config FREETZ_PACKAGE_NCMPC_WITH_NLS
	bool "NLS (native language support)"
	depends on FREETZ_PACKAGE_NCMPC
	select FREETZ_LIB_libintl
	default n
	help
		Enable NLS for localized messages.

config FREETZ_PACKAGE_NCMPC_WITH_REGEX
	bool "regex support (PCRE2)"
	depends on FREETZ_PACKAGE_NCMPC
	select FREETZ_LIB_libpcre2
	default n
	help
		Enable regular expression search using libpcre2.
```

## make/pkgs/ncmpcpp/Config.in
```kconfig
config FREETZ_PACKAGE_NCMPCPP
	bool "ncmpcpp 0.9.2"
	depends on FREETZ_TARGET_UCLIBC_1_0_58
	select FREETZ_LIB_libmpdclient
	select FREETZ_LIB_libncursesw
	select FREETZ_LIB_libcurl
	select FREETZ_LIB_libtag
	default n
	help
		Ncurses-based MPD client. Feature-rich terminal user interface
		for controlling the Music Player Daemon.
		
		Requires uClibc 1.0.58 or newer (it also depends on taglib).
```

## make/pkgs/ncspot/Config.in
```kconfig
config FREETZ_PACKAGE_NCSPOT
	bool "ncspot 1.3.4"
	depends on FREETZ_TARGET_UCLIBC_1_0_58
	select FREETZ_LIB_libasound
	select FREETZ_MODULE_snd_usb_audio if FREETZ_MODULES_AUDIO_AVAILABLE
	default n
	help
		ncspot is a ncurses Spotify client built from source using Rust/Cargo.

		This freetz package builds a target-native ncspot binary with ALSA
		playback backend and crossterm terminal UI backend.

		Can be externalized to save flash memory.
```
