## make/pkgs/neomutt/Config.in
```kconfig
config FREETZ_PACKAGE_NEOMUTT
	bool "NeoMutt 20260504 (binary only)"
	depends on FREETZ_TARGET_GCC_4_7_MIN
	select FREETZ_LIB_libatomic if FREETZ_OPENSSL_VERSION_30_MIN
	select FREETZ_LIB_libncursesw
	select FREETZ_LIB_libcrypto
	select FREETZ_LIB_libssl
	select FREETZ_LIB_libz
	select FREETZ_LIB_libdl if FREETZ_TARGET_UCLIBC_HAS_multiple_libs
	select FREETZ_LIB_libiconv if FREETZ_TARGET_UCLIBC_0_9_28
	default n
	help
		NeoMutt is a feature-rich terminal email client.

		This package builds a lean OpenSSL + ncursesw variant with optional
		features such as GPGME, Lua, Notmuch, SASL and extra header-cache
		backends disabled to keep the footprint suitable for Freetz.

		Requires GCC 4.7 or newer: NeoMutt's configure requires C11
		(checks for -std=c11), which the old GCC 4.6.4 toolchain does not
		support (Error: C11 is required).

		Can be externalized to save flash memory.
```

## make/pkgs/neovim/Config.in
```kconfig
config FREETZ_PACKAGE_NEOVIM
	bool "Neovim 0.12.2"
	depends on FREETZ_TARGET_GCC_4_9_MIN
	select FREETZ_LIB_libdl       if FREETZ_TARGET_UCLIBC_HAS_multiple_libs
	select FREETZ_LIB_libiconv    if FREETZ_TARGET_UCLIBC_0_9_28
	select FREETZ_LIB_libm        if FREETZ_TARGET_UCLIBC_HAS_multiple_libs
	select FREETZ_LIB_libpthread  if FREETZ_TARGET_UCLIBC_HAS_multiple_libs
	default n
	help
		Modern Vim-based terminal editor.

		This package builds Neovim with the upstream bundled dependencies
		needed by the editor and installs the runtime under /usr/share/nvim.
		Externalization is supported for the editor binary and, when
		EXTERNAL_SUBDIRS is enabled, for /usr/share/nvim and /usr/lib/nvim.

		Requires GCC 4.9 or newer: the bundled libuv uses <stdatomic.h>
		(C11 atomics), which the old GCC 4.6.4 toolchain does not provide
		(fatal error: stdatomic.h: No such file or directory).
```

## make/pkgs/nmon/Config.in
```kconfig
config FREETZ_PACKAGE_NMON
	bool "nmon 16s (binary only)"
	select FREETZ_LIB_libm       if FREETZ_TARGET_UCLIBC_HAS_multiple_libs
	select FREETZ_LIB_libncurses
	default n
	help
		nmon is a curses-based performance monitor for Linux systems.

		It displays CPU, memory, disk, network, filesystem, and process
		statistics in real time and can also save performance samples to a
		CSV file for later analysis.

		Can be externalized to save flash memory.
```

## make/pkgs/nodejs/Config.in
```kconfig
config FREETZ_PACKAGE_NODEJS
	bool "Node.js 18.20.8"
	depends on FREETZ_USER_LEVEL_DEVELOPER
	depends on FREETZ_TARGET_GCC_13_MIN
	depends on FREETZ_OPENSSL_VERSION_30 || FREETZ_OPENSSL_VERSION_35
	select FREETZ_STDCXXLIB_FORCE_GNULIBSTDCXX
	select FREETZ_LIB_STDCXXLIB
	select FREETZ_LIB_libatomic
	select FREETZ_LIB_libcrypto
	select FREETZ_LIB_libssl
	select FREETZ_LIB_libz
	select FREETZ_LIB_libdl       if FREETZ_TARGET_UCLIBC_HAS_multiple_libs
	select FREETZ_LIB_libm        if FREETZ_TARGET_UCLIBC_HAS_multiple_libs
	select FREETZ_LIB_libpthread  if FREETZ_TARGET_UCLIBC_HAS_multiple_libs
	default n
	help
		Node.js is a JavaScript runtime built on Chrome's V8 engine.
		
		This package builds a target Node.js runtime linked against
		shared OpenSSL and zlib from freetz.
		
		OpenSSL 3.0 is the recommended choice.
		OpenSSL 3.5 is allowed as an experimental variant and may still
		require fixes depending on target/toolchain.

if FREETZ_PACKAGE_NODEJS

	config FREETZ_PACKAGE_NODEJS_WITH_NPM
		bool "With npm and npx"
		default n
		help
			Install the bundled npm/npx tools.
			
			Disabled by default to keep image size lower.

	config FREETZ_PACKAGE_NODEJS_WITH_INTL
		bool "With Intl (small-icu)"
		default n
		help
			Enable JavaScript Intl support with small-icu.
			
			Disabled by default to keep build and runtime footprint lower.

	config FREETZ_PACKAGE_NODEJS_WITH_INSPECTOR
		bool "With V8 inspector"
		default n
		help
			Enable the V8 inspector/debug protocol.

endif # FREETZ_PACKAGE_NODEJS
```

## make/pkgs/openldap/Config.in
```kconfig
config FREETZ_PACKAGE_OPENLDAP
	bool "OpenLDAP 2.6.8 (client tools)"
	select FREETZ_LIB_libldap
	select FREETZ_LIB_liblber
	default n
	help
		OpenLDAP client tools package.
		Installs ldapsearch and related command-line tools.
```

## make/pkgs/openthread/Config.in
```kconfig
config FREETZ_PACKAGE_OPENTHREAD
	bool "OpenThread 2026.10.0"
	depends on FREETZ_TARGET_UCLIBC_1_0_58_MIN
	select FREETZ_LIB_STDCXXLIB
	select FREETZ_LIB_libatomic
	select FREETZ_LIB_libpthread  if FREETZ_TARGET_UCLIBC_HAS_multiple_libs
	select FREETZ_LIB_libutil     if FREETZ_TARGET_UCLIBC_HAS_multiple_libs
	select FREETZ_LIB_librt       if FREETZ_TARGET_UCLIBC_HAS_multiple_libs
	default n
	help
		OpenThread is Google's open source implementation of the Thread
		networking protocol (Thread 1.4.0: IPv6, 6LoWPAN, 802.15.4 MAC
		security, MLE, mesh routing, Border Router support).

		This package builds the POSIX (Linux) version of the Thread stack:

		 - /usr/bin/ot-daemon   the Thread stack running as a daemon
		 - /usr/bin/ot-ctl      control client with the full CLI command set
		                        (talks to a running ot-daemon)

		Upstream selects the POSIX application as either/or: OT_APP_DAEMON
		(used here, ot-daemon + ot-ctl) or OT_APP_CLI for a standalone
		interactive ot-cli. ot-ctl offers the same command set while the
		Thread stack keeps running in the background.

		No 802.15.4 radio is built: the Thread interface requires an
		external Radio Co-Processor (RCP), for example an nRF52840 dongle
		flashed with the OpenThread RCP firmware, connected over UART
		(spinel+hdlc+uart:///dev/ttyACM0) or reached through a unix socket.

		Build notes:

		 - mbedTLS is the only git submodule of this tag and is fetched as a
		   pinned tarball (third_party/mbedtls/repo) before configure runs;
		   third_party/tcplp is vendored in the source archive.
		 - Upstream requires CMake >= 3.10.2, so the tree's CMake 4 is used
		   with -DCMAKE_POLICY_VERSION_MINIMUM=3.10.
		 - The Border Router daemon (otbr-agent) is provided by the separate
		   ot-br-posix package, which reuses this package's source tree.

		Useful for a Thread network that Matter controllers (and therefore
		Domoticz via python-matter-server) can reach.

		Can be externalized (External menu): ot-daemon and ot-ctl are moved to
		external storage; the daemon only needs the uClibc runtime.
```

## make/pkgs/ot-br-posix/Config.in
```kconfig
config FREETZ_PACKAGE_OT_BR_POSIX
	bool "OpenThread Border Router (ot-br-posix) 2026.10.0"
	depends on FREETZ_TARGET_UCLIBC_1_0_58_MIN
	select FREETZ_PACKAGE_OPENTHREAD
	select FREETZ_LIB_STDCXXLIB
	select FREETZ_LIB_libatomic
	select FREETZ_LIB_libpthread  if FREETZ_TARGET_UCLIBC_HAS_multiple_libs
	select FREETZ_LIB_libutil     if FREETZ_TARGET_UCLIBC_HAS_multiple_libs
	select FREETZ_LIB_librt       if FREETZ_TARGET_UCLIBC_HAS_multiple_libs
	default n
	help
		ot-br-posix is the OpenThread Border Router for Linux: otbr-agent
		attaches an 802.15.4 Radio Co-Processor (RCP) and connects the
		Thread mesh network to the IPv6 home network, so that Thread
		devices can be reached from the LAN.

		Installed binaries:

		 - /usr/sbin/otbr-agent   the Border Router daemon
		 - /usr/sbin/ot-ctl       control client (talks to otbr-agent)

		The Freetz configuration page offers the settings needed to start
		the agent: the infrastructure interface (default br0), the spinel
		URL of the RCP (default spinel+hdlc+uart:///dev/ttyACM0), the boot
		wait time for the RCP device and extra command line options.

		Runtime requirements on the Fritz!Box:

		 - an 802.15.4 RCP (for example an nRF52840 dongle) flashed with
		   the OpenThread RCP firmware, connected over USB/serial
		 - /dev/net/tun (the agent creates the Thread interface wpan0)
		 - IPv6 forwarding (net.ipv6.conf.all.forwarding=1)

		This is the Thread side of a Matter installation: Matter/Thread
		devices become reachable for a Matter controller (for example
		python-matter-server, which the Domoticz Matter driver talks to).

		All optional upstream components (D-Bus API, web GUI, REST server,
		NAT64, DHCPv6-PD, backbone router, nftables firewall) are disabled,
		which avoids the protobuf, dbus, jsoncpp, cJSON, cpp-httplib and
		libsystemd dependencies entirely. mDNS/DNS-SD is served by the
		OpenThread core (OTBR_MDNS=openthread), so no Avahi or
		mDNSResponder port is required.

		Can be externalized (External menu): otbr-agent (2.4 MB) and ot-ctl are
		moved to external storage; the agent takes its radio URL and
		infrastructure interface from the Freetz configuration.
```

## make/pkgs/oxker/Config.in
```kconfig
config FREETZ_PACKAGE_OXKER
	bool "oxker 0.13.2"
	depends on FREETZ_TARGET_UCLIBC_1_0_58_MIN
	default n
	help
		oxker utility package built from source using Rust/Cargo.
```

## make/pkgs/partclone/Config.in
```kconfig
config FREETZ_PACKAGE_PARTCLONE
	bool "partclone 0.3.31 (binary only)"
	depends on FREETZ_TARGET_UCLIBC_1_0_58_MIN
	select FREETZ_LIB_libcrypto
	select FREETZ_LIB_libblkid
	select FREETZ_LIB_libcom_err
	select FREETZ_LIB_libext2fs
	select FREETZ_LIB_libncursesw
	select FREETZ_LIB_libntfs
	select FREETZ_LIB_libuuid
	default n
	help
		Partclone provides block-level clone/restore/check tools.
		This package installs generic engines plus extended filesystem
		backends (extfs, xfs, ntfs, btrfs, exfat, f2fs, fat, minix, apfs,
		hfsp) and ncursesw support.
		
		Requires uClibc 1.0.58 or newer (needs libblkid from
		util-linux 2.41, which is unavailable on older toolchains).
```

## make/pkgs/parted/Config.in
```kconfig
config FREETZ_PACKAGE_PARTED
	bool "parted 3.6 (binary only)"
	select FREETZ_LIB_libuuid
	select FREETZ_LIB_libjemalloc
	default n
	help
		GNU Parted is a disk partition editor.
		
		This package is linked with jemalloc to reduce allocator-related
		crashes observed on some target combinations.

if FREETZ_PACKAGE_PARTED

	config FREETZ_PACKAGE_PARTED_parted
		bool "parted"
		default y
		help
			This option enables the interactive partition editor.

	config FREETZ_PACKAGE_PARTED_partprobe
		bool "partprobe"
		default y
		help
			This option enables the partition table re-read helper.

endif # FREETZ_PACKAGE_PARTED
```

## make/pkgs/patchelf/Config.in
```kconfig
config FREETZ_PACKAGE_PATCHELF
	bool "PatchELF 0.19.1 (binary only)"
	depends on FREETZ_TARGET_GCC_13_MIN  # in fact min gcc11 for C++17
	depends on FREETZ_TARGET_ARCH_LE  # BE is broken
	select FREETZ_STDCXXLIB_FORCE_GNULIBSTDCXX
	select FREETZ_LIB_STDCXXLIB
	select FREETZ_LIB_libjemalloc
	default n
	help
		Modifies existing ELF executables and libraries. Can change the interpreter,
		RPATH, and other ELF metadata.
		
		Useful for modifying binaries to use different dynamic linker paths or
		library search paths (RPATH/RUNPATH).
		
		Links against jemalloc to avoid segfault on uClibc MIPS targets.
```
