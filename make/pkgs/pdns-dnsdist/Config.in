## make/pkgs/python3-audioop-lts/Config.in
```kconfig
config FREETZ_PACKAGE_PYTHON3_AUDIOOP_LTS
	bool "audioop-lts 0.2.2"
	depends on FREETZ_PACKAGE_PYTHON3
	default n
	help
		LTS port of the audioop module removed from Python 3.13+.
		Provides audio processing operations as a C extension.
```

## make/pkgs/python3-av/Config.in
```kconfig
config FREETZ_PACKAGE_PYTHON3_AV
	bool "av 16.0.1"
	depends on FREETZ_PACKAGE_PYTHON3
	depends on FREETZ_PACKAGE_FFMPEG
	depends on FREETZ_PACKAGE_FFMPEG_VERSION_CURRENT
	select FREETZ_LIB_libavcodec
	select FREETZ_LIB_libavdevice
	select FREETZ_LIB_libavfilter
	select FREETZ_LIB_libavformat
	select FREETZ_LIB_libavutil
	select FREETZ_LIB_libswresample
	select FREETZ_LIB_libswscale
	default n
	help
		PyAV is Pythonic bindings for FFmpeg libraries.
		
		This package precompiles PyAV for the target, avoiding on-device
		build failures such as missing pkg-config during pip install.
		
		Requires FFmpeg "current" shared libraries at runtime.
		
		Website: https://pyav.basswood-io.com/
		Source: https://github.com/PyAV-Org/PyAV
```

## make/pkgs/python3-bcrypt/Config.in
```kconfig
config FREETZ_PACKAGE_PYTHON3_BCRYPT
	bool "bcrypt 5.0.0"
	depends on FREETZ_PACKAGE_PYTHON3
	default n
	help
		Modern password hashing for your software and your servers.
		Native Rust implementation via setuptools-rust (no CFFI).
		Requires Rust/Cargo (build time).
		
		Dependencies:
		  - Python 3.x
		  - Rust/Cargo (build time)
		
		Build: Uses pyproject/pip (PEP 517) with setuptools-rust
```

## make/pkgs/python3-bluetooth-data-tools/Config.in
```kconfig
config FREETZ_PACKAGE_PYTHON3_BLUETOOTH_DATA_TOOLS
	bool "bluetooth-data-tools 1.29.18 (pure python, prerequisite)"
	depends on FREETZ_PACKAGE_PYTHON3
	depends on FREETZ_TARGET_UCLIBC_1_0_58
	select FREETZ_PACKAGE_PYTHON3_CRYPTOGRAPHY
	default n
	help
		Tools for converting bluetooth data and packets.
		Provides BLE advertisement parsing, address utilities,
		distance estimation and monotonic time.
```

## make/pkgs/python3-brotli/Config.in
```kconfig
config FREETZ_PACKAGE_PYTHON3_BROTLI
	bool "brotli 1.1.0"
	depends on FREETZ_PACKAGE_PYTHON3
	default n
	help
		Python bindings for Brotli compression/decompression.
```
