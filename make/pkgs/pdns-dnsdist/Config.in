## make/pkgs/pdns-dnsdist/Config.in
```kconfig
comment "PowerDNS dnsdist 1.9.7"
	depends on !FREETZ_TARGET_GCC_8_MIN

menuconfig FREETZ_PACKAGE_DNSDIST
	bool "PowerDNS dnsdist 1.9.7"
	depends on FREETZ_TARGET_GCC_8_MIN
	select FREETZ_LIB_STDCXXLIB
	select FREETZ_LIB_libatomic if FREETZ_TARGET_ARCH_MIPS && FREETZ_TARGET_GCC_4_8_MIN
	select FREETZ_LIB_libcrypto
	select FREETZ_LIB_liblua
	default n
	help
		dnsdist from the upstream standalone release tarball.

		This package ships the dnsdist load-balancer binary in minimal
		mode with advanced optional protocols disabled by default.

if FREETZ_PACKAGE_DNSDIST

	config FREETZ_PACKAGE_DNSDIST_BINARY
		bool "dnsdist"
		default y
		help
			dnsdist DNS load-balancer daemon.

endif # FREETZ_PACKAGE_DNSDIST
```

## make/pkgs/pdns-recursor/Config.in
```kconfig
comment "PowerDNS Recursor 5.0.5 (requires GCC 8+/C++17)"
	depends on !FREETZ_TARGET_GCC_8_MIN

menuconfig FREETZ_PACKAGE_PDNS_RECURSOR
	bool "PowerDNS Recursor 5.0.5"
	depends on FREETZ_TARGET_GCC_8_MIN
	select FREETZ_LIB_STDCXXLIB
	select FREETZ_LIB_libatomic if FREETZ_TARGET_ARCH_MIPS && FREETZ_TARGET_GCC_4_8_MIN
	select FREETZ_LIB_libcrypto
	select FREETZ_LIB_liblua
	default n
	help
		PowerDNS Recursor from the upstream standalone release tarball.

		This package builds the recursive resolver daemon and the
		rec_control runtime helper.

if FREETZ_PACKAGE_PDNS_RECURSOR

	config FREETZ_PACKAGE_PDNS_RECURSOR_BINARY
		bool "pdns_recursor"
		default y
		help
			PowerDNS recursive resolver daemon.

	config FREETZ_PACKAGE_PDNS_RECURSOR_REC_CONTROL
		bool "rec_control (binary only)"
		default y
		help
			Runtime control tool for pdns_recursor.

endif # FREETZ_PACKAGE_PDNS_RECURSOR
```

## make/pkgs/postgresql/Config.in
```kconfig
config FREETZ_PACKAGE_POSTGRESQL
	bool "PostgreSQL 16.3 (client tools)"
	depends on FREETZ_TARGET_GCC_4_8_MIN
	select FREETZ_LIB_libpq
	default n
	help
		PostgreSQL client package.
		Installs psql and links against libpq.

if FREETZ_PACKAGE_POSTGRESQL

config FREETZ_PACKAGE_POSTGRESQL_SERVER
	bool "Install server binaries (postgres, pg_ctl, initdb)"
	default n
	help
		Enable this option to install core PostgreSQL server binaries.
		This is intended for advanced setups.

endif # FREETZ_PACKAGE_POSTGRESQL
```

## make/pkgs/powerdns/Config.in
```kconfig
comment "PowerDNS Authoritative Server 5.0.5 (requires GCC 8+/C++17)"
	depends on !FREETZ_TARGET_GCC_8_MIN

menuconfig FREETZ_PACKAGE_POWERDNS
	bool "PowerDNS Authoritative Server 5.0.5"
	depends on FREETZ_TARGET_GCC_8_MIN
	select FREETZ_LIB_STDCXXLIB
	select FREETZ_LIB_libatomic if FREETZ_TARGET_ARCH_MIPS && FREETZ_TARGET_GCC_4_8_MIN
	select FREETZ_LIB_libcrypto
	select FREETZ_LIB_liblua
	select FREETZ_LIB_libssl if FREETZ_PACKAGE_POWERDNS_WITH_DNS_OVER_TLS
	default n
	help
		PowerDNS Authoritative Server from the upstream pdns source tree.

		This freetz port packages the Authoritative Server only.
		Upstream recursor and dnsdist are not included here.

		The default configuration stays close to the minimal upstream mode:
		no backend or optional server feature is enabled unless selected below.

if FREETZ_PACKAGE_POWERDNS

	config FREETZ_PACKAGE_POWERDNS_SERVER
		bool "pdns_server"
		default y
		help
			Authoritative server daemon.

	config FREETZ_PACKAGE_POWERDNS_PDNSUTIL
		bool "pdnsutil (binary only)"
		default n
		help
			DNSSEC and zone maintenance utility.

	config FREETZ_PACKAGE_POWERDNS_PDNS_CONTROL
		bool "pdns_control (binary only)"
		default n
		help
			Runtime control helper for pdns_server.

	config FREETZ_PACKAGE_POWERDNS_ZONE2SQL
		bool "zone2sql (binary only)"
		default n
		help
			Convert zone files to SQL statements.

	config FREETZ_PACKAGE_POWERDNS_ZONE2JSON
		bool "zone2json (binary only)"
		default n
		help
			Convert zone files to JSON.

	config FREETZ_PACKAGE_POWERDNS_TOOLS
		bool "Extra diagnostic tools"
		default n
		select FREETZ_LIB_libcurl
		help
			Build the optional Authoritative Server tool set:
			pdns_notify, sdig, calidns, dnsdemog, dnsgram,
			dnspcap2calidns, dnspcap2protobuf, dnsreplay, dnsscan,
			dnsscope, dnswasher, nproxy, nsec3dig, dumresp, kvresp,
			stubquery, saxfr, ixplore, dnstcpbench and dnsbulktest.

	menu "Optional server features"

		config FREETZ_PACKAGE_POWERDNS_WITH_LUA_RECORDS
			bool "Enable Lua records"
			default n
			help
				Enable Lua record support. Disabled by default to keep the
				package in minimal mode.

		config FREETZ_PACKAGE_POWERDNS_WITH_DNS_OVER_TLS
			bool "Enable DNS-over-TLS support"
			default n
			help
				Enable DNS-over-TLS support using OpenSSL in this port.

		config FREETZ_PACKAGE_POWERDNS_WITH_IPCIPHER
			bool "Enable IPCipher support"
			default n
			help
				Enable the optional IPCipher helper code.

		config FREETZ_PACKAGE_POWERDNS_WITH_VERBOSE_LOGGING
			bool "Enable verbose logging"
			default n
			help
				Build with upstream verbose logging support.

		comment "OpenSSL-based signers are built automatically with libcrypto."

		comment "Alternative GnuTLS TLS provider is not wired in this port; DNS-over-TLS uses OpenSSL."

		comment "ixfrdist is not available: yaml-cpp is not packaged in this tree."

		comment "libsodium signers are not available: libsodium is not packaged in this tree."

		comment "PKCS11 support is not available: no PKCS#11 userspace stack is packaged here."

		comment "GSS-TSIG support is not available: no Kerberos/GSS client stack is packaged here."

		comment "Remote backend ZeroMQ connector is not available: libzmq is not packaged in this tree."

	endmenu

	comment "HINT: Keep AVM DNS enabled unless you explicitly reconfigure PowerDNS for port 53."
		depends on FREETZ_PACKAGE_POWERDNS_SERVER

	config FREETZ_PACKAGE_POWERDNS_DISABLE_DNS
		bool "Disable multid's DNS/LLMNR"
		depends on FREETZ_AVM_HAS_AVMMULTID_PRELOAD
		depends on FREETZ_PACKAGE_POWERDNS_SERVER
		select FREETZ_AVMDAEMON_DISABLE_MULTIDPORTS
		select FREETZ_AVMDAEMON_DISABLE_DNS
		select FREETZ_AVMDAEMON_DISABLE_LLMNR
		default n
		help
			Use this only when you want PowerDNS to listen on the standard DNS port.

	menu "Backends"

		config FREETZ_PACKAGE_POWERDNS_BACKEND_BIND
			bool "bind backend"
			default n
			help
				Zone-file based backend.

		config FREETZ_PACKAGE_POWERDNS_BACKEND_BIND_DYNAMIC
			bool "Build bind backend as dynamic module"
			depends on FREETZ_PACKAGE_POWERDNS_BACKEND_BIND
			default n

		config FREETZ_PACKAGE_POWERDNS_BACKEND_PIPE
			bool "pipe backend"
			default n
			help
				External backend bridge.

		config FREETZ_PACKAGE_POWERDNS_BACKEND_PIPE_DYNAMIC
			bool "Build pipe backend as dynamic module"
			depends on FREETZ_PACKAGE_POWERDNS_BACKEND_PIPE
			default n

		config FREETZ_PACKAGE_POWERDNS_BACKEND_GMYSQL
			bool "gmysql backend"
			depends on FREETZ_PACKAGE_MYSQL_mysql
			default n
			help
				Generic MySQL backend. Requires the MySQL client package.

		config FREETZ_PACKAGE_POWERDNS_BACKEND_GMYSQL_DYNAMIC
			bool "Build gmysql backend as dynamic module"
			depends on FREETZ_PACKAGE_POWERDNS_BACKEND_GMYSQL
			default n

		config FREETZ_PACKAGE_POWERDNS_BACKEND_GSQLITE3
			bool "gsqlite3 backend"
			default n
			select FREETZ_LIB_libsqlite3
			help
				Generic SQLite3 backend.

		config FREETZ_PACKAGE_POWERDNS_BACKEND_GSQLITE3_DYNAMIC
			bool "Build gsqlite3 backend as dynamic module"
			depends on FREETZ_PACKAGE_POWERDNS_BACKEND_GSQLITE3
			default n

		config FREETZ_PACKAGE_POWERDNS_BACKEND_GEOIP
			bool "geoip backend"
			default n
			select FREETZ_LIB_libmaxminddb
			help
				Geo backend using MaxMind DB.

		config FREETZ_PACKAGE_POWERDNS_BACKEND_GEOIP_DYNAMIC
			bool "Build geoip backend as dynamic module"
			depends on FREETZ_PACKAGE_POWERDNS_BACKEND_GEOIP
			default n

		config FREETZ_PACKAGE_POWERDNS_BACKEND_LUA2
			bool "lua2 backend"
			default n
			help
				Lua-based backend.

		config FREETZ_PACKAGE_POWERDNS_BACKEND_LUA2_DYNAMIC
			bool "Build lua2 backend as dynamic module"
			depends on FREETZ_PACKAGE_POWERDNS_BACKEND_LUA2
			default n

		config FREETZ_PACKAGE_POWERDNS_BACKEND_REMOTE
			bool "remote backend"
			default n
			help
				Remote backend without the optional ZeroMQ connector.

		config FREETZ_PACKAGE_POWERDNS_BACKEND_REMOTE_DYNAMIC
			bool "Build remote backend as dynamic module"
			depends on FREETZ_PACKAGE_POWERDNS_BACKEND_REMOTE
			default n

		comment "godbc backend is not available: unixODBC is not packaged in this tree."

		comment "gpgsql backend is not available: PostgreSQL client libraries are not packaged in this tree."

		comment "ldap backend is not available: OpenLDAP client libraries are not packaged in this tree."

		comment "lmdb backend is not available: LMDB is not packaged in this tree."

		comment "tinydns backend is not available: cdb support is not packaged in this tree."

	endmenu

	comment "HINT: Enable at least one backend before starting PowerDNS."
		depends on FREETZ_PACKAGE_POWERDNS_SERVER && \
			!FREETZ_PACKAGE_POWERDNS_BACKEND_BIND && \
			!FREETZ_PACKAGE_POWERDNS_BACKEND_PIPE && \
			!FREETZ_PACKAGE_POWERDNS_BACKEND_GMYSQL && \
			!FREETZ_PACKAGE_POWERDNS_BACKEND_GSQLITE3 && \
			!FREETZ_PACKAGE_POWERDNS_BACKEND_GEOIP && \
			!FREETZ_PACKAGE_POWERDNS_BACKEND_LUA2 && \
			!FREETZ_PACKAGE_POWERDNS_BACKEND_REMOTE

endif # FREETZ_PACKAGE_POWERDNS
```

## make/pkgs/procs/Config.in
```kconfig
config FREETZ_PACKAGE_PROCS
	bool "procs 0.14.11"
	depends on FREETZ_TARGET_UCLIBC_1_0_58
	default n
	help
		procs utility package built from source using Rust/Cargo.
```

## make/pkgs/prometheus/Config.in
```kconfig
config FREETZ_PACKAGE_PROMETHEUS
	bool "prometheus 3.11.3 (binary only)"
	default n
	help
		Prometheus is an open-source monitoring and alerting toolkit.

		This package cross-compiles the upstream Go sources and installs the
		prometheus executable on the target.

		Can be externalized to save flash memory.
```

## make/pkgs/pseudo-pi-hole-cgi/Config.in
```kconfig
config FREETZ_PACKAGE_PSEUDO_PI_HOLE_CGI
	bool "Pseudo-Pi-hole CGI web configuration interface"
	depends on FREETZ_PACKAGE_PSEUDO_PI_HOLE_DAEMON
	depends on FREETZ_SHOW_DEVELOPER
	select FREETZ_BUSYBOX_START_STOP_DAEMON
	default y
	help
		Provides a web configuration interface for Pseudo-Pi-hole DNS Sinkhole.
		Access: http://fritz.box:81/cgi-bin/conf/pseudo-pi-hole
```

## make/pkgs/pseudo-pi-hole/Config.in
```kconfig
comment "Pseudo-Pi-hole (needs dnsmasq)"
	depends on !FREETZ_PACKAGE_DNSMASQ

menuconfig FREETZ_PACKAGE_PSEUDO_PI_HOLE
	bool "Pseudo-Pi-hole DNS Sinkhole"
	depends on FREETZ_PACKAGE_DNSMASQ
	depends on FREETZ_SHOW_DEVELOPER
	select FREETZ_BUSYBOX_EGREP
	select FREETZ_PACKAGE_WGET
	select FREETZ_PACKAGE_WGET_WITH_SSL
	select FREETZ_PACKAGE_WGET_CA_BUNDLE
	default n
	help
		Pi-hole-like DNS sinkhole for freetz-ng.
		Blocks DNS queries for known advertising and tracking domains.
		Uses dnsmasq for DNS blocking via addn-hosts.
		Shell scripts for blocklist management (gravity).
		This is NOT the official Pi-hole. It reimplements Pi-hole-like
		functionality using existing freetz components (dnsmasq + shell scripts).
		No pihole-FTL daemon is required.
		Requires: dnsmasq, wget for blocklist downloads.
		Web interface: http://fritz.box:81/cgi-bin/conf/pseudo-pi-hole

if FREETZ_PACKAGE_PSEUDO_PI_HOLE

	config FREETZ_PACKAGE_PSEUDO_PI_HOLE_DAEMON
		bool "Pseudo-Pi-hole daemon and core scripts"
		default y
		help
			Installs Pseudo-Pi-hole core scripts (pihole command, gravity blocklist manager).

	config FREETZ_PACKAGE_PSEUDO_PI_HOLE_CGI
		bool "Pseudo-Pi-hole CGI web configuration interface"
		depends on FREETZ_PACKAGE_PSEUDO_PI_HOLE_DAEMON
		select FREETZ_BUSYBOX_START_STOP_DAEMON
		default y

endif # FREETZ_PACKAGE_PSEUDO_PI_HOLE
```

## make/pkgs/python-pip/Config.in
```kconfig
config FREETZ_PACKAGE_PYTHON_PIP
	bool "pip 20.3.4"
	depends on FREETZ_PACKAGE_PYTHON
	default n
	help
		pip is a pure-Python prerequisite/tooling module.
		pip is the package installer for Python 2.7.
		
		This package bootstraps pip using get-pip.py for Python 2.7.
		
		Usage examples:
		  pip2 install requests
		  pip2 list
		  pip2 uninstall package-name
		
		Note: Python 2 is deprecated upstream. Prefer Python 3 when possible.
		
		Website: https://pip.pypa.io/
		Docs: https://pip.pypa.io/en/stable/
```

## make/pkgs/python3-aiodns/Config.in
```kconfig
config FREETZ_PACKAGE_PYTHON3_AIODNS
	bool "aiodns 4.0.0"
	depends on FREETZ_PACKAGE_PYTHON3
	select FREETZ_PACKAGE_PYTHON3_PYCARES
	default n
	help
		Asynchronous DNS resolver for asyncio (uses pycares).
```

## make/pkgs/python3-aiohappyeyeballs/Config.in
```kconfig
config FREETZ_PACKAGE_PYTHON3_AIOHAPPYEYEBALLS
	bool "aiohappyeyeballs 2.6.1 (pure python, prerequisite)"
	depends on FREETZ_PACKAGE_PYTHON3
	default n
	help
		aiohappyeyeballs is a pure-Python prerequisite module.
		It provides happy-eyeballs connector utilities for asyncio.
```

## make/pkgs/python3-aiohttp-asyncmdnsresolver/Config.in
```kconfig
config FREETZ_PACKAGE_PYTHON3_AIOHTTP_ASYNCMDNSRESOLVER
	bool "aiohttp-asyncmdnsresolver 0.1.1"
	depends on FREETZ_PACKAGE_PYTHON3
	select FREETZ_PACKAGE_PYTHON3_AIOHTTP
	select FREETZ_PACKAGE_PYTHON3_AIODNS
	select FREETZ_PACKAGE_PYTHON3_ZEROCONF
	default n
	help
		Async MDNS resolver plugin for aiohttp.
```

## make/pkgs/python3-aiohttp-fast-zlib/Config.in
```kconfig
config FREETZ_PACKAGE_PYTHON3_AIOHTTP_FAST_ZLIB
	bool "aiohttp-fast-zlib 0.3.0"
	depends on FREETZ_PACKAGE_PYTHON3
	select FREETZ_PACKAGE_PYTHON3_AIOHTTP
	default n
	help
		Use the fastest available zlib-compatible backend with aiohttp.
```

## make/pkgs/python3-aiohttp/Config.in
```kconfig
config FREETZ_PACKAGE_PYTHON3_AIOHTTP
	bool "aiohttp 3.13.5"
	depends on FREETZ_PACKAGE_PYTHON3
	select FREETZ_PACKAGE_PYTHON3_AIOHAPPYEYEBALLS
	select FREETZ_PACKAGE_PYTHON3_AIOSIGNAL
	select FREETZ_PACKAGE_PYTHON3_ASYNC_TIMEOUT
	select FREETZ_PACKAGE_PYTHON3_ATTRS
	select FREETZ_PACKAGE_PYTHON3_CHARSET_NORMALIZER
	select FREETZ_PACKAGE_PYTHON3_FROZENLIST
	select FREETZ_PACKAGE_PYTHON3_MULTIDICT
	select FREETZ_PACKAGE_PYTHON3_YARL
	default n
	help
		aiohttp is an asynchronous HTTP client/server framework for asyncio.
```

## make/pkgs/python3-aiosignal/Config.in
```kconfig
config FREETZ_PACKAGE_PYTHON3_AIOSIGNAL
	bool "aiosignal 1.4.0 (pure python, prerequisite)"
	depends on FREETZ_PACKAGE_PYTHON3
	select FREETZ_PACKAGE_PYTHON3_FROZENLIST
	default n
	help
		aiosignal is a pure-Python prerequisite module.
		It manages callbacks in asyncio projects.
```

## make/pkgs/python3-android-backup/Config.in
```kconfig
config FREETZ_PACKAGE_PYTHON3_ANDROID_BACKUP
	bool "android_backup 0.2.0"
	depends on FREETZ_PACKAGE_PYTHON3
	default n
	help
		Helper to back up and restore Android devices over ADB (pure Python helper used by micloud).
```

## make/pkgs/python3-annotatedyaml/Config.in
```kconfig
config FREETZ_PACKAGE_PYTHON3_ANNOTATEDYAML
	bool "annotatedyaml 1.0.2"
	depends on FREETZ_PACKAGE_PYTHON3
	select FREETZ_PACKAGE_PYTHON3_PROPCACHE
	select FREETZ_PACKAGE_PYTHON3_PYYAML
	select FREETZ_PACKAGE_PYTHON3_VOLUPTUOUS
	default n
	help
		Annotated YAML that supports secrets for Python.
		Used by Home Assistant for YAML configuration handling.
		Optionally uses Cython for performance.
```

## make/pkgs/python3-appdirs/Config.in
```kconfig
config FREETZ_PACKAGE_PYTHON3_APPDIRS
	bool "appdirs 1.4.4"
	depends on FREETZ_PACKAGE_PYTHON3
	default n
	help
		Small module that returns the platform specific user data, cache and config directories.
```

## make/pkgs/python3-async-timeout/Config.in
```kconfig
config FREETZ_PACKAGE_PYTHON3_ASYNC_TIMEOUT
	bool "async-timeout 5.0.1 (pure python, prerequisite)"
	depends on FREETZ_PACKAGE_PYTHON3
	default n
	help
		async-timeout is a pure-Python prerequisite module.
		It provides timeout context management for asyncio.
```

## make/pkgs/python3-attrs/Config.in
```kconfig
config FREETZ_PACKAGE_PYTHON3_ATTRS
	bool "attrs 26.1.0 (pure python, prerequisite)"
	depends on FREETZ_PACKAGE_PYTHON3
	default n
	help
		attrs is a pure-Python prerequisite module.
		It provides declarative class helpers.
```
