## make/pkgs/ddrescue/Config.in
```kconfig
config FREETZ_PACKAGE_DDRESCUE
	bool "GNU ddrescue 1.30 (binary only)"
	default n
	help
		GNU ddrescue is a data recovery tool with mapfile support.
		This package installs ddrescue and ddrescuelog.
```

## make/pkgs/dialog/Config.in
```kconfig
config FREETZ_PACKAGE_DIALOG
	bool "dialog 1.3-20230209 (binary only)"
	select FREETZ_LIB_libncurses
	default n
	help
		Dialog is a script-interpreter which provides a set of widgets
		for building text user interfaces in terminal environments.
		Built with whiptail-compatibility enabled.
```

## make/pkgs/disk-mgmt-cgi/Config.in
```kconfig
config FREETZ_PACKAGE_DISK_MGMT_CGI
	bool "Disk Management CGI"
	depends on FREETZ_AVM_HAS_USB_HOST
	select FREETZ_BUSYBOX_START_STOP_DAEMON
	select FREETZ_PACKAGE_PARTED
	select FREETZ_PACKAGE_PARTED_parted
	select FREETZ_PACKAGE_PARTED_partprobe
	select FREETZ_PACKAGE_EXFATPROGS
	select FREETZ_PACKAGE_EXFATPROGS_mkfs_exfat
	select FREETZ_PACKAGE_EXFATPROGS_fsck_exfat
	select FREETZ_PACKAGE_EXFATPROGS_exfatlabel
	select FREETZ_PACKAGE_DOSFSTOOLS
	select FREETZ_PACKAGE_DOSFSTOOLS_fsck_fat
	select FREETZ_PACKAGE_DOSFSTOOLS_fatlabel
	select FREETZ_PACKAGE_DOSFSTOOLS_mkfs_fat
	select FREETZ_PACKAGE_FATRESIZE
	select FREETZ_PACKAGE_E2FSPROGS
	select FREETZ_PACKAGE_E2FSPROGS_SUFFIX_NG
	select FREETZ_PACKAGE_E2FSPROGS_E2FSCK
	select FREETZ_PACKAGE_E2FSPROGS_TOOL_E2FSCK
	select FREETZ_PACKAGE_E2FSPROGS_E2MAKING
	select FREETZ_PACKAGE_E2FSPROGS_TOOL_MKE2FS
	select FREETZ_PACKAGE_E2FSPROGS_E2RESIZE
	select FREETZ_PACKAGE_E2FSPROGS_TOOL_RESIZE2FS
	select FREETZ_PACKAGE_E2FSPROGS_E2TUNING
	select FREETZ_PACKAGE_E2FSPROGS_TOOL_TUNE2FS
	select FREETZ_PACKAGE_E2FSPROGS_TOOL_E2LABEL
	select FREETZ_PACKAGE_E2FSPROGS_BLKID
	select FREETZ_PACKAGE_NTFS
	select FREETZ_PACKAGE_NTFS_TOOLS
	select FREETZ_PACKAGE_NTFS_mkntfs
	select FREETZ_PACKAGE_NTFS_ntfsfix
	select FREETZ_PACKAGE_NTFS_ntfsinfo
	select FREETZ_PACKAGE_NTFS_ntfslabel
	select FREETZ_PACKAGE_NTFS_ntfsresize
	select FREETZ_PACKAGE_GPTFDISK
	select FREETZ_PACKAGE_GPTFDISK_gdisk
	select FREETZ_PACKAGE_GPTFDISK_cgdisk
	select FREETZ_PACKAGE_GPTFDISK_sgdisk
	select FREETZ_PACKAGE_GPTFDISK_fixparts
	select FREETZ_PACKAGE_HDPARM
	select FREETZ_PACKAGE_SMARTMONTOOLS
	select FREETZ_PACKAGE_UTIL_LINUX
	select FREETZ_UTIL_LINUX_BLKID if FREETZ_UTIL_LINUX_VERSION_2_41
	select FREETZ_UTIL_LINUX_LSBLK if FREETZ_UTIL_LINUX_VERSION_2_41
	default n
	help
		Disk Management web UI.
		This is the same as in Packages -> Disk Tools
		http://fritz.box:81/cgi-bin/conf/disk-mgmt

if FREETZ_PACKAGE_DISK_MGMT_CGI

	comment "Note: NTFS mount uses AVM stack when ntfs-3g driver is unavailable"
		depends on FREETZ_AVMPLUGINS_NTFS || FREETZ_AVM_HAS_ANTFS_FS_BUILTIN || (FREETZ_AVM_HAS_NTFS && !FREETZ_REMOVE_NTFS)

endif
```

## make/pkgs/disk-mgmt/Config.in
```kconfig
config FREETZ_PACKAGE_DISK_MGMT
	bool "Disk Management (disk-mgmt)"
	default n
	depends on FREETZ_AVM_HAS_USB_HOST
	select FREETZ_PACKAGE_PARTED
	select FREETZ_PACKAGE_PARTED_parted
	select FREETZ_PACKAGE_PARTED_partprobe
	select FREETZ_PACKAGE_DOSFSTOOLS
	select FREETZ_PACKAGE_DOSFSTOOLS_fsck_fat
	select FREETZ_PACKAGE_DOSFSTOOLS_fatlabel
	select FREETZ_PACKAGE_DOSFSTOOLS_mkfs_fat
	select FREETZ_PACKAGE_E2FSPROGS
	select FREETZ_PACKAGE_E2FSPROGS_SUFFIX_NG
	select FREETZ_PACKAGE_E2FSPROGS_E2FSCK
	select FREETZ_PACKAGE_E2FSPROGS_E2MAKING
	select FREETZ_PACKAGE_E2FSPROGS_E2RESIZE
	select FREETZ_PACKAGE_E2FSPROGS_E2TUNING
	select FREETZ_PACKAGE_E2FSPROGS_BLKID
	select FREETZ_PACKAGE_NTFS
	select FREETZ_PACKAGE_NTFS_TOOLS
	select FREETZ_PACKAGE_NTFS_mkntfs
	select FREETZ_PACKAGE_NTFS_ntfsfix
	select FREETZ_PACKAGE_NTFS_ntfsinfo
	select FREETZ_PACKAGE_NTFS_ntfslabel
	select FREETZ_PACKAGE_NTFS_ntfsresize
	select FREETZ_PACKAGE_GPTFDISK
	select FREETZ_PACKAGE_GPTFDISK_gdisk
	select FREETZ_PACKAGE_GPTFDISK_cgdisk
	select FREETZ_PACKAGE_GPTFDISK_sgdisk
	select FREETZ_PACKAGE_GPTFDISK_fixparts
	select FREETZ_PACKAGE_HDPARM
	select FREETZ_PACKAGE_SMARTMONTOOLS
	select FREETZ_PACKAGE_UTIL_LINUX
	select FREETZ_UTIL_LINUX_BLKID if FREETZ_UTIL_LINUX_VERSION_2_41
	select FREETZ_UTIL_LINUX_LSBLK if FREETZ_UTIL_LINUX_VERSION_2_41
	help
		Disk management web interface (superset of classic parted usage).
		
		Features:
		- Device and partition map visualization
		- Drag-like partition resize planning
		- Partition creation/deletion and metadata update
		- Filesystem creation/check/label operations
		- Toolchain diagnostics and capability analysis
		
		The interface is available at:
		http://fritz.box:81/cgi-bin/conf/disk-mgmt

if FREETZ_PACKAGE_DISK_MGMT

	comment "Note: NTFS mount uses AVM stack when ntfs-3g driver is unavailable"
		depends on FREETZ_AVMPLUGINS_NTFS || FREETZ_AVM_HAS_ANTFS_FS_BUILTIN || (FREETZ_AVM_HAS_NTFS && !FREETZ_REMOVE_NTFS)

	config FREETZ_PACKAGE_DISK_MGMT_CGI
		bool "Disk Management CGI web interface"
		default y
		help
			Provides the Disk Management web interface in the freetz UI.
			This is the same symbol shown in "Packages -> Web interfaces".

endif
```

## make/pkgs/domoticz-ada-p1-meter/Config.in
```kconfig
config FREETZ_PACKAGE_DOMOTICZ_ADA_P1_METER
	bool "Domoticz plugin: ADA P1 meter"
	depends on FREETZ_PACKAGE_DOMOTICZ
	default n
	help
		Support for the ADA P1 meter (greenhess.com), a reader that
		publishes the P1 telegram of a smart meter on the local network:
		the plugin polls it and creates the energy devices of the
		installation — imported and exported energy, the per-tariff
		counters, current power, and the gas/water values when the meter
		reports them.

		It is the counterpart of the
		FREETZ_PACKAGE_DOMOTICZ_HOMEWIZARD_P1 plugin for owners of an ADA
		reader. Both can coexist: they create independent device sets.

		The plugin uses only the Domoticz module and the Python standard
		library, and its labels follow the language of the hardware entry
		(17 translations).

		Setup: Setup -> Hardware -> add the ADA P1 meter, enter the IP
		address of the reader and, where required, the Domoticz address
		(127.0.0.1) and its HTTP port (8080).

		Upstream publishes no license file, so the plugin keeps the
		licensing status upstream gave it; the build fetches a pinned
		commit of the main branch because there are no release tags.
```

## make/pkgs/domoticz-airpurifier/Config.in
```kconfig
config FREETZ_PACKAGE_DOMOTICZ_AIRPURIFIER
	bool "Domoticz plugin: Xiaomi air purifiers"
	depends on FREETZ_PACKAGE_DOMOTICZ
	select FREETZ_PACKAGE_PYTHON3_MIIO
	default n
	help
		control of the Xiaomi / Mi air purifiers that answer the miIO
		protocol (AirPurifier 2 and the related models) over the LAN

		It is a Python plugin of Domoticz: the package installs it into
		/usr/share/domoticz/plugins/domoticz-AirPurifier, the directory Domoticz is
		started with (-approot of the domoticz package), and it needs no
		change of the Domoticz build.

		The plugin needs python-miio (installed as a dependency of this
		package) in addition to the standard library. python-miio speaks
		to the device directly on the LAN, so no Xiaomi account is used:
		the address of the purifier and its token are the settings of the
		plugin (the token is read out of the Xiaomi Home app or of a
		miiocli based tool once).

		Setup: Setup -> Hardware -> AirPurifier, enter the address of the
		purifier in Address and its token in Mode1.

		The upstream repository has no release tags, so the build fetches a
		pinned commit of the default branch. Upstream ships no license
		file: the README is installed with the plugin.
```

## make/pkgs/domoticz-alphaess/Config.in
```kconfig
config FREETZ_PACKAGE_DOMOTICZ_ALPHAESS
	bool "Domoticz plugin: alphaESS battery"
	depends on FREETZ_PACKAGE_DOMOTICZ
	default n
	help
		battery status of an alphaESS storage system through its cloud API

		It is a Python plugin of Domoticz: the package installs it into
		/usr/share/domoticz/plugins/alphaESS-battery-plugin, the directory Domoticz is
		started with (-approot of the domoticz package), and it needs no
		change of the Domoticz build.

		The plugin imports the Domoticz module and the Python standard
		library only, so no additional Python package is required.

		Setup: Setup -> Hardware -> alphaESS, enter the credentials of the alphaESS portal.

		Upstream publishes no license file, so the plugin keeps the licensing
		status upstream gave it. The
		repository has no release tags, so the build fetches a pinned commit of
		the default branch.
```

## make/pkgs/domoticz-apc-ups/Config.in
```kconfig
config FREETZ_PACKAGE_DOMOTICZ_APC_UPS
	bool "Domoticz plugin: APC UPS monitor"
	depends on FREETZ_PACKAGE_DOMOTICZ
	default n
	help
		monitor an APC UPS through the apcupsd daemon or its SNMP interface

		It is a Python plugin of Domoticz: the package installs it into
		/usr/share/domoticz/plugins/domoticz-apc-ups-plugin, the directory Domoticz is
		started with (-approot of the domoticz package), and it needs no
		change of the Domoticz build.

		The plugin imports the Domoticz module and the Python standard
		library only, so no additional Python package is required.

		Setup: Setup -> Hardware -> APC UPS, enter the address and the community of the UPS.

		Licensed upstream (LICENSE is installed with the plugin). The
		repository has no release tags, so the build fetches a pinned commit of
		the default branch.
```

## make/pkgs/domoticz-awtrix3/Config.in
```kconfig
config FREETZ_PACKAGE_DOMOTICZ_AWTRIX3
	bool "Domoticz plugin: AWTRIX 3"
	depends on FREETZ_PACKAGE_DOMOTICZ
	select FREETZ_PACKAGE_PYTHON3_REQUESTS
	default n
	help
		notifications and data on an AWTRIX 3 clock or LED matrix (it uses requests for the HTTP API of AWTRIX 3 and installs the icons it sends to the matrix).

		It is a Python plugin of Domoticz: the package installs it into
		/usr/share/domoticz/plugins/Domoticz-AWTRIX3-Plugin, the directory Domoticz is
		started with (-approot of the domoticz package), and it needs no
		change of the Domoticz build.

		Setup -> Hardware -> AWTRIX3, enter the address of the device.

		Licensed upstream (LICENSE is installed with the plugin). The
		repository has no release tags, so the build fetches a pinned commit of
		the default branch.
```

## make/pkgs/domoticz-battery-level/Config.in
```kconfig
config FREETZ_PACKAGE_DOMOTICZ_BATTERY_LEVEL
	bool "Domoticz plugin: BatteryLevel"
	depends on FREETZ_PACKAGE_DOMOTICZ
	select FREETZ_PACKAGE_PYTHON3_PAHO_MQTT
	default n
	help
		monitoring of the battery level of the devices, with notifications on the thresholds (it connects to the MQTT broker with paho-mqtt).

		It is a Python plugin of Domoticz: the package installs it into
		/usr/share/domoticz/plugins/BatteryLevel, the directory Domoticz is
		started with (-approot of the domoticz package), and it needs no
		change of the Domoticz build.

		Setup -> Hardware -> BatteryLevel, enter the MQTT broker and the devices to follow.

		Licensed upstream (LICENSE is installed with the plugin). The
		repository has no release tags, so the build fetches a pinned commit of
		the default branch.
```

## make/pkgs/domoticz-camera-bridge/Config.in
```kconfig
config FREETZ_PACKAGE_DOMOTICZ_CAMERA_BRIDGE
	bool "Domoticz plugin: RTSP camera bridge"
	depends on FREETZ_PACKAGE_DOMOTICZ
	default n
	help
		publish RTSP camera snapshots as still JPEG images for the Domoticz camera devices

		It is a Python plugin of Domoticz: the package installs it into
		/usr/share/domoticz/plugins/domoticz-camera-bridge, the directory Domoticz is
		started with (-approot of the domoticz package), and it needs no
		change of the Domoticz build.

		The plugin imports the Domoticz module and the Python standard
		library only, so no additional Python package is required.

		Setup: Setup -> Hardware -> Camera bridge, add one entry per camera with its RTSP URL.

		Licensed upstream (LICENSE is installed with the plugin). The
		repository has no release tags, so the build fetches a pinned commit of
		the default branch.
```

## make/pkgs/domoticz-chromecast/Config.in
```kconfig
config FREETZ_PACKAGE_DOMOTICZ_CHROMECAST
	bool "Domoticz plugin: Chromecast"
	depends on FREETZ_PACKAGE_DOMOTICZ
	select FREETZ_PACKAGE_PYTHON3_PYCHROMECAST
	select FREETZ_PACKAGE_PYTHON3_REQUESTS
	default n
	help
		discovery and control of Chromecast and Google Cast devices: media, playback state and volume (it uses pychromecast, which brings protobuf and zeroconf).

		It is a Python plugin of Domoticz: the package installs it into
		/usr/share/domoticz/plugins/ChromecastPlugin, the directory Domoticz is
		started with (-approot of the domoticz package), and it needs no
		change of the Domoticz build.

		Setup -> Hardware -> Chromecast, enter the address of the device or let the plugin discover it.

		Upstream ships no license file: the README is installed with the plugin. The
		repository has no release tags, so the build fetches a pinned commit of
		the default branch.
```

## make/pkgs/domoticz-dahua-vto/Config.in
```kconfig
config FREETZ_PACKAGE_DOMOTICZ_DAHUA_VTO
	bool "Domoticz plugin: Dahua VTO door intercom"
	depends on FREETZ_PACKAGE_DOMOTICZ
	default n
	help
		read a Dahua VTO door intercom (calls, door release, snapshots)

		It is a Python plugin of Domoticz: the package installs it into
		/usr/share/domoticz/plugins/dahua-vto-dz, the directory Domoticz is
		started with (-approot of the domoticz package), and it needs no
		change of the Domoticz build.

		The plugin imports the Domoticz module and the Python standard
		library only, so no additional Python package is required.

		Setup: Setup -> Hardware -> Dahua VTO, enter the address and the credentials of the intercom.

		Licensed upstream (LICENSE is installed with the plugin). The
		repository has no release tags, so the build fetches a pinned commit of
		the default branch.
```

## make/pkgs/domoticz-dds238/Config.in
```kconfig
config FREETZ_PACKAGE_DOMOTICZ_DDS238
	bool "Domoticz plugin: DDS238 energy meter (Modbus RS-485)"
	depends on FREETZ_PACKAGE_DOMOTICZ
	select FREETZ_PACKAGE_PYTHON3_PYSERIAL
	default n
	help
		readings of the DDS238 energy meters and of the devices that speak the same Modbus protocol (it ships its own copy of minimalmodbus and uses pyserial for the RS-485 port).

		It is a Python plugin of Domoticz: the package installs it into
		/usr/share/domoticz/plugins/domoticz-dds238, the directory Domoticz is
		started with (-approot of the domoticz package), and it needs no
		change of the Domoticz build.

		Setup -> Hardware -> DDS238, enter the serial port, the Modbus address and the model.

		Licensed upstream (LICENSE is installed with the plugin). The
		repository has no release tags, so the build fetches a pinned commit of
		the default branch.
```

## make/pkgs/domoticz-denon/Config.in
```kconfig
config FREETZ_PACKAGE_DOMOTICZ_DENON
	bool "Domoticz plugin: Denon/Marantz AV receiver"
	depends on FREETZ_PACKAGE_DOMOTICZ
	default n
	help
		control Denon and Marantz AV receivers over the LAN

		It is a Python plugin of Domoticz: the package installs it into
		/usr/share/domoticz/plugins/Domoticz-Denon-Plugin, the directory Domoticz is
		started with (-approot of the domoticz package), and it needs no
		change of the Domoticz build.

		The plugin imports the Domoticz module and the Python standard
		library only, so no additional Python package is required.

		Setup: Setup -> Hardware -> Denon/Marantz, enter the address of the receiver.

		Licensed upstream (LICENSE is installed with the plugin). The
		repository has no release tags, so the build fetches a pinned commit of
		the default branch.
```
