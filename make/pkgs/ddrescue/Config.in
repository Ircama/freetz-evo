## make/pkgs/domoticz-dsvt/Config.in
```kconfig
config FREETZ_PACKAGE_DOMOTICZ_DSVT
	bool "Domoticz plugin: DSVT zone heating/cooling control"
	depends on FREETZ_PACKAGE_DOMOTICZ
	select FREETZ_PACKAGE_PYTHON3_MOD_SQLITE
	default n
	help
		DSVT is a multi-zone heating, cooling and domestic hot water
		control system for Domoticz: up to 12 zones with individual room
		thermostats (or TRV valves), several heat sources (heat pump,
		boiler, electric heater), floor/radiator/wall/ceiling emitters,
		per-zone door and window detection, and a dashboard page served
		by the Domoticz web server.

		Unlike a plain thermostat script it creates the whole device tree
		and the control logic itself, and it keeps its state in a small
		SQLite database (hence the selected Python sqlite3 module); the
		Duinzicht/MiHome style viewers are not required.

		The plugin uses the Domoticz module and the Python standard
		library, and its labels follow the language of the hardware entry
		(16 translations; the dashboard page brings its own set).

		Setup: Setup -> Hardware -> add the DSVT hardware, then open the
		DSVT setup page of the plugin (linked from the hardware page) to
		define zones and heat sources.

		Licensed MIT upstream (LICENSE is installed with the plugin). The
		repository has no release tags, so the build fetches a pinned
		commit of the main branch.
```

## make/pkgs/domoticz-dts238/Config.in
```kconfig
config FREETZ_PACKAGE_DOMOTICZ_DTS238
	bool "Domoticz plugin: DTS238 three-phase meter (Modbus RS-485)"
	depends on FREETZ_PACKAGE_DOMOTICZ
	select FREETZ_PACKAGE_PYTHON3_PYSERIAL
	default n
	help
		readings of the DTS238 three-phase energy meters and of the devices that speak the same Modbus protocol (it ships its own copy of minimalmodbus and uses pyserial for the RS-485 port).

		It is a Python plugin of Domoticz: the package installs it into
		/usr/share/domoticz/plugins/domoticz-dts238, the directory Domoticz is
		started with (-approot of the domoticz package), and it needs no
		change of the Domoticz build.

		Setup -> Hardware -> DTS238, enter the serial port, the Modbus address and the model.

		Licensed upstream (LICENSE is installed with the plugin). The
		repository has no release tags, so the build fetches a pinned commit of
		the default branch.
```

## make/pkgs/domoticz-ebusd/Config.in
```kconfig
config FREETZ_PACKAGE_DOMOTICZ_EBUSD
	bool "Domoticz plugin: ebusd heating bridge"
	depends on FREETZ_PACKAGE_DOMOTICZ
	default n
	help
		read a heating system through an ebusd daemon (Vaillant, Wolf, ...)

		It is a Python plugin of Domoticz: the package installs it into
		/usr/share/domoticz/plugins/DomoticzEbusd, the directory Domoticz is
		started with (-approot of the domoticz package), and it needs no
		change of the Domoticz build.

		The plugin imports the Domoticz module and the Python standard
		library only, so no additional Python package is required.

		Setup: Setup -> Hardware -> ebusd, enter the address and port of the ebusd daemon.

		Licensed upstream (LICENSE is installed with the plugin). The
		repository has no release tags, so the build fetches a pinned commit of
		the default branch.
```

## make/pkgs/domoticz-emmeti-eq2021/Config.in
```kconfig
config FREETZ_PACKAGE_DOMOTICZ_EMMETI_EQ2021
	bool "Domoticz plugin: Emmeti EQ2021 thermostat (Modbus)"
	depends on FREETZ_PACKAGE_DOMOTICZ
	select FREETZ_PACKAGE_PYTHON3_PYSERIAL
	default n
	help
		control of the Emmeti EQ2021 thermostats over Modbus (it ships its own copy of minimalmodbus and uses pyserial for the RS-485 port).

		It is a Python plugin of Domoticz: the package installs it into
		/usr/share/domoticz/plugins/domoticz-emmeti-eq2021, the directory Domoticz is
		started with (-approot of the domoticz package), and it needs no
		change of the Domoticz build.

		Setup -> Hardware -> Emmeti EQ2021, enter the serial port and the Modbus address.

		Licensed upstream (LICENSE is installed with the plugin). The
		repository has no release tags, so the build fetches a pinned commit of
		the default branch.
```

## make/pkgs/domoticz-emmeti-mirai/Config.in
```kconfig
config FREETZ_PACKAGE_DOMOTICZ_EMMETI_MIRAI
	bool "Domoticz plugin: Emmeti Mirai thermostat (Modbus)"
	depends on FREETZ_PACKAGE_DOMOTICZ
	select FREETZ_PACKAGE_PYTHON3_PYSERIAL
	default n
	help
		control of the Emmeti Mirai thermostats over Modbus (it ships its own copy of minimalmodbus and uses pyserial for the RS-485 port).

		It is a Python plugin of Domoticz: the package installs it into
		/usr/share/domoticz/plugins/domoticz-emmeti-mirai, the directory Domoticz is
		started with (-approot of the domoticz package), and it needs no
		change of the Domoticz build.

		Setup -> Hardware -> Emmeti Mirai, enter the serial port and the Modbus address.

		Licensed upstream (LICENSE is installed with the plugin). The
		repository has no release tags, so the build fetches a pinned commit of
		the default branch.
```

## make/pkgs/domoticz-ev-charge-control/Config.in
```kconfig
config FREETZ_PACKAGE_DOMOTICZ_EV_CHARGE_CONTROL
	bool "Domoticz plugin: timed EV charger control"
	depends on FREETZ_PACKAGE_DOMOTICZ
	default n
	help
		Timed charging control for an electric vehicle: the plugin
		switches an existing Domoticz device (the switch or contactor
		that enables the wallbox) ON and OFF according to a schedule
		configured on the hardware page, and it can be disabled
		temporarily without losing the schedule.

		A safety function refuses to switch the charger ON again within
		30 minutes of a switch OFF, which protects the on-board charger
		of the car from being cycled when the schedule is changed or the
		box restarts.

		The controlled device is any Domoticz switch, for example a
		Wi-Fi or Zigbee relay; the plugin only uses the Domoticz module
		and the Python standard library.

		Setup: Setup -> Hardware -> add "EV charger timer" (or similar),
		then select the switch device and the ON/OFF times.

		Licensed MIT upstream (LICENSE is installed with the plugin).
		The repository has no release tags, so the build fetches a
		pinned commit of the main branch.
```

## make/pkgs/domoticz-ewpe-smart-mqtt/Config.in
```kconfig
config FREETZ_PACKAGE_DOMOTICZ_EWPE_SMART_MQTT
	bool "Domoticz plugin: EWPE Smart air conditioners (MQTT)"
	depends on FREETZ_PACKAGE_DOMOTICZ
	select FREETZ_PACKAGE_PYTHON3_PYCRYPTODOME
	default n
	help
		control of the EWPE Smart/Gree air conditioners over MQTT, with encrypted commands (it encrypts the commands with pycryptodome and ships its own MQTT client).

		It is a Python plugin of Domoticz: the package installs it into
		/usr/share/domoticz/plugins/ewpe-smart-mqtt, the directory Domoticz is
		started with (-approot of the domoticz package), and it needs no
		change of the Domoticz build.

		Setup -> Hardware -> EWPE Smart MQTT, enter the MQTT broker and the device.

		Licensed upstream (LICENSE is installed with the plugin). The
		repository has no release tags, so the build fetches a pinned commit of
		the default branch.
```

## make/pkgs/domoticz-fritz-presence/Config.in
```kconfig
config FREETZ_PACKAGE_DOMOTICZ_FRITZ_PRESENCE
	bool "Domoticz plugin: presence detection via the FRITZ!Box"
	depends on FREETZ_PACKAGE_DOMOTICZ
	select FREETZ_PACKAGE_PYTHON3_FRITZCONNECTION
	default n
	help
		presence detection driven by the FRITZ!Box (devices seen by the router)

		It is a Python plugin of Domoticz: the package installs it into
		/usr/share/domoticz/plugins/domoticz-FritzPresence, the directory Domoticz is
		started with (-approot of the domoticz package), and it needs no
		change of the Domoticz build.

		The plugin needs python3-fritzconnection (installed as a
		dependency of this package) in addition to the standard library.

		Setup: Setup -> Hardware -> Fritz Presence, enter the address and credentials of the FRITZ!Box.

		Licensed upstream (LICENSE is installed with the plugin). The
		repository has no release tags, so the build fetches a pinned commit of
		the default branch.
```

## make/pkgs/domoticz-fronius/Config.in
```kconfig
config FREETZ_PACKAGE_DOMOTICZ_FRONIUS
	bool "Domoticz plugin: Fronius solar inverter"
	depends on FREETZ_PACKAGE_DOMOTICZ
	default n
	help
		read a Fronius inverter through its local HTTP API

		It is a Python plugin of Domoticz: the package installs it into
		/usr/share/domoticz/plugins/froniusHttp, the directory Domoticz is
		started with (-approot of the domoticz package), and it needs no
		change of the Domoticz build.

		The plugin imports the Domoticz module and the Python standard
		library only, so no additional Python package is required.

		Setup: Setup -> Hardware -> Fronius, enter the address of the inverter (or of its Datamanager).

		Licensed upstream (LICENSE is installed with the plugin). The
		repository has no release tags, so the build fetches a pinned commit of
		the default branch.
```

## make/pkgs/domoticz-goodwe/Config.in
```kconfig
config FREETZ_PACKAGE_DOMOTICZ_GOODWE
	bool "Domoticz plugin: GoodWe solar inverter (SEMS API)"
	depends on FREETZ_PACKAGE_DOMOTICZ
	select FREETZ_PACKAGE_PYTHON3_REQUESTS
	default n
	help
		read a GoodWe inverter through the SEMS cloud API

		It is a Python plugin of Domoticz: the package installs it into
		/usr/share/domoticz/plugins/domoticz-GoodWeSEMS, the directory Domoticz is
		started with (-approot of the domoticz package), and it needs no
		change of the Domoticz build.

		The plugin needs python3-requests (installed as a
		dependency of this package) in addition to the standard library.

		Setup: Setup -> Hardware -> GoodWe, enter the account and station data of the SEMS portal.

		Licensed upstream (LICENSE.md is installed with the plugin). The
		repository has no release tags, so the build fetches a pinned commit of
		the default branch.
```
